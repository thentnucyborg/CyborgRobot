/*
 * Interface wrapper code.
 *
 * Generated by SIP 4.17
 */

#include "sipAPIlibrviz_sip.h"

#line 7 "panel_dock_widget.sip"
#include <rviz/panel_dock_widget.h>
#line 12 "/home/lassegoncz/catkin_ws/devel/bin/sip/rviz_sip/siplibrviz_siprvizPanelDockWidget.cpp"

#line 27 "/usr/share/sip/PyQt5/QtCore/qstring.sip"
#include <qstring.h>
#line 16 "/home/lassegoncz/catkin_ws/devel/bin/sip/rviz_sip/siplibrviz_siprvizPanelDockWidget.cpp"
#line 28 "/usr/share/sip/PyQt5/QtWidgets/qwidget.sip"
#include <qwidget.h>
#line 19 "/home/lassegoncz/catkin_ws/devel/bin/sip/rviz_sip/siplibrviz_siprvizPanelDockWidget.cpp"
#line 26 "/usr/share/sip/PyQt5/QtCore/qcoreevent.sip"
#include <qcoreevent.h>
#line 22 "/home/lassegoncz/catkin_ws/devel/bin/sip/rviz_sip/siplibrviz_siprvizPanelDockWidget.cpp"
#line 376 "/usr/share/sip/PyQt5/QtGui/qevent.sip"
#include <qevent.h>
#line 25 "/home/lassegoncz/catkin_ws/devel/bin/sip/rviz_sip/siplibrviz_siprvizPanelDockWidget.cpp"
#line 416 "/usr/share/sip/PyQt5/QtGui/qevent.sip"
#include <qevent.h>
#line 28 "/home/lassegoncz/catkin_ws/devel/bin/sip/rviz_sip/siplibrviz_siprvizPanelDockWidget.cpp"
#line 534 "/usr/share/sip/PyQt5/QtWidgets/qstyleoption.sip"
#include <qstyleoption.h>
#line 31 "/home/lassegoncz/catkin_ws/devel/bin/sip/rviz_sip/siplibrviz_siprvizPanelDockWidget.cpp"
#line 26 "/usr/share/sip/PyQt5/QtCore/qnamespace.sip"
#include <qnamespace.h>
#line 34 "/home/lassegoncz/catkin_ws/devel/bin/sip/rviz_sip/siplibrviz_siprvizPanelDockWidget.cpp"
#line 26 "/usr/share/sip/PyQt5/QtCore/qnamespace.sip"
#include <qnamespace.h>
#line 37 "/home/lassegoncz/catkin_ws/devel/bin/sip/rviz_sip/siplibrviz_siprvizPanelDockWidget.cpp"
#line 26 "/usr/share/sip/PyQt5/QtWidgets/qdockwidget.sip"
#include <qdockwidget.h>
#line 40 "/home/lassegoncz/catkin_ws/devel/bin/sip/rviz_sip/siplibrviz_siprvizPanelDockWidget.cpp"
#line 26 "/usr/share/sip/PyQt5/QtWidgets/qaction.sip"
#include <qaction.h>
#line 43 "/home/lassegoncz/catkin_ws/devel/bin/sip/rviz_sip/siplibrviz_siprvizPanelDockWidget.cpp"
#line 26 "/usr/share/sip/PyQt5/QtGui/qicon.sip"
#include <qicon.h>
#line 46 "/home/lassegoncz/catkin_ws/devel/bin/sip/rviz_sip/siplibrviz_siprvizPanelDockWidget.cpp"
#line 26 "/usr/share/sip/PyQt5/QtGui/qpainter.sip"
#include <qpainter.h>
#line 49 "/home/lassegoncz/catkin_ws/devel/bin/sip/rviz_sip/siplibrviz_siprvizPanelDockWidget.cpp"
#line 32 "/usr/share/sip/PyQt5/QtCore/qbytearray.sip"
#include <qbytearray.h>
#line 52 "/home/lassegoncz/catkin_ws/devel/bin/sip/rviz_sip/siplibrviz_siprvizPanelDockWidget.cpp"
#line 26 "/usr/share/sip/PyQt5/QtGui/qwindow.sip"
#include <qwindow.h>
#line 55 "/home/lassegoncz/catkin_ws/devel/bin/sip/rviz_sip/siplibrviz_siprvizPanelDockWidget.cpp"
#line 26 "/usr/share/sip/PyQt5/QtCore/qnamespace.sip"
#include <qnamespace.h>
#line 58 "/home/lassegoncz/catkin_ws/devel/bin/sip/rviz_sip/siplibrviz_siprvizPanelDockWidget.cpp"
#line 26 "/usr/share/sip/PyQt5/QtGui/qpixmap.sip"
#include <qpixmap.h>
#line 61 "/home/lassegoncz/catkin_ws/devel/bin/sip/rviz_sip/siplibrviz_siprvizPanelDockWidget.cpp"
#line 26 "/usr/share/sip/PyQt5/QtCore/qrect.sip"
#include <qrect.h>
#line 64 "/home/lassegoncz/catkin_ws/devel/bin/sip/rviz_sip/siplibrviz_siprvizPanelDockWidget.cpp"
#line 26 "/usr/share/sip/PyQt5/QtCore/qnamespace.sip"
#include <qnamespace.h>
#line 67 "/home/lassegoncz/catkin_ws/devel/bin/sip/rviz_sip/siplibrviz_siprvizPanelDockWidget.cpp"
#line 26 "/usr/share/sip/PyQt5/QtCore/qmargins.sip"
#include <qmargins.h>
#line 70 "/home/lassegoncz/catkin_ws/devel/bin/sip/rviz_sip/siplibrviz_siprvizPanelDockWidget.cpp"
#line 26 "/usr/share/sip/PyQt5/QtCore/qnamespace.sip"
#include <qnamespace.h>
#line 73 "/home/lassegoncz/catkin_ws/devel/bin/sip/rviz_sip/siplibrviz_siprvizPanelDockWidget.cpp"
#line 26 "/usr/share/sip/PyQt5/QtWidgets/qgraphicseffect.sip"
#include <qgraphicseffect.h>
#line 76 "/home/lassegoncz/catkin_ws/devel/bin/sip/rviz_sip/siplibrviz_siprvizPanelDockWidget.cpp"
#line 26 "/usr/share/sip/PyQt5/QtWidgets/qgraphicsproxywidget.sip"
#include <qgraphicsproxywidget.h>
#line 79 "/home/lassegoncz/catkin_ws/devel/bin/sip/rviz_sip/siplibrviz_siprvizPanelDockWidget.cpp"
#line 192 "/usr/share/sip/PyQt5/QtCore/qglobal.sip"
#include <QtGlobal>
#line 82 "/home/lassegoncz/catkin_ws/devel/bin/sip/rviz_sip/siplibrviz_siprvizPanelDockWidget.cpp"
#line 26 "/usr/share/sip/PyQt5/QtCore/qlocale.sip"
#include <qlocale.h>
#line 85 "/home/lassegoncz/catkin_ws/devel/bin/sip/rviz_sip/siplibrviz_siprvizPanelDockWidget.cpp"
#line 26 "/usr/share/sip/PyQt5/QtGui/qpaintdevice.sip"
#include <qpaintdevice.h>
#line 88 "/home/lassegoncz/catkin_ws/devel/bin/sip/rviz_sip/siplibrviz_siprvizPanelDockWidget.cpp"
#line 26 "/usr/share/sip/PyQt5/QtCore/qpoint.sip"
#include <qpoint.h>
#line 91 "/home/lassegoncz/catkin_ws/devel/bin/sip/rviz_sip/siplibrviz_siprvizPanelDockWidget.cpp"
#line 26 "/usr/share/sip/PyQt5/QtGui/qregion.sip"
#include <qregion.h>
#line 94 "/home/lassegoncz/catkin_ws/devel/bin/sip/rviz_sip/siplibrviz_siprvizPanelDockWidget.cpp"
#line 28 "/usr/share/sip/PyQt5/QtWidgets/qwidget.sip"
#include <qwidget.h>
#line 97 "/home/lassegoncz/catkin_ws/devel/bin/sip/rviz_sip/siplibrviz_siprvizPanelDockWidget.cpp"
#line 26 "/usr/share/sip/PyQt5/QtCore/qsize.sip"
#include <qsize.h>
#line 100 "/home/lassegoncz/catkin_ws/devel/bin/sip/rviz_sip/siplibrviz_siprvizPanelDockWidget.cpp"
#line 26 "/usr/share/sip/PyQt5/QtGui/qfontinfo.sip"
#include <qfontinfo.h>
#line 103 "/home/lassegoncz/catkin_ws/devel/bin/sip/rviz_sip/siplibrviz_siprvizPanelDockWidget.cpp"
#line 26 "/usr/share/sip/PyQt5/QtGui/qfontmetrics.sip"
#include <qfontmetrics.h>
#line 106 "/home/lassegoncz/catkin_ws/devel/bin/sip/rviz_sip/siplibrviz_siprvizPanelDockWidget.cpp"
#line 26 "/usr/share/sip/PyQt5/QtGui/qfont.sip"
#include <qfont.h>
#line 109 "/home/lassegoncz/catkin_ws/devel/bin/sip/rviz_sip/siplibrviz_siprvizPanelDockWidget.cpp"
#line 26 "/usr/share/sip/PyQt5/QtCore/qvariant.sip"
#include <qvariant.h>
#line 112 "/home/lassegoncz/catkin_ws/devel/bin/sip/rviz_sip/siplibrviz_siprvizPanelDockWidget.cpp"
#line 487 "/usr/share/sip/PyQt5/QtGui/qevent.sip"
#include <qevent.h>
#line 115 "/home/lassegoncz/catkin_ws/devel/bin/sip/rviz_sip/siplibrviz_siprvizPanelDockWidget.cpp"
#line 449 "/usr/share/sip/PyQt5/QtGui/qevent.sip"
#include <qevent.h>
#line 118 "/home/lassegoncz/catkin_ws/devel/bin/sip/rviz_sip/siplibrviz_siprvizPanelDockWidget.cpp"
#line 438 "/usr/share/sip/PyQt5/QtGui/qevent.sip"
#include <qevent.h>
#line 121 "/home/lassegoncz/catkin_ws/devel/bin/sip/rviz_sip/siplibrviz_siprvizPanelDockWidget.cpp"
#line 542 "/usr/share/sip/PyQt5/QtGui/qevent.sip"
#include <qevent.h>
#line 124 "/home/lassegoncz/catkin_ws/devel/bin/sip/rviz_sip/siplibrviz_siprvizPanelDockWidget.cpp"
#line 591 "/usr/share/sip/PyQt5/QtGui/qevent.sip"
#include <qevent.h>
#line 127 "/home/lassegoncz/catkin_ws/devel/bin/sip/rviz_sip/siplibrviz_siprvizPanelDockWidget.cpp"
#line 564 "/usr/share/sip/PyQt5/QtGui/qevent.sip"
#include <qevent.h>
#line 130 "/home/lassegoncz/catkin_ws/devel/bin/sip/rviz_sip/siplibrviz_siprvizPanelDockWidget.cpp"
#line 580 "/usr/share/sip/PyQt5/QtGui/qevent.sip"
#include <qevent.h>
#line 133 "/home/lassegoncz/catkin_ws/devel/bin/sip/rviz_sip/siplibrviz_siprvizPanelDockWidget.cpp"
#line 643 "/usr/share/sip/PyQt5/QtGui/qevent.sip"
#include <qevent.h>
#line 136 "/home/lassegoncz/catkin_ws/devel/bin/sip/rviz_sip/siplibrviz_siprvizPanelDockWidget.cpp"
#line 283 "/usr/share/sip/PyQt5/QtGui/qevent.sip"
#include <qevent.h>
#line 139 "/home/lassegoncz/catkin_ws/devel/bin/sip/rviz_sip/siplibrviz_siprvizPanelDockWidget.cpp"
#line 460 "/usr/share/sip/PyQt5/QtGui/qevent.sip"
#include <qevent.h>
#line 142 "/home/lassegoncz/catkin_ws/devel/bin/sip/rviz_sip/siplibrviz_siprvizPanelDockWidget.cpp"
#line 403 "/usr/share/sip/PyQt5/QtGui/qevent.sip"
#include <qevent.h>
#line 145 "/home/lassegoncz/catkin_ws/devel/bin/sip/rviz_sip/siplibrviz_siprvizPanelDockWidget.cpp"
#line 390 "/usr/share/sip/PyQt5/QtGui/qevent.sip"
#include <qevent.h>
#line 148 "/home/lassegoncz/catkin_ws/devel/bin/sip/rviz_sip/siplibrviz_siprvizPanelDockWidget.cpp"
#line 362 "/usr/share/sip/PyQt5/QtGui/qevent.sip"
#include <qevent.h>
#line 151 "/home/lassegoncz/catkin_ws/devel/bin/sip/rviz_sip/siplibrviz_siprvizPanelDockWidget.cpp"
#line 341 "/usr/share/sip/PyQt5/QtGui/qevent.sip"
#include <qevent.h>
#line 154 "/home/lassegoncz/catkin_ws/devel/bin/sip/rviz_sip/siplibrviz_siprvizPanelDockWidget.cpp"
#line 249 "/usr/share/sip/PyQt5/QtGui/qevent.sip"
#include <qevent.h>
#line 157 "/home/lassegoncz/catkin_ws/devel/bin/sip/rviz_sip/siplibrviz_siprvizPanelDockWidget.cpp"
#line 204 "/usr/share/sip/PyQt5/QtGui/qevent.sip"
#include <qevent.h>
#line 160 "/home/lassegoncz/catkin_ws/devel/bin/sip/rviz_sip/siplibrviz_siprvizPanelDockWidget.cpp"
#line 52 "/usr/share/sip/PyQt5/QtGui/qpaintengine.sip"
#include <qpaintengine.h>
#line 163 "/home/lassegoncz/catkin_ws/devel/bin/sip/rviz_sip/siplibrviz_siprvizPanelDockWidget.cpp"
#line 144 "/usr/share/sip/PyQt5/QtCore/qpycore_qlist.sip"
#include <qlist.h>
#line 166 "/home/lassegoncz/catkin_ws/devel/bin/sip/rviz_sip/siplibrviz_siprvizPanelDockWidget.cpp"
#line 26 "/usr/share/sip/PyQt5/QtWidgets/qlayout.sip"
#include <qlayout.h>
#line 169 "/home/lassegoncz/catkin_ws/devel/bin/sip/rviz_sip/siplibrviz_siprvizPanelDockWidget.cpp"
#line 26 "/usr/share/sip/PyQt5/QtWidgets/qsizepolicy.sip"
#include <qsizepolicy.h>
#line 172 "/home/lassegoncz/catkin_ws/devel/bin/sip/rviz_sip/siplibrviz_siprvizPanelDockWidget.cpp"
#line 26 "/usr/share/sip/PyQt5/QtCore/qnamespace.sip"
#include <qnamespace.h>
#line 175 "/home/lassegoncz/catkin_ws/devel/bin/sip/rviz_sip/siplibrviz_siprvizPanelDockWidget.cpp"
#line 26 "/usr/share/sip/PyQt5/QtGui/qkeysequence.sip"
#include <qkeysequence.h>
#line 178 "/home/lassegoncz/catkin_ws/devel/bin/sip/rviz_sip/siplibrviz_siprvizPanelDockWidget.cpp"
#line 26 "/usr/share/sip/PyQt5/QtGui/qcursor.sip"
#include <qcursor.h>
#line 181 "/home/lassegoncz/catkin_ws/devel/bin/sip/rviz_sip/siplibrviz_siprvizPanelDockWidget.cpp"
#line 26 "/usr/share/sip/PyQt5/QtGui/qbitmap.sip"
#include <qbitmap.h>
#line 184 "/home/lassegoncz/catkin_ws/devel/bin/sip/rviz_sip/siplibrviz_siprvizPanelDockWidget.cpp"
#line 26 "/usr/share/sip/PyQt5/QtGui/qpalette.sip"
#include <qpalette.h>
#line 187 "/home/lassegoncz/catkin_ws/devel/bin/sip/rviz_sip/siplibrviz_siprvizPanelDockWidget.cpp"
#line 26 "/usr/share/sip/PyQt5/QtWidgets/qstyle.sip"
#include <qstyle.h>
#line 190 "/home/lassegoncz/catkin_ws/devel/bin/sip/rviz_sip/siplibrviz_siprvizPanelDockWidget.cpp"
#line 26 "/usr/share/sip/PyQt5/QtCore/qmetaobject.sip"
#include <qmetaobject.h>
#line 193 "/home/lassegoncz/catkin_ws/devel/bin/sip/rviz_sip/siplibrviz_siprvizPanelDockWidget.cpp"
#line 244 "/usr/share/sip/PyQt5/QtCore/qcoreevent.sip"
#include <qcoreevent.h>
#line 196 "/home/lassegoncz/catkin_ws/devel/bin/sip/rviz_sip/siplibrviz_siprvizPanelDockWidget.cpp"
#line 232 "/usr/share/sip/PyQt5/QtCore/qcoreevent.sip"
#include <qcoreevent.h>
#line 199 "/home/lassegoncz/catkin_ws/devel/bin/sip/rviz_sip/siplibrviz_siprvizPanelDockWidget.cpp"
#line 28 "/usr/share/sip/PyQt5/QtCore/qobject.sip"
#include <qobject.h>
#line 202 "/home/lassegoncz/catkin_ws/devel/bin/sip/rviz_sip/siplibrviz_siprvizPanelDockWidget.cpp"
#line 36 "/usr/share/sip/PyQt5/QtCore/qpycore_qlist.sip"
#include <qlist.h>
#line 205 "/home/lassegoncz/catkin_ws/devel/bin/sip/rviz_sip/siplibrviz_siprvizPanelDockWidget.cpp"
#line 144 "/usr/share/sip/PyQt5/QtCore/qpycore_qlist.sip"
#include <qlist.h>
#line 208 "/home/lassegoncz/catkin_ws/devel/bin/sip/rviz_sip/siplibrviz_siprvizPanelDockWidget.cpp"
#line 26 "/usr/share/sip/PyQt5/QtCore/qthread.sip"
#include <qthread.h>
#line 211 "/home/lassegoncz/catkin_ws/devel/bin/sip/rviz_sip/siplibrviz_siprvizPanelDockWidget.cpp"
#line 26 "/usr/share/sip/PyQt5/QtCore/qnamespace.sip"
#include <qnamespace.h>
#line 214 "/home/lassegoncz/catkin_ws/devel/bin/sip/rviz_sip/siplibrviz_siprvizPanelDockWidget.cpp"
#line 26 "/usr/share/sip/PyQt5/QtCore/qregexp.sip"
#include <qregexp.h>
#line 217 "/home/lassegoncz/catkin_ws/devel/bin/sip/rviz_sip/siplibrviz_siprvizPanelDockWidget.cpp"
#line 26 "/usr/share/sip/PyQt5/QtCore/qregularexpression.sip"
#include <qregularexpression.h>
#line 220 "/home/lassegoncz/catkin_ws/devel/bin/sip/rviz_sip/siplibrviz_siprvizPanelDockWidget.cpp"
#line 26 "/usr/share/sip/PyQt5/QtCore/qobjectdefs.sip"
#include <qobjectdefs.h>
#line 223 "/home/lassegoncz/catkin_ws/devel/bin/sip/rviz_sip/siplibrviz_siprvizPanelDockWidget.cpp"


class siprviz_PanelDockWidget : public rviz::PanelDockWidget
{
public:
    siprviz_PanelDockWidget(const QString&);
    virtual ~siprviz_PanelDockWidget();

    int qt_metacall(QMetaObject::Call,int,void **);
    void *qt_metacast(const char *);
    const QMetaObject *metaObject() const;

    /*
     * There is a public method for every protected method visible from
     * this class.
     */
    QObject* sipProtect_sender() const;
    int sipProtect_receivers(const char*) const;
    void sipProtectVirt_timerEvent(bool,QTimerEvent*);
    void sipProtectVirt_childEvent(bool,QChildEvent*);
    void sipProtectVirt_customEvent(bool,QEvent*);
    void sipProtectVirt_connectNotify(bool,const QMetaMethod&);
    void sipProtectVirt_disconnectNotify(bool,const QMetaMethod&);
    int sipProtect_senderSignalIndex() const;
    bool sipProtect_isSignalConnected(const QMetaMethod&) const;
    void sipProtectVirt_mousePressEvent(bool,QMouseEvent*);
    void sipProtectVirt_mouseReleaseEvent(bool,QMouseEvent*);
    void sipProtectVirt_mouseDoubleClickEvent(bool,QMouseEvent*);
    void sipProtectVirt_mouseMoveEvent(bool,QMouseEvent*);
    void sipProtectVirt_wheelEvent(bool,QWheelEvent*);
    void sipProtectVirt_keyPressEvent(bool,QKeyEvent*);
    void sipProtectVirt_keyReleaseEvent(bool,QKeyEvent*);
    void sipProtectVirt_focusInEvent(bool,QFocusEvent*);
    void sipProtectVirt_focusOutEvent(bool,QFocusEvent*);
    void sipProtectVirt_enterEvent(bool,QEvent*);
    void sipProtectVirt_leaveEvent(bool,QEvent*);
    void sipProtectVirt_moveEvent(bool,QMoveEvent*);
    void sipProtectVirt_resizeEvent(bool,QResizeEvent*);
    void sipProtectVirt_contextMenuEvent(bool,QContextMenuEvent*);
    void sipProtectVirt_tabletEvent(bool,QTabletEvent*);
    void sipProtectVirt_actionEvent(bool,QActionEvent*);
    void sipProtectVirt_dragEnterEvent(bool,QDragEnterEvent*);
    void sipProtectVirt_dragMoveEvent(bool,QDragMoveEvent*);
    void sipProtectVirt_dragLeaveEvent(bool,QDragLeaveEvent*);
    void sipProtectVirt_dropEvent(bool,QDropEvent*);
    void sipProtectVirt_showEvent(bool,QShowEvent*);
    void sipProtectVirt_hideEvent(bool,QHideEvent*);
    int sipProtectVirt_metric(bool,QPaintDevice::PaintDeviceMetric) const;
    void sipProtectVirt_inputMethodEvent(bool,QInputMethodEvent*);
    void sipProtect_updateMicroFocus();
    void sipProtect_create(WId,bool,bool);
    void sipProtect_destroy(bool,bool);
    bool sipProtectVirt_focusNextPrevChild(bool,bool);
    bool sipProtect_focusNextChild();
    bool sipProtect_focusPreviousChild();
    bool sipProtectVirt_nativeEvent(bool,const QByteArray&,void*,long*);
    QPainter* sipProtectVirt_sharedPainter(bool) const;
    void sipProtectVirt_initPainter(bool,QPainter*) const;
    void sipProtect_initStyleOption(QStyleOptionDockWidget*) const;
    void sipProtectVirt_changeEvent(bool,QEvent*);
    void sipProtectVirt_closeEvent(bool,QCloseEvent*);
    void sipProtectVirt_paintEvent(bool,QPaintEvent*);
    bool sipProtectVirt_event(bool,QEvent*);

    /*
     * There is a protected method for every virtual method visible from
     * this class.
     */
protected:
    void disconnectNotify(const QMetaMethod&);
    void connectNotify(const QMetaMethod&);
    void customEvent(QEvent*);
    void childEvent(QChildEvent*);
    void timerEvent(QTimerEvent*);
    bool eventFilter(QObject*,QEvent*);
    void initPainter(QPainter*) const;
    QPainter* sharedPainter() const;
    bool nativeEvent(const QByteArray&,void*,long*);
    bool hasHeightForWidth() const;
    bool focusNextPrevChild(bool);
    QVariant inputMethodQuery(Qt::InputMethodQuery) const;
    void inputMethodEvent(QInputMethodEvent*);
    int metric(QPaintDevice::PaintDeviceMetric) const;
    void hideEvent(QHideEvent*);
    void showEvent(QShowEvent*);
    void dropEvent(QDropEvent*);
    void dragLeaveEvent(QDragLeaveEvent*);
    void dragMoveEvent(QDragMoveEvent*);
    void dragEnterEvent(QDragEnterEvent*);
    void actionEvent(QActionEvent*);
    void tabletEvent(QTabletEvent*);
    void contextMenuEvent(QContextMenuEvent*);
    void resizeEvent(QResizeEvent*);
    void moveEvent(QMoveEvent*);
    void leaveEvent(QEvent*);
    void enterEvent(QEvent*);
    void focusOutEvent(QFocusEvent*);
    void focusInEvent(QFocusEvent*);
    void keyReleaseEvent(QKeyEvent*);
    void keyPressEvent(QKeyEvent*);
    void wheelEvent(QWheelEvent*);
    void mouseMoveEvent(QMouseEvent*);
    void mouseDoubleClickEvent(QMouseEvent*);
    void mouseReleaseEvent(QMouseEvent*);
    void mousePressEvent(QMouseEvent*);
    QPaintEngine* paintEngine() const;
    int heightForWidth(int) const;
    QSize minimumSizeHint() const;
    QSize sizeHint() const;
    void setVisible(bool);
    int devType() const;
    bool event(QEvent*);
    void paintEvent(QPaintEvent*);
    void closeEvent(QCloseEvent*);
    void changeEvent(QEvent*);

public:
    sipSimpleWrapper *sipPySelf;

private:
    siprviz_PanelDockWidget(const siprviz_PanelDockWidget &);
    siprviz_PanelDockWidget &operator = (const siprviz_PanelDockWidget &);

    char sipPyMethods[46];
};

siprviz_PanelDockWidget::siprviz_PanelDockWidget(const QString& a0): rviz::PanelDockWidget(a0), sipPySelf(0)
{
    memset(sipPyMethods, 0, sizeof (sipPyMethods));
}

siprviz_PanelDockWidget::~siprviz_PanelDockWidget()
{
    sipCommonDtor(sipPySelf);
}

const QMetaObject *siprviz_PanelDockWidget::metaObject() const
{
    return QObject::d_ptr->metaObject ? QObject::d_ptr->dynamicMetaObject() : sip_librviz_sip_qt_metaobject(sipPySelf,sipType_rviz_PanelDockWidget);
}

int siprviz_PanelDockWidget::qt_metacall(QMetaObject::Call _c,int _id,void **_a)
{
    _id = rviz::PanelDockWidget::qt_metacall(_c,_id,_a);

    if (_id >= 0)
        _id = sip_librviz_sip_qt_metacall(sipPySelf,sipType_rviz_PanelDockWidget,_c,_id,_a);

    return _id;
}

void *siprviz_PanelDockWidget::qt_metacast(const char *_clname)
{
    void *sipCpp;

    return (sip_librviz_sip_qt_metacast(sipPySelf, sipType_rviz_PanelDockWidget, _clname, &sipCpp) ? sipCpp : rviz::PanelDockWidget::qt_metacast(_clname));
}

void siprviz_PanelDockWidget::disconnectNotify(const QMetaMethod& a0)
{
    sip_gilstate_t sipGILState;
    PyObject *sipMeth;

    sipMeth = sipIsPyMethod(&sipGILState,&sipPyMethods[0],sipPySelf,NULL,sipName_disconnectNotify);

    if (!sipMeth)
    {
        rviz::PanelDockWidget::disconnectNotify(a0);
        return;
    }

    typedef void (*sipVH_QtCore_46)(sip_gilstate_t, sipVirtErrorHandlerFunc, sipSimpleWrapper *, PyObject *, const QMetaMethod&);

    ((sipVH_QtCore_46)(sipModuleAPI_librviz_sip_QtCore->em_virthandlers[46]))(sipGILState, sipModuleAPI_librviz_sip_QtCore->em_virterrorhandlers[0], sipPySelf, sipMeth, a0);
}

void siprviz_PanelDockWidget::connectNotify(const QMetaMethod& a0)
{
    sip_gilstate_t sipGILState;
    PyObject *sipMeth;

    sipMeth = sipIsPyMethod(&sipGILState,&sipPyMethods[1],sipPySelf,NULL,sipName_connectNotify);

    if (!sipMeth)
    {
        rviz::PanelDockWidget::connectNotify(a0);
        return;
    }

    typedef void (*sipVH_QtCore_46)(sip_gilstate_t, sipVirtErrorHandlerFunc, sipSimpleWrapper *, PyObject *, const QMetaMethod&);

    ((sipVH_QtCore_46)(sipModuleAPI_librviz_sip_QtCore->em_virthandlers[46]))(sipGILState, sipModuleAPI_librviz_sip_QtCore->em_virterrorhandlers[0], sipPySelf, sipMeth, a0);
}

void siprviz_PanelDockWidget::customEvent(QEvent*a0)
{
    sip_gilstate_t sipGILState;
    PyObject *sipMeth;

    sipMeth = sipIsPyMethod(&sipGILState,&sipPyMethods[2],sipPySelf,NULL,sipName_customEvent);

    if (!sipMeth)
    {
        rviz::PanelDockWidget::customEvent(a0);
        return;
    }

    typedef void (*sipVH_QtCore_25)(sip_gilstate_t, sipVirtErrorHandlerFunc, sipSimpleWrapper *, PyObject *, QEvent*);

    ((sipVH_QtCore_25)(sipModuleAPI_librviz_sip_QtCore->em_virthandlers[25]))(sipGILState, sipModuleAPI_librviz_sip_QtCore->em_virterrorhandlers[0], sipPySelf, sipMeth, a0);
}

void siprviz_PanelDockWidget::childEvent(QChildEvent*a0)
{
    sip_gilstate_t sipGILState;
    PyObject *sipMeth;

    sipMeth = sipIsPyMethod(&sipGILState,&sipPyMethods[3],sipPySelf,NULL,sipName_childEvent);

    if (!sipMeth)
    {
        rviz::PanelDockWidget::childEvent(a0);
        return;
    }

    typedef void (*sipVH_QtCore_47)(sip_gilstate_t, sipVirtErrorHandlerFunc, sipSimpleWrapper *, PyObject *, QChildEvent*);

    ((sipVH_QtCore_47)(sipModuleAPI_librviz_sip_QtCore->em_virthandlers[47]))(sipGILState, sipModuleAPI_librviz_sip_QtCore->em_virterrorhandlers[0], sipPySelf, sipMeth, a0);
}

void siprviz_PanelDockWidget::timerEvent(QTimerEvent*a0)
{
    sip_gilstate_t sipGILState;
    PyObject *sipMeth;

    sipMeth = sipIsPyMethod(&sipGILState,&sipPyMethods[4],sipPySelf,NULL,sipName_timerEvent);

    if (!sipMeth)
    {
        rviz::PanelDockWidget::timerEvent(a0);
        return;
    }

    typedef void (*sipVH_QtCore_9)(sip_gilstate_t, sipVirtErrorHandlerFunc, sipSimpleWrapper *, PyObject *, QTimerEvent*);

    ((sipVH_QtCore_9)(sipModuleAPI_librviz_sip_QtCore->em_virthandlers[9]))(sipGILState, sipModuleAPI_librviz_sip_QtCore->em_virterrorhandlers[0], sipPySelf, sipMeth, a0);
}

bool siprviz_PanelDockWidget::eventFilter(QObject*a0,QEvent*a1)
{
    sip_gilstate_t sipGILState;
    PyObject *sipMeth;

    sipMeth = sipIsPyMethod(&sipGILState,&sipPyMethods[5],sipPySelf,NULL,sipName_eventFilter);

    if (!sipMeth)
        return rviz::PanelDockWidget::eventFilter(a0,a1);

    typedef bool (*sipVH_QtCore_26)(sip_gilstate_t, sipVirtErrorHandlerFunc, sipSimpleWrapper *, PyObject *, QObject*,QEvent*);

    return ((sipVH_QtCore_26)(sipModuleAPI_librviz_sip_QtCore->em_virthandlers[26]))(sipGILState, sipModuleAPI_librviz_sip_QtCore->em_virterrorhandlers[0], sipPySelf, sipMeth, a0, a1);
}

void siprviz_PanelDockWidget::initPainter(QPainter*a0) const
{
    sip_gilstate_t sipGILState;
    PyObject *sipMeth;

    sipMeth = sipIsPyMethod(&sipGILState,const_cast<char *>(&sipPyMethods[6]),sipPySelf,NULL,sipName_initPainter);

    if (!sipMeth)
    {
        rviz::PanelDockWidget::initPainter(a0);
        return;
    }

    typedef void (*sipVH_QtWidgets_3)(sip_gilstate_t, sipVirtErrorHandlerFunc, sipSimpleWrapper *, PyObject *, QPainter*);

    ((sipVH_QtWidgets_3)(sipModuleAPI_librviz_sip_QtWidgets->em_virthandlers[3]))(sipGILState, sipModuleAPI_librviz_sip_QtCore->em_virterrorhandlers[0], sipPySelf, sipMeth, a0);
}

QPainter* siprviz_PanelDockWidget::sharedPainter() const
{
    sip_gilstate_t sipGILState;
    PyObject *sipMeth;

    sipMeth = sipIsPyMethod(&sipGILState,const_cast<char *>(&sipPyMethods[7]),sipPySelf,NULL,sipName_sharedPainter);

    if (!sipMeth)
        return rviz::PanelDockWidget::sharedPainter();

    typedef QPainter* (*sipVH_QtWidgets_4)(sip_gilstate_t, sipVirtErrorHandlerFunc, sipSimpleWrapper *, PyObject *);

    return ((sipVH_QtWidgets_4)(sipModuleAPI_librviz_sip_QtWidgets->em_virthandlers[4]))(sipGILState, sipModuleAPI_librviz_sip_QtCore->em_virterrorhandlers[0], sipPySelf, sipMeth);
}

bool siprviz_PanelDockWidget::nativeEvent(const QByteArray& a0,void*a1,long*a2)
{
    sip_gilstate_t sipGILState;
    PyObject *sipMeth;

    sipMeth = sipIsPyMethod(&sipGILState,&sipPyMethods[8],sipPySelf,NULL,sipName_nativeEvent);

    if (!sipMeth)
        return rviz::PanelDockWidget::nativeEvent(a0,a1,a2);

    typedef bool (*sipVH_QtCore_58)(sip_gilstate_t, sipVirtErrorHandlerFunc, sipSimpleWrapper *, PyObject *, const QByteArray&,void*,long*);

    return ((sipVH_QtCore_58)(sipModuleAPI_librviz_sip_QtCore->em_virthandlers[58]))(sipGILState, sipModuleAPI_librviz_sip_QtCore->em_virterrorhandlers[0], sipPySelf, sipMeth, a0, a1, a2);
}

bool siprviz_PanelDockWidget::hasHeightForWidth() const
{
    sip_gilstate_t sipGILState;
    PyObject *sipMeth;

    sipMeth = sipIsPyMethod(&sipGILState,const_cast<char *>(&sipPyMethods[9]),sipPySelf,NULL,sipName_hasHeightForWidth);

    if (!sipMeth)
        return rviz::PanelDockWidget::hasHeightForWidth();

    typedef bool (*sipVH_QtCore_7)(sip_gilstate_t, sipVirtErrorHandlerFunc, sipSimpleWrapper *, PyObject *);

    return ((sipVH_QtCore_7)(sipModuleAPI_librviz_sip_QtCore->em_virthandlers[7]))(sipGILState, sipModuleAPI_librviz_sip_QtCore->em_virterrorhandlers[0], sipPySelf, sipMeth);
}

bool siprviz_PanelDockWidget::focusNextPrevChild(bool a0)
{
    sip_gilstate_t sipGILState;
    PyObject *sipMeth;

    sipMeth = sipIsPyMethod(&sipGILState,&sipPyMethods[10],sipPySelf,NULL,sipName_focusNextPrevChild);

    if (!sipMeth)
        return rviz::PanelDockWidget::focusNextPrevChild(a0);

    typedef bool (*sipVH_QtWidgets_5)(sip_gilstate_t, sipVirtErrorHandlerFunc, sipSimpleWrapper *, PyObject *, bool);

    return ((sipVH_QtWidgets_5)(sipModuleAPI_librviz_sip_QtWidgets->em_virthandlers[5]))(sipGILState, sipModuleAPI_librviz_sip_QtCore->em_virterrorhandlers[0], sipPySelf, sipMeth, a0);
}

QVariant siprviz_PanelDockWidget::inputMethodQuery(Qt::InputMethodQuery a0) const
{
    sip_gilstate_t sipGILState;
    PyObject *sipMeth;

    sipMeth = sipIsPyMethod(&sipGILState,const_cast<char *>(&sipPyMethods[11]),sipPySelf,NULL,sipName_inputMethodQuery);

    if (!sipMeth)
        return rviz::PanelDockWidget::inputMethodQuery(a0);

    typedef QVariant (*sipVH_QtWidgets_6)(sip_gilstate_t, sipVirtErrorHandlerFunc, sipSimpleWrapper *, PyObject *, Qt::InputMethodQuery);

    return ((sipVH_QtWidgets_6)(sipModuleAPI_librviz_sip_QtWidgets->em_virthandlers[6]))(sipGILState, sipModuleAPI_librviz_sip_QtCore->em_virterrorhandlers[0], sipPySelf, sipMeth, a0);
}

void siprviz_PanelDockWidget::inputMethodEvent(QInputMethodEvent*a0)
{
    sip_gilstate_t sipGILState;
    PyObject *sipMeth;

    sipMeth = sipIsPyMethod(&sipGILState,&sipPyMethods[12],sipPySelf,NULL,sipName_inputMethodEvent);

    if (!sipMeth)
    {
        rviz::PanelDockWidget::inputMethodEvent(a0);
        return;
    }

    typedef void (*sipVH_QtWidgets_7)(sip_gilstate_t, sipVirtErrorHandlerFunc, sipSimpleWrapper *, PyObject *, QInputMethodEvent*);

    ((sipVH_QtWidgets_7)(sipModuleAPI_librviz_sip_QtWidgets->em_virthandlers[7]))(sipGILState, sipModuleAPI_librviz_sip_QtCore->em_virterrorhandlers[0], sipPySelf, sipMeth, a0);
}

int siprviz_PanelDockWidget::metric(QPaintDevice::PaintDeviceMetric a0) const
{
    sip_gilstate_t sipGILState;
    PyObject *sipMeth;

    sipMeth = sipIsPyMethod(&sipGILState,const_cast<char *>(&sipPyMethods[13]),sipPySelf,NULL,sipName_metric);

    if (!sipMeth)
        return rviz::PanelDockWidget::metric(a0);

    typedef int (*sipVH_QtGui_28)(sip_gilstate_t, sipVirtErrorHandlerFunc, sipSimpleWrapper *, PyObject *, QPaintDevice::PaintDeviceMetric);

    return ((sipVH_QtGui_28)(sipModuleAPI_librviz_sip_QtGui->em_virthandlers[28]))(sipGILState, sipModuleAPI_librviz_sip_QtCore->em_virterrorhandlers[0], sipPySelf, sipMeth, a0);
}

void siprviz_PanelDockWidget::hideEvent(QHideEvent*a0)
{
    sip_gilstate_t sipGILState;
    PyObject *sipMeth;

    sipMeth = sipIsPyMethod(&sipGILState,&sipPyMethods[14],sipPySelf,NULL,sipName_hideEvent);

    if (!sipMeth)
    {
        rviz::PanelDockWidget::hideEvent(a0);
        return;
    }

    typedef void (*sipVH_QtGui_5)(sip_gilstate_t, sipVirtErrorHandlerFunc, sipSimpleWrapper *, PyObject *, QHideEvent*);

    ((sipVH_QtGui_5)(sipModuleAPI_librviz_sip_QtGui->em_virthandlers[5]))(sipGILState, sipModuleAPI_librviz_sip_QtCore->em_virterrorhandlers[0], sipPySelf, sipMeth, a0);
}

void siprviz_PanelDockWidget::showEvent(QShowEvent*a0)
{
    sip_gilstate_t sipGILState;
    PyObject *sipMeth;

    sipMeth = sipIsPyMethod(&sipGILState,&sipPyMethods[15],sipPySelf,NULL,sipName_showEvent);

    if (!sipMeth)
    {
        rviz::PanelDockWidget::showEvent(a0);
        return;
    }

    typedef void (*sipVH_QtGui_6)(sip_gilstate_t, sipVirtErrorHandlerFunc, sipSimpleWrapper *, PyObject *, QShowEvent*);

    ((sipVH_QtGui_6)(sipModuleAPI_librviz_sip_QtGui->em_virthandlers[6]))(sipGILState, sipModuleAPI_librviz_sip_QtCore->em_virterrorhandlers[0], sipPySelf, sipMeth, a0);
}

void siprviz_PanelDockWidget::dropEvent(QDropEvent*a0)
{
    sip_gilstate_t sipGILState;
    PyObject *sipMeth;

    sipMeth = sipIsPyMethod(&sipGILState,&sipPyMethods[16],sipPySelf,NULL,sipName_dropEvent);

    if (!sipMeth)
    {
        rviz::PanelDockWidget::dropEvent(a0);
        return;
    }

    typedef void (*sipVH_QtWidgets_8)(sip_gilstate_t, sipVirtErrorHandlerFunc, sipSimpleWrapper *, PyObject *, QDropEvent*);

    ((sipVH_QtWidgets_8)(sipModuleAPI_librviz_sip_QtWidgets->em_virthandlers[8]))(sipGILState, sipModuleAPI_librviz_sip_QtCore->em_virterrorhandlers[0], sipPySelf, sipMeth, a0);
}

void siprviz_PanelDockWidget::dragLeaveEvent(QDragLeaveEvent*a0)
{
    sip_gilstate_t sipGILState;
    PyObject *sipMeth;

    sipMeth = sipIsPyMethod(&sipGILState,&sipPyMethods[17],sipPySelf,NULL,sipName_dragLeaveEvent);

    if (!sipMeth)
    {
        rviz::PanelDockWidget::dragLeaveEvent(a0);
        return;
    }

    typedef void (*sipVH_QtWidgets_9)(sip_gilstate_t, sipVirtErrorHandlerFunc, sipSimpleWrapper *, PyObject *, QDragLeaveEvent*);

    ((sipVH_QtWidgets_9)(sipModuleAPI_librviz_sip_QtWidgets->em_virthandlers[9]))(sipGILState, sipModuleAPI_librviz_sip_QtCore->em_virterrorhandlers[0], sipPySelf, sipMeth, a0);
}

void siprviz_PanelDockWidget::dragMoveEvent(QDragMoveEvent*a0)
{
    sip_gilstate_t sipGILState;
    PyObject *sipMeth;

    sipMeth = sipIsPyMethod(&sipGILState,&sipPyMethods[18],sipPySelf,NULL,sipName_dragMoveEvent);

    if (!sipMeth)
    {
        rviz::PanelDockWidget::dragMoveEvent(a0);
        return;
    }

    typedef void (*sipVH_QtWidgets_10)(sip_gilstate_t, sipVirtErrorHandlerFunc, sipSimpleWrapper *, PyObject *, QDragMoveEvent*);

    ((sipVH_QtWidgets_10)(sipModuleAPI_librviz_sip_QtWidgets->em_virthandlers[10]))(sipGILState, sipModuleAPI_librviz_sip_QtCore->em_virterrorhandlers[0], sipPySelf, sipMeth, a0);
}

void siprviz_PanelDockWidget::dragEnterEvent(QDragEnterEvent*a0)
{
    sip_gilstate_t sipGILState;
    PyObject *sipMeth;

    sipMeth = sipIsPyMethod(&sipGILState,&sipPyMethods[19],sipPySelf,NULL,sipName_dragEnterEvent);

    if (!sipMeth)
    {
        rviz::PanelDockWidget::dragEnterEvent(a0);
        return;
    }

    typedef void (*sipVH_QtWidgets_11)(sip_gilstate_t, sipVirtErrorHandlerFunc, sipSimpleWrapper *, PyObject *, QDragEnterEvent*);

    ((sipVH_QtWidgets_11)(sipModuleAPI_librviz_sip_QtWidgets->em_virthandlers[11]))(sipGILState, sipModuleAPI_librviz_sip_QtCore->em_virterrorhandlers[0], sipPySelf, sipMeth, a0);
}

void siprviz_PanelDockWidget::actionEvent(QActionEvent*a0)
{
    sip_gilstate_t sipGILState;
    PyObject *sipMeth;

    sipMeth = sipIsPyMethod(&sipGILState,&sipPyMethods[20],sipPySelf,NULL,sipName_actionEvent);

    if (!sipMeth)
    {
        rviz::PanelDockWidget::actionEvent(a0);
        return;
    }

    typedef void (*sipVH_QtWidgets_12)(sip_gilstate_t, sipVirtErrorHandlerFunc, sipSimpleWrapper *, PyObject *, QActionEvent*);

    ((sipVH_QtWidgets_12)(sipModuleAPI_librviz_sip_QtWidgets->em_virthandlers[12]))(sipGILState, sipModuleAPI_librviz_sip_QtCore->em_virterrorhandlers[0], sipPySelf, sipMeth, a0);
}

void siprviz_PanelDockWidget::tabletEvent(QTabletEvent*a0)
{
    sip_gilstate_t sipGILState;
    PyObject *sipMeth;

    sipMeth = sipIsPyMethod(&sipGILState,&sipPyMethods[21],sipPySelf,NULL,sipName_tabletEvent);

    if (!sipMeth)
    {
        rviz::PanelDockWidget::tabletEvent(a0);
        return;
    }

    typedef void (*sipVH_QtGui_0)(sip_gilstate_t, sipVirtErrorHandlerFunc, sipSimpleWrapper *, PyObject *, QTabletEvent*);

    ((sipVH_QtGui_0)(sipModuleAPI_librviz_sip_QtGui->em_virthandlers[0]))(sipGILState, sipModuleAPI_librviz_sip_QtCore->em_virterrorhandlers[0], sipPySelf, sipMeth, a0);
}

void siprviz_PanelDockWidget::contextMenuEvent(QContextMenuEvent*a0)
{
    sip_gilstate_t sipGILState;
    PyObject *sipMeth;

    sipMeth = sipIsPyMethod(&sipGILState,&sipPyMethods[22],sipPySelf,NULL,sipName_contextMenuEvent);

    if (!sipMeth)
    {
        rviz::PanelDockWidget::contextMenuEvent(a0);
        return;
    }

    typedef void (*sipVH_QtWidgets_13)(sip_gilstate_t, sipVirtErrorHandlerFunc, sipSimpleWrapper *, PyObject *, QContextMenuEvent*);

    ((sipVH_QtWidgets_13)(sipModuleAPI_librviz_sip_QtWidgets->em_virthandlers[13]))(sipGILState, sipModuleAPI_librviz_sip_QtCore->em_virterrorhandlers[0], sipPySelf, sipMeth, a0);
}

void siprviz_PanelDockWidget::resizeEvent(QResizeEvent*a0)
{
    sip_gilstate_t sipGILState;
    PyObject *sipMeth;

    sipMeth = sipIsPyMethod(&sipGILState,&sipPyMethods[23],sipPySelf,NULL,sipName_resizeEvent);

    if (!sipMeth)
    {
        rviz::PanelDockWidget::resizeEvent(a0);
        return;
    }

    typedef void (*sipVH_QtGui_9)(sip_gilstate_t, sipVirtErrorHandlerFunc, sipSimpleWrapper *, PyObject *, QResizeEvent*);

    ((sipVH_QtGui_9)(sipModuleAPI_librviz_sip_QtGui->em_virthandlers[9]))(sipGILState, sipModuleAPI_librviz_sip_QtCore->em_virterrorhandlers[0], sipPySelf, sipMeth, a0);
}

void siprviz_PanelDockWidget::moveEvent(QMoveEvent*a0)
{
    sip_gilstate_t sipGILState;
    PyObject *sipMeth;

    sipMeth = sipIsPyMethod(&sipGILState,&sipPyMethods[24],sipPySelf,NULL,sipName_moveEvent);

    if (!sipMeth)
    {
        rviz::PanelDockWidget::moveEvent(a0);
        return;
    }

    typedef void (*sipVH_QtGui_8)(sip_gilstate_t, sipVirtErrorHandlerFunc, sipSimpleWrapper *, PyObject *, QMoveEvent*);

    ((sipVH_QtGui_8)(sipModuleAPI_librviz_sip_QtGui->em_virthandlers[8]))(sipGILState, sipModuleAPI_librviz_sip_QtCore->em_virterrorhandlers[0], sipPySelf, sipMeth, a0);
}

void siprviz_PanelDockWidget::leaveEvent(QEvent*a0)
{
    sip_gilstate_t sipGILState;
    PyObject *sipMeth;

    sipMeth = sipIsPyMethod(&sipGILState,&sipPyMethods[25],sipPySelf,NULL,sipName_leaveEvent);

    if (!sipMeth)
    {
        rviz::PanelDockWidget::leaveEvent(a0);
        return;
    }

    typedef void (*sipVH_QtCore_25)(sip_gilstate_t, sipVirtErrorHandlerFunc, sipSimpleWrapper *, PyObject *, QEvent*);

    ((sipVH_QtCore_25)(sipModuleAPI_librviz_sip_QtCore->em_virthandlers[25]))(sipGILState, sipModuleAPI_librviz_sip_QtCore->em_virterrorhandlers[0], sipPySelf, sipMeth, a0);
}

void siprviz_PanelDockWidget::enterEvent(QEvent*a0)
{
    sip_gilstate_t sipGILState;
    PyObject *sipMeth;

    sipMeth = sipIsPyMethod(&sipGILState,&sipPyMethods[26],sipPySelf,NULL,sipName_enterEvent);

    if (!sipMeth)
    {
        rviz::PanelDockWidget::enterEvent(a0);
        return;
    }

    typedef void (*sipVH_QtCore_25)(sip_gilstate_t, sipVirtErrorHandlerFunc, sipSimpleWrapper *, PyObject *, QEvent*);

    ((sipVH_QtCore_25)(sipModuleAPI_librviz_sip_QtCore->em_virthandlers[25]))(sipGILState, sipModuleAPI_librviz_sip_QtCore->em_virterrorhandlers[0], sipPySelf, sipMeth, a0);
}

void siprviz_PanelDockWidget::focusOutEvent(QFocusEvent*a0)
{
    sip_gilstate_t sipGILState;
    PyObject *sipMeth;

    sipMeth = sipIsPyMethod(&sipGILState,&sipPyMethods[27],sipPySelf,NULL,sipName_focusOutEvent);

    if (!sipMeth)
    {
        rviz::PanelDockWidget::focusOutEvent(a0);
        return;
    }

    typedef void (*sipVH_QtGui_7)(sip_gilstate_t, sipVirtErrorHandlerFunc, sipSimpleWrapper *, PyObject *, QFocusEvent*);

    ((sipVH_QtGui_7)(sipModuleAPI_librviz_sip_QtGui->em_virthandlers[7]))(sipGILState, sipModuleAPI_librviz_sip_QtCore->em_virterrorhandlers[0], sipPySelf, sipMeth, a0);
}

void siprviz_PanelDockWidget::focusInEvent(QFocusEvent*a0)
{
    sip_gilstate_t sipGILState;
    PyObject *sipMeth;

    sipMeth = sipIsPyMethod(&sipGILState,&sipPyMethods[28],sipPySelf,NULL,sipName_focusInEvent);

    if (!sipMeth)
    {
        rviz::PanelDockWidget::focusInEvent(a0);
        return;
    }

    typedef void (*sipVH_QtGui_7)(sip_gilstate_t, sipVirtErrorHandlerFunc, sipSimpleWrapper *, PyObject *, QFocusEvent*);

    ((sipVH_QtGui_7)(sipModuleAPI_librviz_sip_QtGui->em_virthandlers[7]))(sipGILState, sipModuleAPI_librviz_sip_QtCore->em_virterrorhandlers[0], sipPySelf, sipMeth, a0);
}

void siprviz_PanelDockWidget::keyReleaseEvent(QKeyEvent*a0)
{
    sip_gilstate_t sipGILState;
    PyObject *sipMeth;

    sipMeth = sipIsPyMethod(&sipGILState,&sipPyMethods[29],sipPySelf,NULL,sipName_keyReleaseEvent);

    if (!sipMeth)
    {
        rviz::PanelDockWidget::keyReleaseEvent(a0);
        return;
    }

    typedef void (*sipVH_QtGui_4)(sip_gilstate_t, sipVirtErrorHandlerFunc, sipSimpleWrapper *, PyObject *, QKeyEvent*);

    ((sipVH_QtGui_4)(sipModuleAPI_librviz_sip_QtGui->em_virthandlers[4]))(sipGILState, sipModuleAPI_librviz_sip_QtCore->em_virterrorhandlers[0], sipPySelf, sipMeth, a0);
}

void siprviz_PanelDockWidget::keyPressEvent(QKeyEvent*a0)
{
    sip_gilstate_t sipGILState;
    PyObject *sipMeth;

    sipMeth = sipIsPyMethod(&sipGILState,&sipPyMethods[30],sipPySelf,NULL,sipName_keyPressEvent);

    if (!sipMeth)
    {
        rviz::PanelDockWidget::keyPressEvent(a0);
        return;
    }

    typedef void (*sipVH_QtGui_4)(sip_gilstate_t, sipVirtErrorHandlerFunc, sipSimpleWrapper *, PyObject *, QKeyEvent*);

    ((sipVH_QtGui_4)(sipModuleAPI_librviz_sip_QtGui->em_virthandlers[4]))(sipGILState, sipModuleAPI_librviz_sip_QtCore->em_virterrorhandlers[0], sipPySelf, sipMeth, a0);
}

void siprviz_PanelDockWidget::wheelEvent(QWheelEvent*a0)
{
    sip_gilstate_t sipGILState;
    PyObject *sipMeth;

    sipMeth = sipIsPyMethod(&sipGILState,&sipPyMethods[31],sipPySelf,NULL,sipName_wheelEvent);

    if (!sipMeth)
    {
        rviz::PanelDockWidget::wheelEvent(a0);
        return;
    }

    typedef void (*sipVH_QtGui_2)(sip_gilstate_t, sipVirtErrorHandlerFunc, sipSimpleWrapper *, PyObject *, QWheelEvent*);

    ((sipVH_QtGui_2)(sipModuleAPI_librviz_sip_QtGui->em_virthandlers[2]))(sipGILState, sipModuleAPI_librviz_sip_QtCore->em_virterrorhandlers[0], sipPySelf, sipMeth, a0);
}

void siprviz_PanelDockWidget::mouseMoveEvent(QMouseEvent*a0)
{
    sip_gilstate_t sipGILState;
    PyObject *sipMeth;

    sipMeth = sipIsPyMethod(&sipGILState,&sipPyMethods[32],sipPySelf,NULL,sipName_mouseMoveEvent);

    if (!sipMeth)
    {
        rviz::PanelDockWidget::mouseMoveEvent(a0);
        return;
    }

    typedef void (*sipVH_QtGui_3)(sip_gilstate_t, sipVirtErrorHandlerFunc, sipSimpleWrapper *, PyObject *, QMouseEvent*);

    ((sipVH_QtGui_3)(sipModuleAPI_librviz_sip_QtGui->em_virthandlers[3]))(sipGILState, sipModuleAPI_librviz_sip_QtCore->em_virterrorhandlers[0], sipPySelf, sipMeth, a0);
}

void siprviz_PanelDockWidget::mouseDoubleClickEvent(QMouseEvent*a0)
{
    sip_gilstate_t sipGILState;
    PyObject *sipMeth;

    sipMeth = sipIsPyMethod(&sipGILState,&sipPyMethods[33],sipPySelf,NULL,sipName_mouseDoubleClickEvent);

    if (!sipMeth)
    {
        rviz::PanelDockWidget::mouseDoubleClickEvent(a0);
        return;
    }

    typedef void (*sipVH_QtGui_3)(sip_gilstate_t, sipVirtErrorHandlerFunc, sipSimpleWrapper *, PyObject *, QMouseEvent*);

    ((sipVH_QtGui_3)(sipModuleAPI_librviz_sip_QtGui->em_virthandlers[3]))(sipGILState, sipModuleAPI_librviz_sip_QtCore->em_virterrorhandlers[0], sipPySelf, sipMeth, a0);
}

void siprviz_PanelDockWidget::mouseReleaseEvent(QMouseEvent*a0)
{
    sip_gilstate_t sipGILState;
    PyObject *sipMeth;

    sipMeth = sipIsPyMethod(&sipGILState,&sipPyMethods[34],sipPySelf,NULL,sipName_mouseReleaseEvent);

    if (!sipMeth)
    {
        rviz::PanelDockWidget::mouseReleaseEvent(a0);
        return;
    }

    typedef void (*sipVH_QtGui_3)(sip_gilstate_t, sipVirtErrorHandlerFunc, sipSimpleWrapper *, PyObject *, QMouseEvent*);

    ((sipVH_QtGui_3)(sipModuleAPI_librviz_sip_QtGui->em_virthandlers[3]))(sipGILState, sipModuleAPI_librviz_sip_QtCore->em_virterrorhandlers[0], sipPySelf, sipMeth, a0);
}

void siprviz_PanelDockWidget::mousePressEvent(QMouseEvent*a0)
{
    sip_gilstate_t sipGILState;
    PyObject *sipMeth;

    sipMeth = sipIsPyMethod(&sipGILState,&sipPyMethods[35],sipPySelf,NULL,sipName_mousePressEvent);

    if (!sipMeth)
    {
        rviz::PanelDockWidget::mousePressEvent(a0);
        return;
    }

    typedef void (*sipVH_QtGui_3)(sip_gilstate_t, sipVirtErrorHandlerFunc, sipSimpleWrapper *, PyObject *, QMouseEvent*);

    ((sipVH_QtGui_3)(sipModuleAPI_librviz_sip_QtGui->em_virthandlers[3]))(sipGILState, sipModuleAPI_librviz_sip_QtCore->em_virterrorhandlers[0], sipPySelf, sipMeth, a0);
}

QPaintEngine* siprviz_PanelDockWidget::paintEngine() const
{
    sip_gilstate_t sipGILState;
    PyObject *sipMeth;

    sipMeth = sipIsPyMethod(&sipGILState,const_cast<char *>(&sipPyMethods[36]),sipPySelf,NULL,sipName_paintEngine);

    if (!sipMeth)
        return rviz::PanelDockWidget::paintEngine();

    typedef QPaintEngine* (*sipVH_QtGui_29)(sip_gilstate_t, sipVirtErrorHandlerFunc, sipSimpleWrapper *, PyObject *);

    return ((sipVH_QtGui_29)(sipModuleAPI_librviz_sip_QtGui->em_virthandlers[29]))(sipGILState, sipModuleAPI_librviz_sip_QtCore->em_virterrorhandlers[0], sipPySelf, sipMeth);
}

int siprviz_PanelDockWidget::heightForWidth(int a0) const
{
    sip_gilstate_t sipGILState;
    PyObject *sipMeth;

    sipMeth = sipIsPyMethod(&sipGILState,const_cast<char *>(&sipPyMethods[37]),sipPySelf,NULL,sipName_heightForWidth);

    if (!sipMeth)
        return rviz::PanelDockWidget::heightForWidth(a0);

    typedef int (*sipVH_QtCore_61)(sip_gilstate_t, sipVirtErrorHandlerFunc, sipSimpleWrapper *, PyObject *, int);

    return ((sipVH_QtCore_61)(sipModuleAPI_librviz_sip_QtCore->em_virthandlers[61]))(sipGILState, sipModuleAPI_librviz_sip_QtCore->em_virterrorhandlers[0], sipPySelf, sipMeth, a0);
}

QSize siprviz_PanelDockWidget::minimumSizeHint() const
{
    sip_gilstate_t sipGILState;
    PyObject *sipMeth;

    sipMeth = sipIsPyMethod(&sipGILState,const_cast<char *>(&sipPyMethods[38]),sipPySelf,NULL,sipName_minimumSizeHint);

    if (!sipMeth)
        return rviz::PanelDockWidget::minimumSizeHint();

    typedef QSize (*sipVH_QtGui_12)(sip_gilstate_t, sipVirtErrorHandlerFunc, sipSimpleWrapper *, PyObject *);

    return ((sipVH_QtGui_12)(sipModuleAPI_librviz_sip_QtGui->em_virthandlers[12]))(sipGILState, sipModuleAPI_librviz_sip_QtCore->em_virterrorhandlers[0], sipPySelf, sipMeth);
}

QSize siprviz_PanelDockWidget::sizeHint() const
{
    sip_gilstate_t sipGILState;
    PyObject *sipMeth;

    sipMeth = sipIsPyMethod(&sipGILState,const_cast<char *>(&sipPyMethods[39]),sipPySelf,NULL,sipName_sizeHint);

    if (!sipMeth)
        return rviz::PanelDockWidget::sizeHint();

    typedef QSize (*sipVH_QtGui_12)(sip_gilstate_t, sipVirtErrorHandlerFunc, sipSimpleWrapper *, PyObject *);

    return ((sipVH_QtGui_12)(sipModuleAPI_librviz_sip_QtGui->em_virthandlers[12]))(sipGILState, sipModuleAPI_librviz_sip_QtCore->em_virterrorhandlers[0], sipPySelf, sipMeth);
}

void siprviz_PanelDockWidget::setVisible(bool a0)
{
    sip_gilstate_t sipGILState;
    PyObject *sipMeth;

    sipMeth = sipIsPyMethod(&sipGILState,&sipPyMethods[40],sipPySelf,NULL,sipName_setVisible);

    if (!sipMeth)
    {
        rviz::PanelDockWidget::setVisible(a0);
        return;
    }

    typedef void (*sipVH_QtWidgets_0)(sip_gilstate_t, sipVirtErrorHandlerFunc, sipSimpleWrapper *, PyObject *, bool);

    ((sipVH_QtWidgets_0)(sipModuleAPI_librviz_sip_QtWidgets->em_virthandlers[0]))(sipGILState, sipModuleAPI_librviz_sip_QtCore->em_virterrorhandlers[0], sipPySelf, sipMeth, a0);
}

int siprviz_PanelDockWidget::devType() const
{
    sip_gilstate_t sipGILState;
    PyObject *sipMeth;

    sipMeth = sipIsPyMethod(&sipGILState,const_cast<char *>(&sipPyMethods[41]),sipPySelf,NULL,sipName_devType);

    if (!sipMeth)
        return rviz::PanelDockWidget::devType();

    typedef int (*sipVH_QtCore_6)(sip_gilstate_t, sipVirtErrorHandlerFunc, sipSimpleWrapper *, PyObject *);

    return ((sipVH_QtCore_6)(sipModuleAPI_librviz_sip_QtCore->em_virthandlers[6]))(sipGILState, sipModuleAPI_librviz_sip_QtCore->em_virterrorhandlers[0], sipPySelf, sipMeth);
}

bool siprviz_PanelDockWidget::event(QEvent*a0)
{
    sip_gilstate_t sipGILState;
    PyObject *sipMeth;

    sipMeth = sipIsPyMethod(&sipGILState,&sipPyMethods[42],sipPySelf,NULL,sipName_event);

    if (!sipMeth)
        return rviz::PanelDockWidget::event(a0);

    typedef bool (*sipVH_QtCore_5)(sip_gilstate_t, sipVirtErrorHandlerFunc, sipSimpleWrapper *, PyObject *, QEvent*);

    return ((sipVH_QtCore_5)(sipModuleAPI_librviz_sip_QtCore->em_virthandlers[5]))(sipGILState, sipModuleAPI_librviz_sip_QtCore->em_virterrorhandlers[0], sipPySelf, sipMeth, a0);
}

void siprviz_PanelDockWidget::paintEvent(QPaintEvent*a0)
{
    sip_gilstate_t sipGILState;
    PyObject *sipMeth;

    sipMeth = sipIsPyMethod(&sipGILState,&sipPyMethods[43],sipPySelf,NULL,sipName_paintEvent);

    if (!sipMeth)
    {
        rviz::PanelDockWidget::paintEvent(a0);
        return;
    }

    typedef void (*sipVH_QtGui_52)(sip_gilstate_t, sipVirtErrorHandlerFunc, sipSimpleWrapper *, PyObject *, QPaintEvent*);

    ((sipVH_QtGui_52)(sipModuleAPI_librviz_sip_QtGui->em_virthandlers[52]))(sipGILState, sipModuleAPI_librviz_sip_QtCore->em_virterrorhandlers[0], sipPySelf, sipMeth, a0);
}

void siprviz_PanelDockWidget::closeEvent(QCloseEvent*a0)
{
    sip_gilstate_t sipGILState;
    PyObject *sipMeth;

    sipMeth = sipIsPyMethod(&sipGILState,&sipPyMethods[44],sipPySelf,NULL,sipName_closeEvent);

    if (!sipMeth)
    {
        rviz::PanelDockWidget::closeEvent(a0);
        return;
    }

    typedef void (*sipVH_QtWidgets_14)(sip_gilstate_t, sipVirtErrorHandlerFunc, sipSimpleWrapper *, PyObject *, QCloseEvent*);

    ((sipVH_QtWidgets_14)(sipModuleAPI_librviz_sip_QtWidgets->em_virthandlers[14]))(sipGILState, sipModuleAPI_librviz_sip_QtCore->em_virterrorhandlers[0], sipPySelf, sipMeth, a0);
}

void siprviz_PanelDockWidget::changeEvent(QEvent*a0)
{
    sip_gilstate_t sipGILState;
    PyObject *sipMeth;

    sipMeth = sipIsPyMethod(&sipGILState,&sipPyMethods[45],sipPySelf,NULL,sipName_changeEvent);

    if (!sipMeth)
    {
        rviz::PanelDockWidget::changeEvent(a0);
        return;
    }

    typedef void (*sipVH_QtCore_25)(sip_gilstate_t, sipVirtErrorHandlerFunc, sipSimpleWrapper *, PyObject *, QEvent*);

    ((sipVH_QtCore_25)(sipModuleAPI_librviz_sip_QtCore->em_virthandlers[25]))(sipGILState, sipModuleAPI_librviz_sip_QtCore->em_virterrorhandlers[0], sipPySelf, sipMeth, a0);
}

QObject* siprviz_PanelDockWidget::sipProtect_sender() const
{
    return QObject::sender();
}

int siprviz_PanelDockWidget::sipProtect_receivers(const char*a0) const
{
    return QObject::receivers(a0);
}

void siprviz_PanelDockWidget::sipProtectVirt_timerEvent(bool sipSelfWasArg,QTimerEvent*a0)
{
    (sipSelfWasArg ? QObject::timerEvent(a0) : timerEvent(a0));
}

void siprviz_PanelDockWidget::sipProtectVirt_childEvent(bool sipSelfWasArg,QChildEvent*a0)
{
    (sipSelfWasArg ? QObject::childEvent(a0) : childEvent(a0));
}

void siprviz_PanelDockWidget::sipProtectVirt_customEvent(bool sipSelfWasArg,QEvent*a0)
{
    (sipSelfWasArg ? QObject::customEvent(a0) : customEvent(a0));
}

void siprviz_PanelDockWidget::sipProtectVirt_connectNotify(bool sipSelfWasArg,const QMetaMethod& a0)
{
    (sipSelfWasArg ? QObject::connectNotify(a0) : connectNotify(a0));
}

void siprviz_PanelDockWidget::sipProtectVirt_disconnectNotify(bool sipSelfWasArg,const QMetaMethod& a0)
{
    (sipSelfWasArg ? QObject::disconnectNotify(a0) : disconnectNotify(a0));
}

int siprviz_PanelDockWidget::sipProtect_senderSignalIndex() const
{
    return QObject::senderSignalIndex();
}

bool siprviz_PanelDockWidget::sipProtect_isSignalConnected(const QMetaMethod& a0) const
{
    return QObject::isSignalConnected(a0);
}

void siprviz_PanelDockWidget::sipProtectVirt_mousePressEvent(bool sipSelfWasArg,QMouseEvent*a0)
{
    (sipSelfWasArg ? QWidget::mousePressEvent(a0) : mousePressEvent(a0));
}

void siprviz_PanelDockWidget::sipProtectVirt_mouseReleaseEvent(bool sipSelfWasArg,QMouseEvent*a0)
{
    (sipSelfWasArg ? QWidget::mouseReleaseEvent(a0) : mouseReleaseEvent(a0));
}

void siprviz_PanelDockWidget::sipProtectVirt_mouseDoubleClickEvent(bool sipSelfWasArg,QMouseEvent*a0)
{
    (sipSelfWasArg ? QWidget::mouseDoubleClickEvent(a0) : mouseDoubleClickEvent(a0));
}

void siprviz_PanelDockWidget::sipProtectVirt_mouseMoveEvent(bool sipSelfWasArg,QMouseEvent*a0)
{
    (sipSelfWasArg ? QWidget::mouseMoveEvent(a0) : mouseMoveEvent(a0));
}

void siprviz_PanelDockWidget::sipProtectVirt_wheelEvent(bool sipSelfWasArg,QWheelEvent*a0)
{
    (sipSelfWasArg ? QWidget::wheelEvent(a0) : wheelEvent(a0));
}

void siprviz_PanelDockWidget::sipProtectVirt_keyPressEvent(bool sipSelfWasArg,QKeyEvent*a0)
{
    (sipSelfWasArg ? QWidget::keyPressEvent(a0) : keyPressEvent(a0));
}

void siprviz_PanelDockWidget::sipProtectVirt_keyReleaseEvent(bool sipSelfWasArg,QKeyEvent*a0)
{
    (sipSelfWasArg ? QWidget::keyReleaseEvent(a0) : keyReleaseEvent(a0));
}

void siprviz_PanelDockWidget::sipProtectVirt_focusInEvent(bool sipSelfWasArg,QFocusEvent*a0)
{
    (sipSelfWasArg ? QWidget::focusInEvent(a0) : focusInEvent(a0));
}

void siprviz_PanelDockWidget::sipProtectVirt_focusOutEvent(bool sipSelfWasArg,QFocusEvent*a0)
{
    (sipSelfWasArg ? QWidget::focusOutEvent(a0) : focusOutEvent(a0));
}

void siprviz_PanelDockWidget::sipProtectVirt_enterEvent(bool sipSelfWasArg,QEvent*a0)
{
    (sipSelfWasArg ? QWidget::enterEvent(a0) : enterEvent(a0));
}

void siprviz_PanelDockWidget::sipProtectVirt_leaveEvent(bool sipSelfWasArg,QEvent*a0)
{
    (sipSelfWasArg ? QWidget::leaveEvent(a0) : leaveEvent(a0));
}

void siprviz_PanelDockWidget::sipProtectVirt_moveEvent(bool sipSelfWasArg,QMoveEvent*a0)
{
    (sipSelfWasArg ? QWidget::moveEvent(a0) : moveEvent(a0));
}

void siprviz_PanelDockWidget::sipProtectVirt_resizeEvent(bool sipSelfWasArg,QResizeEvent*a0)
{
    (sipSelfWasArg ? QWidget::resizeEvent(a0) : resizeEvent(a0));
}

void siprviz_PanelDockWidget::sipProtectVirt_contextMenuEvent(bool sipSelfWasArg,QContextMenuEvent*a0)
{
    (sipSelfWasArg ? QWidget::contextMenuEvent(a0) : contextMenuEvent(a0));
}

void siprviz_PanelDockWidget::sipProtectVirt_tabletEvent(bool sipSelfWasArg,QTabletEvent*a0)
{
    (sipSelfWasArg ? QWidget::tabletEvent(a0) : tabletEvent(a0));
}

void siprviz_PanelDockWidget::sipProtectVirt_actionEvent(bool sipSelfWasArg,QActionEvent*a0)
{
    (sipSelfWasArg ? QWidget::actionEvent(a0) : actionEvent(a0));
}

void siprviz_PanelDockWidget::sipProtectVirt_dragEnterEvent(bool sipSelfWasArg,QDragEnterEvent*a0)
{
    (sipSelfWasArg ? QWidget::dragEnterEvent(a0) : dragEnterEvent(a0));
}

void siprviz_PanelDockWidget::sipProtectVirt_dragMoveEvent(bool sipSelfWasArg,QDragMoveEvent*a0)
{
    (sipSelfWasArg ? QWidget::dragMoveEvent(a0) : dragMoveEvent(a0));
}

void siprviz_PanelDockWidget::sipProtectVirt_dragLeaveEvent(bool sipSelfWasArg,QDragLeaveEvent*a0)
{
    (sipSelfWasArg ? QWidget::dragLeaveEvent(a0) : dragLeaveEvent(a0));
}

void siprviz_PanelDockWidget::sipProtectVirt_dropEvent(bool sipSelfWasArg,QDropEvent*a0)
{
    (sipSelfWasArg ? QWidget::dropEvent(a0) : dropEvent(a0));
}

void siprviz_PanelDockWidget::sipProtectVirt_showEvent(bool sipSelfWasArg,QShowEvent*a0)
{
    (sipSelfWasArg ? QWidget::showEvent(a0) : showEvent(a0));
}

void siprviz_PanelDockWidget::sipProtectVirt_hideEvent(bool sipSelfWasArg,QHideEvent*a0)
{
    (sipSelfWasArg ? QWidget::hideEvent(a0) : hideEvent(a0));
}

int siprviz_PanelDockWidget::sipProtectVirt_metric(bool sipSelfWasArg,QPaintDevice::PaintDeviceMetric a0) const
{
    return (sipSelfWasArg ? QWidget::metric(a0) : metric(a0));
}

void siprviz_PanelDockWidget::sipProtectVirt_inputMethodEvent(bool sipSelfWasArg,QInputMethodEvent*a0)
{
    (sipSelfWasArg ? QWidget::inputMethodEvent(a0) : inputMethodEvent(a0));
}

void siprviz_PanelDockWidget::sipProtect_updateMicroFocus()
{
    QWidget::updateMicroFocus();
}

void siprviz_PanelDockWidget::sipProtect_create(WId a0,bool a1,bool a2)
{
    QWidget::create(a0,a1,a2);
}

void siprviz_PanelDockWidget::sipProtect_destroy(bool a0,bool a1)
{
    QWidget::destroy(a0,a1);
}

bool siprviz_PanelDockWidget::sipProtectVirt_focusNextPrevChild(bool sipSelfWasArg,bool a0)
{
    return (sipSelfWasArg ? QWidget::focusNextPrevChild(a0) : focusNextPrevChild(a0));
}

bool siprviz_PanelDockWidget::sipProtect_focusNextChild()
{
    return QWidget::focusNextChild();
}

bool siprviz_PanelDockWidget::sipProtect_focusPreviousChild()
{
    return QWidget::focusPreviousChild();
}

bool siprviz_PanelDockWidget::sipProtectVirt_nativeEvent(bool sipSelfWasArg,const QByteArray& a0,void*a1,long*a2)
{
    return (sipSelfWasArg ? QWidget::nativeEvent(a0,a1,a2) : nativeEvent(a0,a1,a2));
}

QPainter* siprviz_PanelDockWidget::sipProtectVirt_sharedPainter(bool sipSelfWasArg) const
{
    return (sipSelfWasArg ? QWidget::sharedPainter() : sharedPainter());
}

void siprviz_PanelDockWidget::sipProtectVirt_initPainter(bool sipSelfWasArg,QPainter*a0) const
{
    (sipSelfWasArg ? QWidget::initPainter(a0) : initPainter(a0));
}

void siprviz_PanelDockWidget::sipProtect_initStyleOption(QStyleOptionDockWidget*a0) const
{
    QDockWidget::initStyleOption(a0);
}

void siprviz_PanelDockWidget::sipProtectVirt_changeEvent(bool sipSelfWasArg,QEvent*a0)
{
    (sipSelfWasArg ? QDockWidget::changeEvent(a0) : changeEvent(a0));
}

void siprviz_PanelDockWidget::sipProtectVirt_closeEvent(bool sipSelfWasArg,QCloseEvent*a0)
{
    (sipSelfWasArg ? QDockWidget::closeEvent(a0) : closeEvent(a0));
}

void siprviz_PanelDockWidget::sipProtectVirt_paintEvent(bool sipSelfWasArg,QPaintEvent*a0)
{
    (sipSelfWasArg ? QDockWidget::paintEvent(a0) : paintEvent(a0));
}

bool siprviz_PanelDockWidget::sipProtectVirt_event(bool sipSelfWasArg,QEvent*a0)
{
    return (sipSelfWasArg ? QDockWidget::event(a0) : event(a0));
}


extern "C" {static PyObject *meth_rviz_PanelDockWidget_sender(PyObject *, PyObject *, PyObject *);}
static PyObject *meth_rviz_PanelDockWidget_sender(PyObject *sipSelf, PyObject *sipArgs, PyObject *sipKwds)
{
    PyObject *sipParseErr = NULL;

    {
        const siprviz_PanelDockWidget *sipCpp;

        if (sipParseKwdArgs(&sipParseErr, sipArgs, sipKwds, NULL, NULL, "B", &sipSelf, sipType_rviz_PanelDockWidget, &sipCpp))
        {
            QObject*sipRes = 0;

#line 550 "/usr/share/sip/PyQt5/QtCore/qobject.sip"
        // sender() must be called without the GIL to avoid possible deadlocks between
        // the GIL and Qt's internal thread data mutex.
        
        Py_BEGIN_ALLOW_THREADS
        
        #if defined(SIP_PROTECTED_IS_PUBLIC)
        sipRes = sipCpp->sender();
        #else
        sipRes = sipCpp->sipProtect_sender();
        #endif
        
        Py_END_ALLOW_THREADS
        
        if (!sipRes)
        {
            typedef QObject *(*qtcore_qobject_sender_t)();
        
            static qtcore_qobject_sender_t qtcore_qobject_sender = 0;
        
            if (!qtcore_qobject_sender)
                qtcore_qobject_sender = (qtcore_qobject_sender_t)sipImportSymbol("qtcore_qobject_sender");
        
            if (qtcore_qobject_sender)
                sipRes = qtcore_qobject_sender();
        }
#line 1445 "/home/lassegoncz/catkin_ws/devel/bin/sip/rviz_sip/siplibrviz_siprvizPanelDockWidget.cpp"

            return sipConvertFromType(sipRes,sipType_QObject,NULL);
        }
    }

    /* Raise an exception if the arguments couldn't be parsed. */
    sipNoMethod(sipParseErr, sipName_PanelDockWidget, sipName_sender, NULL);

    return NULL;
}


extern "C" {static PyObject *meth_rviz_PanelDockWidget_receivers(PyObject *, PyObject *, PyObject *);}
static PyObject *meth_rviz_PanelDockWidget_receivers(PyObject *sipSelf, PyObject *sipArgs, PyObject *sipKwds)
{
    PyObject *sipParseErr = NULL;

    {
        PyObject * a0;
        const siprviz_PanelDockWidget *sipCpp;

        if (sipParseKwdArgs(&sipParseErr, sipArgs, sipKwds, NULL, NULL, "BP0", &sipSelf, sipType_rviz_PanelDockWidget, &sipCpp, &a0))
        {
            int sipRes = 0;
            sipErrorState sipError = sipErrorNone;

#line 579 "/usr/share/sip/PyQt5/QtCore/qobject.sip"
        // We need to handle the signal object.  Import the helper if it hasn't already
        // been done.
        typedef sipErrorState (*pyqt5_get_signal_signature_t)(PyObject *, const QObject *, const QByteArray &);
        
        static pyqt5_get_signal_signature_t pyqt5_get_signal_signature = 0;
        
        if (!pyqt5_get_signal_signature)
            pyqt5_get_signal_signature = (pyqt5_get_signal_signature_t)sipImportSymbol("pyqt5_get_signal_signature");
        
        if (pyqt5_get_signal_signature)
        {
            QByteArray signal_signature;
            
        #if defined(SIP_PROTECTED_IS_PUBLIC)
            if ((sipError = pyqt5_get_signal_signature(a0, sipCpp, signal_signature)) == sipErrorNone)
            {
                sipRes = sipCpp->receivers(signal_signature.constData());
            }
        #else
            if ((sipError = pyqt5_get_signal_signature(a0, static_cast<const QObject *>(sipCpp), signal_signature)) == sipErrorNone)
            {
                sipRes = sipCpp->sipProtect_receivers(signal_signature.constData());
            }
        #endif
            else if (sipError == sipErrorContinue)
            {
                sipError = sipBadCallableArg(0, a0);
            }
        }
#line 1502 "/home/lassegoncz/catkin_ws/devel/bin/sip/rviz_sip/siplibrviz_siprvizPanelDockWidget.cpp"

            if (sipError == sipErrorFail)
                return 0;

            if (sipError == sipErrorNone)
            {
            return SIPLong_FromLong(sipRes);
            }

            sipAddException(sipError, &sipParseErr);
        }
    }

    /* Raise an exception if the arguments couldn't be parsed. */
    sipNoMethod(sipParseErr, sipName_PanelDockWidget, sipName_receivers, NULL);

    return NULL;
}


extern "C" {static PyObject *meth_rviz_PanelDockWidget_timerEvent(PyObject *, PyObject *, PyObject *);}
static PyObject *meth_rviz_PanelDockWidget_timerEvent(PyObject *sipSelf, PyObject *sipArgs, PyObject *sipKwds)
{
    PyObject *sipParseErr = NULL;
    bool sipSelfWasArg = (!sipSelf || sipIsDerived((sipSimpleWrapper *)sipSelf));

    {
        QTimerEvent* a0;
        siprviz_PanelDockWidget *sipCpp;

        if (sipParseKwdArgs(&sipParseErr, sipArgs, sipKwds, NULL, NULL, "BJ8", &sipSelf, sipType_rviz_PanelDockWidget, &sipCpp, sipType_QTimerEvent, &a0))
        {
            sipCpp->sipProtectVirt_timerEvent(sipSelfWasArg,a0);

            Py_INCREF(Py_None);
            return Py_None;
        }
    }

    /* Raise an exception if the arguments couldn't be parsed. */
    sipNoMethod(sipParseErr, sipName_PanelDockWidget, sipName_timerEvent, NULL);

    return NULL;
}


extern "C" {static PyObject *meth_rviz_PanelDockWidget_childEvent(PyObject *, PyObject *, PyObject *);}
static PyObject *meth_rviz_PanelDockWidget_childEvent(PyObject *sipSelf, PyObject *sipArgs, PyObject *sipKwds)
{
    PyObject *sipParseErr = NULL;
    bool sipSelfWasArg = (!sipSelf || sipIsDerived((sipSimpleWrapper *)sipSelf));

    {
        QChildEvent* a0;
        siprviz_PanelDockWidget *sipCpp;

        if (sipParseKwdArgs(&sipParseErr, sipArgs, sipKwds, NULL, NULL, "BJ8", &sipSelf, sipType_rviz_PanelDockWidget, &sipCpp, sipType_QChildEvent, &a0))
        {
            sipCpp->sipProtectVirt_childEvent(sipSelfWasArg,a0);

            Py_INCREF(Py_None);
            return Py_None;
        }
    }

    /* Raise an exception if the arguments couldn't be parsed. */
    sipNoMethod(sipParseErr, sipName_PanelDockWidget, sipName_childEvent, NULL);

    return NULL;
}


extern "C" {static PyObject *meth_rviz_PanelDockWidget_customEvent(PyObject *, PyObject *, PyObject *);}
static PyObject *meth_rviz_PanelDockWidget_customEvent(PyObject *sipSelf, PyObject *sipArgs, PyObject *sipKwds)
{
    PyObject *sipParseErr = NULL;
    bool sipSelfWasArg = (!sipSelf || sipIsDerived((sipSimpleWrapper *)sipSelf));

    {
        QEvent* a0;
        siprviz_PanelDockWidget *sipCpp;

        if (sipParseKwdArgs(&sipParseErr, sipArgs, sipKwds, NULL, NULL, "BJ8", &sipSelf, sipType_rviz_PanelDockWidget, &sipCpp, sipType_QEvent, &a0))
        {
            sipCpp->sipProtectVirt_customEvent(sipSelfWasArg,a0);

            Py_INCREF(Py_None);
            return Py_None;
        }
    }

    /* Raise an exception if the arguments couldn't be parsed. */
    sipNoMethod(sipParseErr, sipName_PanelDockWidget, sipName_customEvent, NULL);

    return NULL;
}


extern "C" {static PyObject *meth_rviz_PanelDockWidget_connectNotify(PyObject *, PyObject *, PyObject *);}
static PyObject *meth_rviz_PanelDockWidget_connectNotify(PyObject *sipSelf, PyObject *sipArgs, PyObject *sipKwds)
{
    PyObject *sipParseErr = NULL;
    bool sipSelfWasArg = (!sipSelf || sipIsDerived((sipSimpleWrapper *)sipSelf));

    {
        const QMetaMethod* a0;
        siprviz_PanelDockWidget *sipCpp;

        if (sipParseKwdArgs(&sipParseErr, sipArgs, sipKwds, NULL, NULL, "BJ9", &sipSelf, sipType_rviz_PanelDockWidget, &sipCpp, sipType_QMetaMethod, &a0))
        {
            sipCpp->sipProtectVirt_connectNotify(sipSelfWasArg,*a0);

            Py_INCREF(Py_None);
            return Py_None;
        }
    }

    /* Raise an exception if the arguments couldn't be parsed. */
    sipNoMethod(sipParseErr, sipName_PanelDockWidget, sipName_connectNotify, NULL);

    return NULL;
}


extern "C" {static PyObject *meth_rviz_PanelDockWidget_disconnectNotify(PyObject *, PyObject *, PyObject *);}
static PyObject *meth_rviz_PanelDockWidget_disconnectNotify(PyObject *sipSelf, PyObject *sipArgs, PyObject *sipKwds)
{
    PyObject *sipParseErr = NULL;
    bool sipSelfWasArg = (!sipSelf || sipIsDerived((sipSimpleWrapper *)sipSelf));

    {
        const QMetaMethod* a0;
        siprviz_PanelDockWidget *sipCpp;

        if (sipParseKwdArgs(&sipParseErr, sipArgs, sipKwds, NULL, NULL, "BJ9", &sipSelf, sipType_rviz_PanelDockWidget, &sipCpp, sipType_QMetaMethod, &a0))
        {
            sipCpp->sipProtectVirt_disconnectNotify(sipSelfWasArg,*a0);

            Py_INCREF(Py_None);
            return Py_None;
        }
    }

    /* Raise an exception if the arguments couldn't be parsed. */
    sipNoMethod(sipParseErr, sipName_PanelDockWidget, sipName_disconnectNotify, NULL);

    return NULL;
}


extern "C" {static PyObject *meth_rviz_PanelDockWidget_senderSignalIndex(PyObject *, PyObject *, PyObject *);}
static PyObject *meth_rviz_PanelDockWidget_senderSignalIndex(PyObject *sipSelf, PyObject *sipArgs, PyObject *sipKwds)
{
    PyObject *sipParseErr = NULL;

    {
        const siprviz_PanelDockWidget *sipCpp;

        if (sipParseKwdArgs(&sipParseErr, sipArgs, sipKwds, NULL, NULL, "B", &sipSelf, sipType_rviz_PanelDockWidget, &sipCpp))
        {
            int sipRes;

            sipRes = sipCpp->sipProtect_senderSignalIndex();

            return SIPLong_FromLong(sipRes);
        }
    }

    /* Raise an exception if the arguments couldn't be parsed. */
    sipNoMethod(sipParseErr, sipName_PanelDockWidget, sipName_senderSignalIndex, NULL);

    return NULL;
}


extern "C" {static PyObject *meth_rviz_PanelDockWidget_isSignalConnected(PyObject *, PyObject *, PyObject *);}
static PyObject *meth_rviz_PanelDockWidget_isSignalConnected(PyObject *sipSelf, PyObject *sipArgs, PyObject *sipKwds)
{
    PyObject *sipParseErr = NULL;

    {
        const QMetaMethod* a0;
        const siprviz_PanelDockWidget *sipCpp;

        if (sipParseKwdArgs(&sipParseErr, sipArgs, sipKwds, NULL, NULL, "BJ9", &sipSelf, sipType_rviz_PanelDockWidget, &sipCpp, sipType_QMetaMethod, &a0))
        {
            bool sipRes;

            sipRes = sipCpp->sipProtect_isSignalConnected(*a0);

            return PyBool_FromLong(sipRes);
        }
    }

    /* Raise an exception if the arguments couldn't be parsed. */
    sipNoMethod(sipParseErr, sipName_PanelDockWidget, sipName_isSignalConnected, NULL);

    return NULL;
}


extern "C" {static PyObject *meth_rviz_PanelDockWidget_mousePressEvent(PyObject *, PyObject *, PyObject *);}
static PyObject *meth_rviz_PanelDockWidget_mousePressEvent(PyObject *sipSelf, PyObject *sipArgs, PyObject *sipKwds)
{
    PyObject *sipParseErr = NULL;
    bool sipSelfWasArg = (!sipSelf || sipIsDerived((sipSimpleWrapper *)sipSelf));

    {
        QMouseEvent* a0;
        siprviz_PanelDockWidget *sipCpp;

        if (sipParseKwdArgs(&sipParseErr, sipArgs, sipKwds, NULL, NULL, "BJ8", &sipSelf, sipType_rviz_PanelDockWidget, &sipCpp, sipType_QMouseEvent, &a0))
        {
            sipCpp->sipProtectVirt_mousePressEvent(sipSelfWasArg,a0);

            Py_INCREF(Py_None);
            return Py_None;
        }
    }

    /* Raise an exception if the arguments couldn't be parsed. */
    sipNoMethod(sipParseErr, sipName_PanelDockWidget, sipName_mousePressEvent, NULL);

    return NULL;
}


extern "C" {static PyObject *meth_rviz_PanelDockWidget_mouseReleaseEvent(PyObject *, PyObject *, PyObject *);}
static PyObject *meth_rviz_PanelDockWidget_mouseReleaseEvent(PyObject *sipSelf, PyObject *sipArgs, PyObject *sipKwds)
{
    PyObject *sipParseErr = NULL;
    bool sipSelfWasArg = (!sipSelf || sipIsDerived((sipSimpleWrapper *)sipSelf));

    {
        QMouseEvent* a0;
        siprviz_PanelDockWidget *sipCpp;

        if (sipParseKwdArgs(&sipParseErr, sipArgs, sipKwds, NULL, NULL, "BJ8", &sipSelf, sipType_rviz_PanelDockWidget, &sipCpp, sipType_QMouseEvent, &a0))
        {
            sipCpp->sipProtectVirt_mouseReleaseEvent(sipSelfWasArg,a0);

            Py_INCREF(Py_None);
            return Py_None;
        }
    }

    /* Raise an exception if the arguments couldn't be parsed. */
    sipNoMethod(sipParseErr, sipName_PanelDockWidget, sipName_mouseReleaseEvent, NULL);

    return NULL;
}


extern "C" {static PyObject *meth_rviz_PanelDockWidget_mouseDoubleClickEvent(PyObject *, PyObject *, PyObject *);}
static PyObject *meth_rviz_PanelDockWidget_mouseDoubleClickEvent(PyObject *sipSelf, PyObject *sipArgs, PyObject *sipKwds)
{
    PyObject *sipParseErr = NULL;
    bool sipSelfWasArg = (!sipSelf || sipIsDerived((sipSimpleWrapper *)sipSelf));

    {
        QMouseEvent* a0;
        siprviz_PanelDockWidget *sipCpp;

        if (sipParseKwdArgs(&sipParseErr, sipArgs, sipKwds, NULL, NULL, "BJ8", &sipSelf, sipType_rviz_PanelDockWidget, &sipCpp, sipType_QMouseEvent, &a0))
        {
            sipCpp->sipProtectVirt_mouseDoubleClickEvent(sipSelfWasArg,a0);

            Py_INCREF(Py_None);
            return Py_None;
        }
    }

    /* Raise an exception if the arguments couldn't be parsed. */
    sipNoMethod(sipParseErr, sipName_PanelDockWidget, sipName_mouseDoubleClickEvent, NULL);

    return NULL;
}


extern "C" {static PyObject *meth_rviz_PanelDockWidget_mouseMoveEvent(PyObject *, PyObject *, PyObject *);}
static PyObject *meth_rviz_PanelDockWidget_mouseMoveEvent(PyObject *sipSelf, PyObject *sipArgs, PyObject *sipKwds)
{
    PyObject *sipParseErr = NULL;
    bool sipSelfWasArg = (!sipSelf || sipIsDerived((sipSimpleWrapper *)sipSelf));

    {
        QMouseEvent* a0;
        siprviz_PanelDockWidget *sipCpp;

        if (sipParseKwdArgs(&sipParseErr, sipArgs, sipKwds, NULL, NULL, "BJ8", &sipSelf, sipType_rviz_PanelDockWidget, &sipCpp, sipType_QMouseEvent, &a0))
        {
            sipCpp->sipProtectVirt_mouseMoveEvent(sipSelfWasArg,a0);

            Py_INCREF(Py_None);
            return Py_None;
        }
    }

    /* Raise an exception if the arguments couldn't be parsed. */
    sipNoMethod(sipParseErr, sipName_PanelDockWidget, sipName_mouseMoveEvent, NULL);

    return NULL;
}


extern "C" {static PyObject *meth_rviz_PanelDockWidget_wheelEvent(PyObject *, PyObject *, PyObject *);}
static PyObject *meth_rviz_PanelDockWidget_wheelEvent(PyObject *sipSelf, PyObject *sipArgs, PyObject *sipKwds)
{
    PyObject *sipParseErr = NULL;
    bool sipSelfWasArg = (!sipSelf || sipIsDerived((sipSimpleWrapper *)sipSelf));

    {
        QWheelEvent* a0;
        siprviz_PanelDockWidget *sipCpp;

        if (sipParseKwdArgs(&sipParseErr, sipArgs, sipKwds, NULL, NULL, "BJ8", &sipSelf, sipType_rviz_PanelDockWidget, &sipCpp, sipType_QWheelEvent, &a0))
        {
            sipCpp->sipProtectVirt_wheelEvent(sipSelfWasArg,a0);

            Py_INCREF(Py_None);
            return Py_None;
        }
    }

    /* Raise an exception if the arguments couldn't be parsed. */
    sipNoMethod(sipParseErr, sipName_PanelDockWidget, sipName_wheelEvent, NULL);

    return NULL;
}


extern "C" {static PyObject *meth_rviz_PanelDockWidget_keyPressEvent(PyObject *, PyObject *, PyObject *);}
static PyObject *meth_rviz_PanelDockWidget_keyPressEvent(PyObject *sipSelf, PyObject *sipArgs, PyObject *sipKwds)
{
    PyObject *sipParseErr = NULL;
    bool sipSelfWasArg = (!sipSelf || sipIsDerived((sipSimpleWrapper *)sipSelf));

    {
        QKeyEvent* a0;
        siprviz_PanelDockWidget *sipCpp;

        if (sipParseKwdArgs(&sipParseErr, sipArgs, sipKwds, NULL, NULL, "BJ8", &sipSelf, sipType_rviz_PanelDockWidget, &sipCpp, sipType_QKeyEvent, &a0))
        {
            sipCpp->sipProtectVirt_keyPressEvent(sipSelfWasArg,a0);

            Py_INCREF(Py_None);
            return Py_None;
        }
    }

    /* Raise an exception if the arguments couldn't be parsed. */
    sipNoMethod(sipParseErr, sipName_PanelDockWidget, sipName_keyPressEvent, NULL);

    return NULL;
}


extern "C" {static PyObject *meth_rviz_PanelDockWidget_keyReleaseEvent(PyObject *, PyObject *, PyObject *);}
static PyObject *meth_rviz_PanelDockWidget_keyReleaseEvent(PyObject *sipSelf, PyObject *sipArgs, PyObject *sipKwds)
{
    PyObject *sipParseErr = NULL;
    bool sipSelfWasArg = (!sipSelf || sipIsDerived((sipSimpleWrapper *)sipSelf));

    {
        QKeyEvent* a0;
        siprviz_PanelDockWidget *sipCpp;

        if (sipParseKwdArgs(&sipParseErr, sipArgs, sipKwds, NULL, NULL, "BJ8", &sipSelf, sipType_rviz_PanelDockWidget, &sipCpp, sipType_QKeyEvent, &a0))
        {
            sipCpp->sipProtectVirt_keyReleaseEvent(sipSelfWasArg,a0);

            Py_INCREF(Py_None);
            return Py_None;
        }
    }

    /* Raise an exception if the arguments couldn't be parsed. */
    sipNoMethod(sipParseErr, sipName_PanelDockWidget, sipName_keyReleaseEvent, NULL);

    return NULL;
}


extern "C" {static PyObject *meth_rviz_PanelDockWidget_focusInEvent(PyObject *, PyObject *, PyObject *);}
static PyObject *meth_rviz_PanelDockWidget_focusInEvent(PyObject *sipSelf, PyObject *sipArgs, PyObject *sipKwds)
{
    PyObject *sipParseErr = NULL;
    bool sipSelfWasArg = (!sipSelf || sipIsDerived((sipSimpleWrapper *)sipSelf));

    {
        QFocusEvent* a0;
        siprviz_PanelDockWidget *sipCpp;

        if (sipParseKwdArgs(&sipParseErr, sipArgs, sipKwds, NULL, NULL, "BJ8", &sipSelf, sipType_rviz_PanelDockWidget, &sipCpp, sipType_QFocusEvent, &a0))
        {
            sipCpp->sipProtectVirt_focusInEvent(sipSelfWasArg,a0);

            Py_INCREF(Py_None);
            return Py_None;
        }
    }

    /* Raise an exception if the arguments couldn't be parsed. */
    sipNoMethod(sipParseErr, sipName_PanelDockWidget, sipName_focusInEvent, NULL);

    return NULL;
}


extern "C" {static PyObject *meth_rviz_PanelDockWidget_focusOutEvent(PyObject *, PyObject *, PyObject *);}
static PyObject *meth_rviz_PanelDockWidget_focusOutEvent(PyObject *sipSelf, PyObject *sipArgs, PyObject *sipKwds)
{
    PyObject *sipParseErr = NULL;
    bool sipSelfWasArg = (!sipSelf || sipIsDerived((sipSimpleWrapper *)sipSelf));

    {
        QFocusEvent* a0;
        siprviz_PanelDockWidget *sipCpp;

        if (sipParseKwdArgs(&sipParseErr, sipArgs, sipKwds, NULL, NULL, "BJ8", &sipSelf, sipType_rviz_PanelDockWidget, &sipCpp, sipType_QFocusEvent, &a0))
        {
            sipCpp->sipProtectVirt_focusOutEvent(sipSelfWasArg,a0);

            Py_INCREF(Py_None);
            return Py_None;
        }
    }

    /* Raise an exception if the arguments couldn't be parsed. */
    sipNoMethod(sipParseErr, sipName_PanelDockWidget, sipName_focusOutEvent, NULL);

    return NULL;
}


extern "C" {static PyObject *meth_rviz_PanelDockWidget_enterEvent(PyObject *, PyObject *, PyObject *);}
static PyObject *meth_rviz_PanelDockWidget_enterEvent(PyObject *sipSelf, PyObject *sipArgs, PyObject *sipKwds)
{
    PyObject *sipParseErr = NULL;
    bool sipSelfWasArg = (!sipSelf || sipIsDerived((sipSimpleWrapper *)sipSelf));

    {
        QEvent* a0;
        siprviz_PanelDockWidget *sipCpp;

        if (sipParseKwdArgs(&sipParseErr, sipArgs, sipKwds, NULL, NULL, "BJ8", &sipSelf, sipType_rviz_PanelDockWidget, &sipCpp, sipType_QEvent, &a0))
        {
            sipCpp->sipProtectVirt_enterEvent(sipSelfWasArg,a0);

            Py_INCREF(Py_None);
            return Py_None;
        }
    }

    /* Raise an exception if the arguments couldn't be parsed. */
    sipNoMethod(sipParseErr, sipName_PanelDockWidget, sipName_enterEvent, NULL);

    return NULL;
}


extern "C" {static PyObject *meth_rviz_PanelDockWidget_leaveEvent(PyObject *, PyObject *, PyObject *);}
static PyObject *meth_rviz_PanelDockWidget_leaveEvent(PyObject *sipSelf, PyObject *sipArgs, PyObject *sipKwds)
{
    PyObject *sipParseErr = NULL;
    bool sipSelfWasArg = (!sipSelf || sipIsDerived((sipSimpleWrapper *)sipSelf));

    {
        QEvent* a0;
        siprviz_PanelDockWidget *sipCpp;

        if (sipParseKwdArgs(&sipParseErr, sipArgs, sipKwds, NULL, NULL, "BJ8", &sipSelf, sipType_rviz_PanelDockWidget, &sipCpp, sipType_QEvent, &a0))
        {
            sipCpp->sipProtectVirt_leaveEvent(sipSelfWasArg,a0);

            Py_INCREF(Py_None);
            return Py_None;
        }
    }

    /* Raise an exception if the arguments couldn't be parsed. */
    sipNoMethod(sipParseErr, sipName_PanelDockWidget, sipName_leaveEvent, NULL);

    return NULL;
}


extern "C" {static PyObject *meth_rviz_PanelDockWidget_moveEvent(PyObject *, PyObject *, PyObject *);}
static PyObject *meth_rviz_PanelDockWidget_moveEvent(PyObject *sipSelf, PyObject *sipArgs, PyObject *sipKwds)
{
    PyObject *sipParseErr = NULL;
    bool sipSelfWasArg = (!sipSelf || sipIsDerived((sipSimpleWrapper *)sipSelf));

    {
        QMoveEvent* a0;
        siprviz_PanelDockWidget *sipCpp;

        if (sipParseKwdArgs(&sipParseErr, sipArgs, sipKwds, NULL, NULL, "BJ8", &sipSelf, sipType_rviz_PanelDockWidget, &sipCpp, sipType_QMoveEvent, &a0))
        {
            sipCpp->sipProtectVirt_moveEvent(sipSelfWasArg,a0);

            Py_INCREF(Py_None);
            return Py_None;
        }
    }

    /* Raise an exception if the arguments couldn't be parsed. */
    sipNoMethod(sipParseErr, sipName_PanelDockWidget, sipName_moveEvent, NULL);

    return NULL;
}


extern "C" {static PyObject *meth_rviz_PanelDockWidget_resizeEvent(PyObject *, PyObject *, PyObject *);}
static PyObject *meth_rviz_PanelDockWidget_resizeEvent(PyObject *sipSelf, PyObject *sipArgs, PyObject *sipKwds)
{
    PyObject *sipParseErr = NULL;
    bool sipSelfWasArg = (!sipSelf || sipIsDerived((sipSimpleWrapper *)sipSelf));

    {
        QResizeEvent* a0;
        siprviz_PanelDockWidget *sipCpp;

        if (sipParseKwdArgs(&sipParseErr, sipArgs, sipKwds, NULL, NULL, "BJ8", &sipSelf, sipType_rviz_PanelDockWidget, &sipCpp, sipType_QResizeEvent, &a0))
        {
            sipCpp->sipProtectVirt_resizeEvent(sipSelfWasArg,a0);

            Py_INCREF(Py_None);
            return Py_None;
        }
    }

    /* Raise an exception if the arguments couldn't be parsed. */
    sipNoMethod(sipParseErr, sipName_PanelDockWidget, sipName_resizeEvent, NULL);

    return NULL;
}


extern "C" {static PyObject *meth_rviz_PanelDockWidget_contextMenuEvent(PyObject *, PyObject *, PyObject *);}
static PyObject *meth_rviz_PanelDockWidget_contextMenuEvent(PyObject *sipSelf, PyObject *sipArgs, PyObject *sipKwds)
{
    PyObject *sipParseErr = NULL;
    bool sipSelfWasArg = (!sipSelf || sipIsDerived((sipSimpleWrapper *)sipSelf));

    {
        QContextMenuEvent* a0;
        siprviz_PanelDockWidget *sipCpp;

        if (sipParseKwdArgs(&sipParseErr, sipArgs, sipKwds, NULL, NULL, "BJ8", &sipSelf, sipType_rviz_PanelDockWidget, &sipCpp, sipType_QContextMenuEvent, &a0))
        {
            sipCpp->sipProtectVirt_contextMenuEvent(sipSelfWasArg,a0);

            Py_INCREF(Py_None);
            return Py_None;
        }
    }

    /* Raise an exception if the arguments couldn't be parsed. */
    sipNoMethod(sipParseErr, sipName_PanelDockWidget, sipName_contextMenuEvent, NULL);

    return NULL;
}


extern "C" {static PyObject *meth_rviz_PanelDockWidget_tabletEvent(PyObject *, PyObject *, PyObject *);}
static PyObject *meth_rviz_PanelDockWidget_tabletEvent(PyObject *sipSelf, PyObject *sipArgs, PyObject *sipKwds)
{
    PyObject *sipParseErr = NULL;
    bool sipSelfWasArg = (!sipSelf || sipIsDerived((sipSimpleWrapper *)sipSelf));

    {
        QTabletEvent* a0;
        siprviz_PanelDockWidget *sipCpp;

        if (sipParseKwdArgs(&sipParseErr, sipArgs, sipKwds, NULL, NULL, "BJ8", &sipSelf, sipType_rviz_PanelDockWidget, &sipCpp, sipType_QTabletEvent, &a0))
        {
            sipCpp->sipProtectVirt_tabletEvent(sipSelfWasArg,a0);

            Py_INCREF(Py_None);
            return Py_None;
        }
    }

    /* Raise an exception if the arguments couldn't be parsed. */
    sipNoMethod(sipParseErr, sipName_PanelDockWidget, sipName_tabletEvent, NULL);

    return NULL;
}


extern "C" {static PyObject *meth_rviz_PanelDockWidget_actionEvent(PyObject *, PyObject *, PyObject *);}
static PyObject *meth_rviz_PanelDockWidget_actionEvent(PyObject *sipSelf, PyObject *sipArgs, PyObject *sipKwds)
{
    PyObject *sipParseErr = NULL;
    bool sipSelfWasArg = (!sipSelf || sipIsDerived((sipSimpleWrapper *)sipSelf));

    {
        QActionEvent* a0;
        siprviz_PanelDockWidget *sipCpp;

        if (sipParseKwdArgs(&sipParseErr, sipArgs, sipKwds, NULL, NULL, "BJ8", &sipSelf, sipType_rviz_PanelDockWidget, &sipCpp, sipType_QActionEvent, &a0))
        {
            sipCpp->sipProtectVirt_actionEvent(sipSelfWasArg,a0);

            Py_INCREF(Py_None);
            return Py_None;
        }
    }

    /* Raise an exception if the arguments couldn't be parsed. */
    sipNoMethod(sipParseErr, sipName_PanelDockWidget, sipName_actionEvent, NULL);

    return NULL;
}


extern "C" {static PyObject *meth_rviz_PanelDockWidget_dragEnterEvent(PyObject *, PyObject *, PyObject *);}
static PyObject *meth_rviz_PanelDockWidget_dragEnterEvent(PyObject *sipSelf, PyObject *sipArgs, PyObject *sipKwds)
{
    PyObject *sipParseErr = NULL;
    bool sipSelfWasArg = (!sipSelf || sipIsDerived((sipSimpleWrapper *)sipSelf));

    {
        QDragEnterEvent* a0;
        siprviz_PanelDockWidget *sipCpp;

        if (sipParseKwdArgs(&sipParseErr, sipArgs, sipKwds, NULL, NULL, "BJ8", &sipSelf, sipType_rviz_PanelDockWidget, &sipCpp, sipType_QDragEnterEvent, &a0))
        {
            sipCpp->sipProtectVirt_dragEnterEvent(sipSelfWasArg,a0);

            Py_INCREF(Py_None);
            return Py_None;
        }
    }

    /* Raise an exception if the arguments couldn't be parsed. */
    sipNoMethod(sipParseErr, sipName_PanelDockWidget, sipName_dragEnterEvent, NULL);

    return NULL;
}


extern "C" {static PyObject *meth_rviz_PanelDockWidget_dragMoveEvent(PyObject *, PyObject *, PyObject *);}
static PyObject *meth_rviz_PanelDockWidget_dragMoveEvent(PyObject *sipSelf, PyObject *sipArgs, PyObject *sipKwds)
{
    PyObject *sipParseErr = NULL;
    bool sipSelfWasArg = (!sipSelf || sipIsDerived((sipSimpleWrapper *)sipSelf));

    {
        QDragMoveEvent* a0;
        siprviz_PanelDockWidget *sipCpp;

        if (sipParseKwdArgs(&sipParseErr, sipArgs, sipKwds, NULL, NULL, "BJ8", &sipSelf, sipType_rviz_PanelDockWidget, &sipCpp, sipType_QDragMoveEvent, &a0))
        {
            sipCpp->sipProtectVirt_dragMoveEvent(sipSelfWasArg,a0);

            Py_INCREF(Py_None);
            return Py_None;
        }
    }

    /* Raise an exception if the arguments couldn't be parsed. */
    sipNoMethod(sipParseErr, sipName_PanelDockWidget, sipName_dragMoveEvent, NULL);

    return NULL;
}


extern "C" {static PyObject *meth_rviz_PanelDockWidget_dragLeaveEvent(PyObject *, PyObject *, PyObject *);}
static PyObject *meth_rviz_PanelDockWidget_dragLeaveEvent(PyObject *sipSelf, PyObject *sipArgs, PyObject *sipKwds)
{
    PyObject *sipParseErr = NULL;
    bool sipSelfWasArg = (!sipSelf || sipIsDerived((sipSimpleWrapper *)sipSelf));

    {
        QDragLeaveEvent* a0;
        siprviz_PanelDockWidget *sipCpp;

        if (sipParseKwdArgs(&sipParseErr, sipArgs, sipKwds, NULL, NULL, "BJ8", &sipSelf, sipType_rviz_PanelDockWidget, &sipCpp, sipType_QDragLeaveEvent, &a0))
        {
            sipCpp->sipProtectVirt_dragLeaveEvent(sipSelfWasArg,a0);

            Py_INCREF(Py_None);
            return Py_None;
        }
    }

    /* Raise an exception if the arguments couldn't be parsed. */
    sipNoMethod(sipParseErr, sipName_PanelDockWidget, sipName_dragLeaveEvent, NULL);

    return NULL;
}


extern "C" {static PyObject *meth_rviz_PanelDockWidget_dropEvent(PyObject *, PyObject *, PyObject *);}
static PyObject *meth_rviz_PanelDockWidget_dropEvent(PyObject *sipSelf, PyObject *sipArgs, PyObject *sipKwds)
{
    PyObject *sipParseErr = NULL;
    bool sipSelfWasArg = (!sipSelf || sipIsDerived((sipSimpleWrapper *)sipSelf));

    {
        QDropEvent* a0;
        siprviz_PanelDockWidget *sipCpp;

        if (sipParseKwdArgs(&sipParseErr, sipArgs, sipKwds, NULL, NULL, "BJ8", &sipSelf, sipType_rviz_PanelDockWidget, &sipCpp, sipType_QDropEvent, &a0))
        {
            sipCpp->sipProtectVirt_dropEvent(sipSelfWasArg,a0);

            Py_INCREF(Py_None);
            return Py_None;
        }
    }

    /* Raise an exception if the arguments couldn't be parsed. */
    sipNoMethod(sipParseErr, sipName_PanelDockWidget, sipName_dropEvent, NULL);

    return NULL;
}


extern "C" {static PyObject *meth_rviz_PanelDockWidget_showEvent(PyObject *, PyObject *, PyObject *);}
static PyObject *meth_rviz_PanelDockWidget_showEvent(PyObject *sipSelf, PyObject *sipArgs, PyObject *sipKwds)
{
    PyObject *sipParseErr = NULL;
    bool sipSelfWasArg = (!sipSelf || sipIsDerived((sipSimpleWrapper *)sipSelf));

    {
        QShowEvent* a0;
        siprviz_PanelDockWidget *sipCpp;

        if (sipParseKwdArgs(&sipParseErr, sipArgs, sipKwds, NULL, NULL, "BJ8", &sipSelf, sipType_rviz_PanelDockWidget, &sipCpp, sipType_QShowEvent, &a0))
        {
            sipCpp->sipProtectVirt_showEvent(sipSelfWasArg,a0);

            Py_INCREF(Py_None);
            return Py_None;
        }
    }

    /* Raise an exception if the arguments couldn't be parsed. */
    sipNoMethod(sipParseErr, sipName_PanelDockWidget, sipName_showEvent, NULL);

    return NULL;
}


extern "C" {static PyObject *meth_rviz_PanelDockWidget_hideEvent(PyObject *, PyObject *, PyObject *);}
static PyObject *meth_rviz_PanelDockWidget_hideEvent(PyObject *sipSelf, PyObject *sipArgs, PyObject *sipKwds)
{
    PyObject *sipParseErr = NULL;
    bool sipSelfWasArg = (!sipSelf || sipIsDerived((sipSimpleWrapper *)sipSelf));

    {
        QHideEvent* a0;
        siprviz_PanelDockWidget *sipCpp;

        if (sipParseKwdArgs(&sipParseErr, sipArgs, sipKwds, NULL, NULL, "BJ8", &sipSelf, sipType_rviz_PanelDockWidget, &sipCpp, sipType_QHideEvent, &a0))
        {
            sipCpp->sipProtectVirt_hideEvent(sipSelfWasArg,a0);

            Py_INCREF(Py_None);
            return Py_None;
        }
    }

    /* Raise an exception if the arguments couldn't be parsed. */
    sipNoMethod(sipParseErr, sipName_PanelDockWidget, sipName_hideEvent, NULL);

    return NULL;
}


extern "C" {static PyObject *meth_rviz_PanelDockWidget_metric(PyObject *, PyObject *, PyObject *);}
static PyObject *meth_rviz_PanelDockWidget_metric(PyObject *sipSelf, PyObject *sipArgs, PyObject *sipKwds)
{
    PyObject *sipParseErr = NULL;
    bool sipSelfWasArg = (!sipSelf || sipIsDerived((sipSimpleWrapper *)sipSelf));

    {
        QPaintDevice::PaintDeviceMetric a0;
        const siprviz_PanelDockWidget *sipCpp;

        if (sipParseKwdArgs(&sipParseErr, sipArgs, sipKwds, NULL, NULL, "BE", &sipSelf, sipType_rviz_PanelDockWidget, &sipCpp, sipType_QPaintDevice_PaintDeviceMetric, &a0))
        {
            int sipRes;

            sipRes = sipCpp->sipProtectVirt_metric(sipSelfWasArg,a0);

            return SIPLong_FromLong(sipRes);
        }
    }

    /* Raise an exception if the arguments couldn't be parsed. */
    sipNoMethod(sipParseErr, sipName_PanelDockWidget, sipName_metric, NULL);

    return NULL;
}


extern "C" {static PyObject *meth_rviz_PanelDockWidget_inputMethodEvent(PyObject *, PyObject *, PyObject *);}
static PyObject *meth_rviz_PanelDockWidget_inputMethodEvent(PyObject *sipSelf, PyObject *sipArgs, PyObject *sipKwds)
{
    PyObject *sipParseErr = NULL;
    bool sipSelfWasArg = (!sipSelf || sipIsDerived((sipSimpleWrapper *)sipSelf));

    {
        QInputMethodEvent* a0;
        siprviz_PanelDockWidget *sipCpp;

        if (sipParseKwdArgs(&sipParseErr, sipArgs, sipKwds, NULL, NULL, "BJ8", &sipSelf, sipType_rviz_PanelDockWidget, &sipCpp, sipType_QInputMethodEvent, &a0))
        {
            sipCpp->sipProtectVirt_inputMethodEvent(sipSelfWasArg,a0);

            Py_INCREF(Py_None);
            return Py_None;
        }
    }

    /* Raise an exception if the arguments couldn't be parsed. */
    sipNoMethod(sipParseErr, sipName_PanelDockWidget, sipName_inputMethodEvent, NULL);

    return NULL;
}


extern "C" {static PyObject *meth_rviz_PanelDockWidget_updateMicroFocus(PyObject *, PyObject *, PyObject *);}
static PyObject *meth_rviz_PanelDockWidget_updateMicroFocus(PyObject *sipSelf, PyObject *sipArgs, PyObject *sipKwds)
{
    PyObject *sipParseErr = NULL;

    {
        siprviz_PanelDockWidget *sipCpp;

        if (sipParseKwdArgs(&sipParseErr, sipArgs, sipKwds, NULL, NULL, "B", &sipSelf, sipType_rviz_PanelDockWidget, &sipCpp))
        {
            sipCpp->sipProtect_updateMicroFocus();

            Py_INCREF(Py_None);
            return Py_None;
        }
    }

    /* Raise an exception if the arguments couldn't be parsed. */
    sipNoMethod(sipParseErr, sipName_PanelDockWidget, sipName_updateMicroFocus, NULL);

    return NULL;
}


extern "C" {static PyObject *meth_rviz_PanelDockWidget_create(PyObject *, PyObject *, PyObject *);}
static PyObject *meth_rviz_PanelDockWidget_create(PyObject *sipSelf, PyObject *sipArgs, PyObject *sipKwds)
{
    PyObject *sipParseErr = NULL;

    {
        WId a0def = 0;
        WId* a0 = &a0def;
        int a0State = 0;
        bool a1 = 1;
        bool a2 = 1;
        siprviz_PanelDockWidget *sipCpp;

        static const char *sipKwdList[] = {
            sipName_window,
            sipName_initializeWindow,
            sipName_destroyOldWindow,
        };

        if (sipParseKwdArgs(&sipParseErr, sipArgs, sipKwds, sipKwdList, NULL, "B|J1bb", &sipSelf, sipType_rviz_PanelDockWidget, &sipCpp, sipType_quintptr,&a0, &a0State, &a1, &a2))
        {
            sipCpp->sipProtect_create(*a0,a1,a2);
            sipReleaseType(a0,sipType_quintptr,a0State);

            Py_INCREF(Py_None);
            return Py_None;
        }
    }

    /* Raise an exception if the arguments couldn't be parsed. */
    sipNoMethod(sipParseErr, sipName_PanelDockWidget, sipName_create, NULL);

    return NULL;
}


extern "C" {static PyObject *meth_rviz_PanelDockWidget_destroy(PyObject *, PyObject *, PyObject *);}
static PyObject *meth_rviz_PanelDockWidget_destroy(PyObject *sipSelf, PyObject *sipArgs, PyObject *sipKwds)
{
    PyObject *sipParseErr = NULL;

    {
        bool a0 = 1;
        bool a1 = 1;
        siprviz_PanelDockWidget *sipCpp;

        static const char *sipKwdList[] = {
            sipName_destroyWindow,
            sipName_destroySubWindows,
        };

        if (sipParseKwdArgs(&sipParseErr, sipArgs, sipKwds, sipKwdList, NULL, "B|bb", &sipSelf, sipType_rviz_PanelDockWidget, &sipCpp, &a0, &a1))
        {
            sipCpp->sipProtect_destroy(a0,a1);

            Py_INCREF(Py_None);
            return Py_None;
        }
    }

    /* Raise an exception if the arguments couldn't be parsed. */
    sipNoMethod(sipParseErr, sipName_PanelDockWidget, sipName_destroy, NULL);

    return NULL;
}


extern "C" {static PyObject *meth_rviz_PanelDockWidget_focusNextPrevChild(PyObject *, PyObject *, PyObject *);}
static PyObject *meth_rviz_PanelDockWidget_focusNextPrevChild(PyObject *sipSelf, PyObject *sipArgs, PyObject *sipKwds)
{
    PyObject *sipParseErr = NULL;
    bool sipSelfWasArg = (!sipSelf || sipIsDerived((sipSimpleWrapper *)sipSelf));

    {
        bool a0;
        siprviz_PanelDockWidget *sipCpp;

        if (sipParseKwdArgs(&sipParseErr, sipArgs, sipKwds, NULL, NULL, "Bb", &sipSelf, sipType_rviz_PanelDockWidget, &sipCpp, &a0))
        {
            bool sipRes;

            sipRes = sipCpp->sipProtectVirt_focusNextPrevChild(sipSelfWasArg,a0);

            return PyBool_FromLong(sipRes);
        }
    }

    /* Raise an exception if the arguments couldn't be parsed. */
    sipNoMethod(sipParseErr, sipName_PanelDockWidget, sipName_focusNextPrevChild, NULL);

    return NULL;
}


extern "C" {static PyObject *meth_rviz_PanelDockWidget_focusNextChild(PyObject *, PyObject *, PyObject *);}
static PyObject *meth_rviz_PanelDockWidget_focusNextChild(PyObject *sipSelf, PyObject *sipArgs, PyObject *sipKwds)
{
    PyObject *sipParseErr = NULL;

    {
        siprviz_PanelDockWidget *sipCpp;

        if (sipParseKwdArgs(&sipParseErr, sipArgs, sipKwds, NULL, NULL, "B", &sipSelf, sipType_rviz_PanelDockWidget, &sipCpp))
        {
            bool sipRes;

            sipRes = sipCpp->sipProtect_focusNextChild();

            return PyBool_FromLong(sipRes);
        }
    }

    /* Raise an exception if the arguments couldn't be parsed. */
    sipNoMethod(sipParseErr, sipName_PanelDockWidget, sipName_focusNextChild, NULL);

    return NULL;
}


extern "C" {static PyObject *meth_rviz_PanelDockWidget_focusPreviousChild(PyObject *, PyObject *, PyObject *);}
static PyObject *meth_rviz_PanelDockWidget_focusPreviousChild(PyObject *sipSelf, PyObject *sipArgs, PyObject *sipKwds)
{
    PyObject *sipParseErr = NULL;

    {
        siprviz_PanelDockWidget *sipCpp;

        if (sipParseKwdArgs(&sipParseErr, sipArgs, sipKwds, NULL, NULL, "B", &sipSelf, sipType_rviz_PanelDockWidget, &sipCpp))
        {
            bool sipRes;

            sipRes = sipCpp->sipProtect_focusPreviousChild();

            return PyBool_FromLong(sipRes);
        }
    }

    /* Raise an exception if the arguments couldn't be parsed. */
    sipNoMethod(sipParseErr, sipName_PanelDockWidget, sipName_focusPreviousChild, NULL);

    return NULL;
}


extern "C" {static PyObject *meth_rviz_PanelDockWidget_nativeEvent(PyObject *, PyObject *, PyObject *);}
static PyObject *meth_rviz_PanelDockWidget_nativeEvent(PyObject *sipSelf, PyObject *sipArgs, PyObject *sipKwds)
{
    PyObject *sipParseErr = NULL;
    bool sipSelfWasArg = (!sipSelf || sipIsDerived((sipSimpleWrapper *)sipSelf));

    {
        const QByteArray* a0;
        int a0State = 0;
        void* a1;
        long a2;
        siprviz_PanelDockWidget *sipCpp;

        if (sipParseKwdArgs(&sipParseErr, sipArgs, sipKwds, NULL, NULL, "BJ1v", &sipSelf, sipType_rviz_PanelDockWidget, &sipCpp, sipType_QByteArray, &a0, &a0State, &a1))
        {
            bool sipRes;

            sipRes = sipCpp->sipProtectVirt_nativeEvent(sipSelfWasArg,*a0,a1,&a2);
            sipReleaseType(const_cast<QByteArray *>(a0),sipType_QByteArray,a0State);

            return sipBuildResult(0,"(bl)",sipRes,a2);
        }
    }

    /* Raise an exception if the arguments couldn't be parsed. */
    sipNoMethod(sipParseErr, sipName_PanelDockWidget, sipName_nativeEvent, NULL);

    return NULL;
}


extern "C" {static PyObject *meth_rviz_PanelDockWidget_sharedPainter(PyObject *, PyObject *, PyObject *);}
static PyObject *meth_rviz_PanelDockWidget_sharedPainter(PyObject *sipSelf, PyObject *sipArgs, PyObject *sipKwds)
{
    PyObject *sipParseErr = NULL;
    bool sipSelfWasArg = (!sipSelf || sipIsDerived((sipSimpleWrapper *)sipSelf));

    {
        const siprviz_PanelDockWidget *sipCpp;

        if (sipParseKwdArgs(&sipParseErr, sipArgs, sipKwds, NULL, NULL, "B", &sipSelf, sipType_rviz_PanelDockWidget, &sipCpp))
        {
            QPainter*sipRes;

            sipRes = sipCpp->sipProtectVirt_sharedPainter(sipSelfWasArg);

            return sipConvertFromType(sipRes,sipType_QPainter,NULL);
        }
    }

    /* Raise an exception if the arguments couldn't be parsed. */
    sipNoMethod(sipParseErr, sipName_PanelDockWidget, sipName_sharedPainter, NULL);

    return NULL;
}


extern "C" {static PyObject *meth_rviz_PanelDockWidget_initPainter(PyObject *, PyObject *, PyObject *);}
static PyObject *meth_rviz_PanelDockWidget_initPainter(PyObject *sipSelf, PyObject *sipArgs, PyObject *sipKwds)
{
    PyObject *sipParseErr = NULL;
    bool sipSelfWasArg = (!sipSelf || sipIsDerived((sipSimpleWrapper *)sipSelf));

    {
        QPainter* a0;
        const siprviz_PanelDockWidget *sipCpp;

        if (sipParseKwdArgs(&sipParseErr, sipArgs, sipKwds, NULL, NULL, "BJ8", &sipSelf, sipType_rviz_PanelDockWidget, &sipCpp, sipType_QPainter, &a0))
        {
            sipCpp->sipProtectVirt_initPainter(sipSelfWasArg,a0);

            Py_INCREF(Py_None);
            return Py_None;
        }
    }

    /* Raise an exception if the arguments couldn't be parsed. */
    sipNoMethod(sipParseErr, sipName_PanelDockWidget, sipName_initPainter, NULL);

    return NULL;
}


extern "C" {static PyObject *meth_rviz_PanelDockWidget_initStyleOption(PyObject *, PyObject *, PyObject *);}
static PyObject *meth_rviz_PanelDockWidget_initStyleOption(PyObject *sipSelf, PyObject *sipArgs, PyObject *sipKwds)
{
    PyObject *sipParseErr = NULL;

    {
        QStyleOptionDockWidget* a0;
        const siprviz_PanelDockWidget *sipCpp;

        if (sipParseKwdArgs(&sipParseErr, sipArgs, sipKwds, NULL, NULL, "BJ8", &sipSelf, sipType_rviz_PanelDockWidget, &sipCpp, sipType_QStyleOptionDockWidget, &a0))
        {
            sipCpp->sipProtect_initStyleOption(a0);

            Py_INCREF(Py_None);
            return Py_None;
        }
    }

    /* Raise an exception if the arguments couldn't be parsed. */
    sipNoMethod(sipParseErr, sipName_PanelDockWidget, sipName_initStyleOption, NULL);

    return NULL;
}


extern "C" {static PyObject *meth_rviz_PanelDockWidget_changeEvent(PyObject *, PyObject *, PyObject *);}
static PyObject *meth_rviz_PanelDockWidget_changeEvent(PyObject *sipSelf, PyObject *sipArgs, PyObject *sipKwds)
{
    PyObject *sipParseErr = NULL;
    bool sipSelfWasArg = (!sipSelf || sipIsDerived((sipSimpleWrapper *)sipSelf));

    {
        QEvent* a0;
        siprviz_PanelDockWidget *sipCpp;

        if (sipParseKwdArgs(&sipParseErr, sipArgs, sipKwds, NULL, NULL, "BJ8", &sipSelf, sipType_rviz_PanelDockWidget, &sipCpp, sipType_QEvent, &a0))
        {
            sipCpp->sipProtectVirt_changeEvent(sipSelfWasArg,a0);

            Py_INCREF(Py_None);
            return Py_None;
        }
    }

    /* Raise an exception if the arguments couldn't be parsed. */
    sipNoMethod(sipParseErr, sipName_PanelDockWidget, sipName_changeEvent, NULL);

    return NULL;
}


extern "C" {static PyObject *meth_rviz_PanelDockWidget_closeEvent(PyObject *, PyObject *, PyObject *);}
static PyObject *meth_rviz_PanelDockWidget_closeEvent(PyObject *sipSelf, PyObject *sipArgs, PyObject *sipKwds)
{
    PyObject *sipParseErr = NULL;
    bool sipSelfWasArg = (!sipSelf || sipIsDerived((sipSimpleWrapper *)sipSelf));

    {
        QCloseEvent* a0;
        siprviz_PanelDockWidget *sipCpp;

        if (sipParseKwdArgs(&sipParseErr, sipArgs, sipKwds, NULL, NULL, "BJ8", &sipSelf, sipType_rviz_PanelDockWidget, &sipCpp, sipType_QCloseEvent, &a0))
        {
            sipCpp->sipProtectVirt_closeEvent(sipSelfWasArg,a0);

            Py_INCREF(Py_None);
            return Py_None;
        }
    }

    /* Raise an exception if the arguments couldn't be parsed. */
    sipNoMethod(sipParseErr, sipName_PanelDockWidget, sipName_closeEvent, NULL);

    return NULL;
}


extern "C" {static PyObject *meth_rviz_PanelDockWidget_paintEvent(PyObject *, PyObject *, PyObject *);}
static PyObject *meth_rviz_PanelDockWidget_paintEvent(PyObject *sipSelf, PyObject *sipArgs, PyObject *sipKwds)
{
    PyObject *sipParseErr = NULL;
    bool sipSelfWasArg = (!sipSelf || sipIsDerived((sipSimpleWrapper *)sipSelf));

    {
        QPaintEvent* a0;
        siprviz_PanelDockWidget *sipCpp;

        if (sipParseKwdArgs(&sipParseErr, sipArgs, sipKwds, NULL, NULL, "BJ8", &sipSelf, sipType_rviz_PanelDockWidget, &sipCpp, sipType_QPaintEvent, &a0))
        {
            sipCpp->sipProtectVirt_paintEvent(sipSelfWasArg,a0);

            Py_INCREF(Py_None);
            return Py_None;
        }
    }

    /* Raise an exception if the arguments couldn't be parsed. */
    sipNoMethod(sipParseErr, sipName_PanelDockWidget, sipName_paintEvent, NULL);

    return NULL;
}


extern "C" {static PyObject *meth_rviz_PanelDockWidget_event(PyObject *, PyObject *, PyObject *);}
static PyObject *meth_rviz_PanelDockWidget_event(PyObject *sipSelf, PyObject *sipArgs, PyObject *sipKwds)
{
    PyObject *sipParseErr = NULL;
    bool sipSelfWasArg = (!sipSelf || sipIsDerived((sipSimpleWrapper *)sipSelf));

    {
        QEvent* a0;
        siprviz_PanelDockWidget *sipCpp;

        if (sipParseKwdArgs(&sipParseErr, sipArgs, sipKwds, NULL, NULL, "BJ8", &sipSelf, sipType_rviz_PanelDockWidget, &sipCpp, sipType_QEvent, &a0))
        {
            bool sipRes;

            sipRes = sipCpp->sipProtectVirt_event(sipSelfWasArg,a0);

            return PyBool_FromLong(sipRes);
        }
    }

    /* Raise an exception if the arguments couldn't be parsed. */
    sipNoMethod(sipParseErr, sipName_PanelDockWidget, sipName_event, NULL);

    return NULL;
}


extern "C" {static PyObject *meth_rviz_PanelDockWidget_setContentWidget(PyObject *, PyObject *);}
static PyObject *meth_rviz_PanelDockWidget_setContentWidget(PyObject *sipSelf, PyObject *sipArgs)
{
    PyObject *sipParseErr = NULL;

    {
        QWidget* a0;
        rviz::PanelDockWidget *sipCpp;

        if (sipParseArgs(&sipParseErr, sipArgs, "BJ8", &sipSelf, sipType_rviz_PanelDockWidget, &sipCpp, sipType_QWidget, &a0))
        {
            sipCpp->setContentWidget(a0);

            Py_INCREF(Py_None);
            return Py_None;
        }
    }

    /* Raise an exception if the arguments couldn't be parsed. */
    sipNoMethod(sipParseErr, sipName_PanelDockWidget, sipName_setContentWidget, NULL);

    return NULL;
}


/* Cast a pointer to a type somewhere in its superclass hierarchy. */
extern "C" {static void *cast_rviz_PanelDockWidget(void *, const sipTypeDef *);}
static void *cast_rviz_PanelDockWidget(void *ptr, const sipTypeDef *targetType)
{
    void *res;

    if (targetType == sipType_rviz_PanelDockWidget)
        return ptr;

    if ((res = ((const sipClassTypeDef *)sipType_QDockWidget)->ctd_cast((QDockWidget *)(rviz::PanelDockWidget *)ptr,targetType)) != NULL)
        return res;

    return NULL;
}


/* Call the instance's destructor. */
extern "C" {static void release_rviz_PanelDockWidget(void *, int);}
static void release_rviz_PanelDockWidget(void *sipCppV,int)
{
    rviz::PanelDockWidget *sipCpp = reinterpret_cast<rviz::PanelDockWidget *>(sipCppV);

    if (QThread::currentThread() == sipCpp->thread())
        delete sipCpp;
    else
        sipCpp->deleteLater();
}


extern "C" {static void dealloc_rviz_PanelDockWidget(sipSimpleWrapper *);}
static void dealloc_rviz_PanelDockWidget(sipSimpleWrapper *sipSelf)
{
    if (sipIsDerived(sipSelf))
        reinterpret_cast<siprviz_PanelDockWidget *>(sipGetAddress(sipSelf))->sipPySelf = NULL;

    if (sipIsPyOwned(sipSelf))
    {
        release_rviz_PanelDockWidget(sipGetAddress(sipSelf),sipSelf->flags);
    }
}


extern "C" {static void *init_type_rviz_PanelDockWidget(sipSimpleWrapper *, PyObject *, PyObject *, PyObject **, PyObject **, PyObject **);}
static void *init_type_rviz_PanelDockWidget(sipSimpleWrapper *sipSelf, PyObject *sipArgs, PyObject *sipKwds, PyObject **sipUnused, PyObject **, PyObject **sipParseErr)
{
    siprviz_PanelDockWidget *sipCpp = 0;

    {
        const QString* a0;
        int a0State = 0;

        if (sipParseKwdArgs(sipParseErr, sipArgs, sipKwds, NULL, sipUnused, "J1", sipType_QString,&a0, &a0State))
        {
            sipCpp = new siprviz_PanelDockWidget(*a0);
            sipReleaseType(const_cast<QString *>(a0),sipType_QString,a0State);

            sipCpp->sipPySelf = sipSelf;

            return sipCpp;
        }
    }

    return NULL;
}


/* Define this type's super-types. */
static sipEncodedTypeDef supers_rviz_PanelDockWidget[] = {{69, 2, 1}};


static PyMethodDef methods_rviz_PanelDockWidget[] = {
    {SIP_MLNAME_CAST(sipName_actionEvent), (PyCFunction)meth_rviz_PanelDockWidget_actionEvent, METH_VARARGS|METH_KEYWORDS, NULL},
    {SIP_MLNAME_CAST(sipName_changeEvent), (PyCFunction)meth_rviz_PanelDockWidget_changeEvent, METH_VARARGS|METH_KEYWORDS, NULL},
    {SIP_MLNAME_CAST(sipName_childEvent), (PyCFunction)meth_rviz_PanelDockWidget_childEvent, METH_VARARGS|METH_KEYWORDS, NULL},
    {SIP_MLNAME_CAST(sipName_closeEvent), (PyCFunction)meth_rviz_PanelDockWidget_closeEvent, METH_VARARGS|METH_KEYWORDS, NULL},
    {SIP_MLNAME_CAST(sipName_connectNotify), (PyCFunction)meth_rviz_PanelDockWidget_connectNotify, METH_VARARGS|METH_KEYWORDS, NULL},
    {SIP_MLNAME_CAST(sipName_contextMenuEvent), (PyCFunction)meth_rviz_PanelDockWidget_contextMenuEvent, METH_VARARGS|METH_KEYWORDS, NULL},
    {SIP_MLNAME_CAST(sipName_create), (PyCFunction)meth_rviz_PanelDockWidget_create, METH_VARARGS|METH_KEYWORDS, NULL},
    {SIP_MLNAME_CAST(sipName_customEvent), (PyCFunction)meth_rviz_PanelDockWidget_customEvent, METH_VARARGS|METH_KEYWORDS, NULL},
    {SIP_MLNAME_CAST(sipName_destroy), (PyCFunction)meth_rviz_PanelDockWidget_destroy, METH_VARARGS|METH_KEYWORDS, NULL},
    {SIP_MLNAME_CAST(sipName_disconnectNotify), (PyCFunction)meth_rviz_PanelDockWidget_disconnectNotify, METH_VARARGS|METH_KEYWORDS, NULL},
    {SIP_MLNAME_CAST(sipName_dragEnterEvent), (PyCFunction)meth_rviz_PanelDockWidget_dragEnterEvent, METH_VARARGS|METH_KEYWORDS, NULL},
    {SIP_MLNAME_CAST(sipName_dragLeaveEvent), (PyCFunction)meth_rviz_PanelDockWidget_dragLeaveEvent, METH_VARARGS|METH_KEYWORDS, NULL},
    {SIP_MLNAME_CAST(sipName_dragMoveEvent), (PyCFunction)meth_rviz_PanelDockWidget_dragMoveEvent, METH_VARARGS|METH_KEYWORDS, NULL},
    {SIP_MLNAME_CAST(sipName_dropEvent), (PyCFunction)meth_rviz_PanelDockWidget_dropEvent, METH_VARARGS|METH_KEYWORDS, NULL},
    {SIP_MLNAME_CAST(sipName_enterEvent), (PyCFunction)meth_rviz_PanelDockWidget_enterEvent, METH_VARARGS|METH_KEYWORDS, NULL},
    {SIP_MLNAME_CAST(sipName_event), (PyCFunction)meth_rviz_PanelDockWidget_event, METH_VARARGS|METH_KEYWORDS, NULL},
    {SIP_MLNAME_CAST(sipName_focusInEvent), (PyCFunction)meth_rviz_PanelDockWidget_focusInEvent, METH_VARARGS|METH_KEYWORDS, NULL},
    {SIP_MLNAME_CAST(sipName_focusNextChild), (PyCFunction)meth_rviz_PanelDockWidget_focusNextChild, METH_VARARGS|METH_KEYWORDS, NULL},
    {SIP_MLNAME_CAST(sipName_focusNextPrevChild), (PyCFunction)meth_rviz_PanelDockWidget_focusNextPrevChild, METH_VARARGS|METH_KEYWORDS, NULL},
    {SIP_MLNAME_CAST(sipName_focusOutEvent), (PyCFunction)meth_rviz_PanelDockWidget_focusOutEvent, METH_VARARGS|METH_KEYWORDS, NULL},
    {SIP_MLNAME_CAST(sipName_focusPreviousChild), (PyCFunction)meth_rviz_PanelDockWidget_focusPreviousChild, METH_VARARGS|METH_KEYWORDS, NULL},
    {SIP_MLNAME_CAST(sipName_hideEvent), (PyCFunction)meth_rviz_PanelDockWidget_hideEvent, METH_VARARGS|METH_KEYWORDS, NULL},
    {SIP_MLNAME_CAST(sipName_initPainter), (PyCFunction)meth_rviz_PanelDockWidget_initPainter, METH_VARARGS|METH_KEYWORDS, NULL},
    {SIP_MLNAME_CAST(sipName_initStyleOption), (PyCFunction)meth_rviz_PanelDockWidget_initStyleOption, METH_VARARGS|METH_KEYWORDS, NULL},
    {SIP_MLNAME_CAST(sipName_inputMethodEvent), (PyCFunction)meth_rviz_PanelDockWidget_inputMethodEvent, METH_VARARGS|METH_KEYWORDS, NULL},
    {SIP_MLNAME_CAST(sipName_isSignalConnected), (PyCFunction)meth_rviz_PanelDockWidget_isSignalConnected, METH_VARARGS|METH_KEYWORDS, NULL},
    {SIP_MLNAME_CAST(sipName_keyPressEvent), (PyCFunction)meth_rviz_PanelDockWidget_keyPressEvent, METH_VARARGS|METH_KEYWORDS, NULL},
    {SIP_MLNAME_CAST(sipName_keyReleaseEvent), (PyCFunction)meth_rviz_PanelDockWidget_keyReleaseEvent, METH_VARARGS|METH_KEYWORDS, NULL},
    {SIP_MLNAME_CAST(sipName_leaveEvent), (PyCFunction)meth_rviz_PanelDockWidget_leaveEvent, METH_VARARGS|METH_KEYWORDS, NULL},
    {SIP_MLNAME_CAST(sipName_metric), (PyCFunction)meth_rviz_PanelDockWidget_metric, METH_VARARGS|METH_KEYWORDS, NULL},
    {SIP_MLNAME_CAST(sipName_mouseDoubleClickEvent), (PyCFunction)meth_rviz_PanelDockWidget_mouseDoubleClickEvent, METH_VARARGS|METH_KEYWORDS, NULL},
    {SIP_MLNAME_CAST(sipName_mouseMoveEvent), (PyCFunction)meth_rviz_PanelDockWidget_mouseMoveEvent, METH_VARARGS|METH_KEYWORDS, NULL},
    {SIP_MLNAME_CAST(sipName_mousePressEvent), (PyCFunction)meth_rviz_PanelDockWidget_mousePressEvent, METH_VARARGS|METH_KEYWORDS, NULL},
    {SIP_MLNAME_CAST(sipName_mouseReleaseEvent), (PyCFunction)meth_rviz_PanelDockWidget_mouseReleaseEvent, METH_VARARGS|METH_KEYWORDS, NULL},
    {SIP_MLNAME_CAST(sipName_moveEvent), (PyCFunction)meth_rviz_PanelDockWidget_moveEvent, METH_VARARGS|METH_KEYWORDS, NULL},
    {SIP_MLNAME_CAST(sipName_nativeEvent), (PyCFunction)meth_rviz_PanelDockWidget_nativeEvent, METH_VARARGS|METH_KEYWORDS, NULL},
    {SIP_MLNAME_CAST(sipName_paintEvent), (PyCFunction)meth_rviz_PanelDockWidget_paintEvent, METH_VARARGS|METH_KEYWORDS, NULL},
    {SIP_MLNAME_CAST(sipName_receivers), (PyCFunction)meth_rviz_PanelDockWidget_receivers, METH_VARARGS|METH_KEYWORDS, NULL},
    {SIP_MLNAME_CAST(sipName_resizeEvent), (PyCFunction)meth_rviz_PanelDockWidget_resizeEvent, METH_VARARGS|METH_KEYWORDS, NULL},
    {SIP_MLNAME_CAST(sipName_sender), (PyCFunction)meth_rviz_PanelDockWidget_sender, METH_VARARGS|METH_KEYWORDS, NULL},
    {SIP_MLNAME_CAST(sipName_senderSignalIndex), (PyCFunction)meth_rviz_PanelDockWidget_senderSignalIndex, METH_VARARGS|METH_KEYWORDS, NULL},
    {SIP_MLNAME_CAST(sipName_setContentWidget), meth_rviz_PanelDockWidget_setContentWidget, METH_VARARGS, NULL},
    {SIP_MLNAME_CAST(sipName_sharedPainter), (PyCFunction)meth_rviz_PanelDockWidget_sharedPainter, METH_VARARGS|METH_KEYWORDS, NULL},
    {SIP_MLNAME_CAST(sipName_showEvent), (PyCFunction)meth_rviz_PanelDockWidget_showEvent, METH_VARARGS|METH_KEYWORDS, NULL},
    {SIP_MLNAME_CAST(sipName_tabletEvent), (PyCFunction)meth_rviz_PanelDockWidget_tabletEvent, METH_VARARGS|METH_KEYWORDS, NULL},
    {SIP_MLNAME_CAST(sipName_timerEvent), (PyCFunction)meth_rviz_PanelDockWidget_timerEvent, METH_VARARGS|METH_KEYWORDS, NULL},
    {SIP_MLNAME_CAST(sipName_updateMicroFocus), (PyCFunction)meth_rviz_PanelDockWidget_updateMicroFocus, METH_VARARGS|METH_KEYWORDS, NULL},
    {SIP_MLNAME_CAST(sipName_wheelEvent), (PyCFunction)meth_rviz_PanelDockWidget_wheelEvent, METH_VARARGS|METH_KEYWORDS, NULL}
};


/* Define this type's signals. */
static const pyqt5QtSignal signals_rviz_PanelDockWidget[] = {
    {"visibilityChanged(bool)", 0, 0, 0},
    {0, 0, 0, 0}
};


pyqt5ClassTypeDef sipTypeDef_librviz_sip_rviz_PanelDockWidget = {
{
    {
        -1,
        0,
        0,
        SIP_TYPE_SCC|SIP_TYPE_SUPER_INIT|SIP_TYPE_CLASS,
        sipNameNr_rviz__PanelDockWidget,
        {0}
    },
    {
        sipNameNr_PanelDockWidget,
        {0, 255, 0},
        48, methods_rviz_PanelDockWidget,
        0, 0,
        0, 0,
        {0, 0, 0, 0, 0, 0, 0, 0, 0, 0},
    },
    0,
    -1,
    -1,
    supers_rviz_PanelDockWidget,
    0,
    init_type_rviz_PanelDockWidget,
    0,
    0,
#if PY_MAJOR_VERSION >= 3
    0,
    0,
#else
    0,
    0,
    0,
    0,
#endif
    dealloc_rviz_PanelDockWidget,
    0,
    0,
    0,
    release_rviz_PanelDockWidget,
    cast_rviz_PanelDockWidget,
    0,
    0,
    0,
    0,
    0,
    0
},
    &rviz::PanelDockWidget::staticMetaObject,
    0,
    signals_rviz_PanelDockWidget,
    0
};
