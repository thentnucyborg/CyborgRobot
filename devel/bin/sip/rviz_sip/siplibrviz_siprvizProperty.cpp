/*
 * Interface wrapper code.
 *
 * Generated by SIP 4.17
 */

#include "sipAPIlibrviz_sip.h"

#line 7 "property.sip"
#define ROS_PACKAGE_NAME "rviz"
#include <rviz/properties/property.h>
#line 13 "/home/lassegoncz/catkin_ws/devel/bin/sip/rviz_sip/siplibrviz_siprvizProperty.cpp"

#line 27 "/usr/share/sip/PyQt5/QtCore/qstring.sip"
#include <qstring.h>
#line 17 "/home/lassegoncz/catkin_ws/devel/bin/sip/rviz_sip/siplibrviz_siprvizProperty.cpp"
#line 26 "/usr/share/sip/PyQt5/QtCore/qvariant.sip"
#include <qvariant.h>
#line 20 "/home/lassegoncz/catkin_ws/devel/bin/sip/rviz_sip/siplibrviz_siprvizProperty.cpp"
#line 7 "config.sip"
#define ROS_PACKAGE_NAME "rviz"
#include <rviz/config.h>
#line 24 "/home/lassegoncz/catkin_ws/devel/bin/sip/rviz_sip/siplibrviz_siprvizProperty.cpp"
#line 28 "/usr/share/sip/PyQt5/QtWidgets/qwidget.sip"
#include <qwidget.h>
#line 27 "/home/lassegoncz/catkin_ws/devel/bin/sip/rviz_sip/siplibrviz_siprvizProperty.cpp"
#line 560 "/usr/share/sip/PyQt5/QtWidgets/qstyleoption.sip"
#include <qstyleoption.h>
#line 30 "/home/lassegoncz/catkin_ws/devel/bin/sip/rviz_sip/siplibrviz_siprvizProperty.cpp"
#line 26 "/usr/share/sip/PyQt5/QtGui/qpainter.sip"
#include <qpainter.h>
#line 33 "/home/lassegoncz/catkin_ws/devel/bin/sip/rviz_sip/siplibrviz_siprvizProperty.cpp"
#line 26 "/usr/share/sip/PyQt5/QtCore/qnamespace.sip"
#include <qnamespace.h>
#line 36 "/home/lassegoncz/catkin_ws/devel/bin/sip/rviz_sip/siplibrviz_siprvizProperty.cpp"
#line 26 "/usr/share/sip/PyQt5/QtCore/qmetaobject.sip"
#include <qmetaobject.h>
#line 39 "/home/lassegoncz/catkin_ws/devel/bin/sip/rviz_sip/siplibrviz_siprvizProperty.cpp"
#line 26 "/usr/share/sip/PyQt5/QtCore/qcoreevent.sip"
#include <qcoreevent.h>
#line 42 "/home/lassegoncz/catkin_ws/devel/bin/sip/rviz_sip/siplibrviz_siprvizProperty.cpp"
#line 244 "/usr/share/sip/PyQt5/QtCore/qcoreevent.sip"
#include <qcoreevent.h>
#line 45 "/home/lassegoncz/catkin_ws/devel/bin/sip/rviz_sip/siplibrviz_siprvizProperty.cpp"
#line 232 "/usr/share/sip/PyQt5/QtCore/qcoreevent.sip"
#include <qcoreevent.h>
#line 48 "/home/lassegoncz/catkin_ws/devel/bin/sip/rviz_sip/siplibrviz_siprvizProperty.cpp"
#line 28 "/usr/share/sip/PyQt5/QtCore/qobject.sip"
#include <qobject.h>
#line 51 "/home/lassegoncz/catkin_ws/devel/bin/sip/rviz_sip/siplibrviz_siprvizProperty.cpp"
#line 36 "/usr/share/sip/PyQt5/QtCore/qpycore_qlist.sip"
#include <qlist.h>
#line 54 "/home/lassegoncz/catkin_ws/devel/bin/sip/rviz_sip/siplibrviz_siprvizProperty.cpp"
#line 32 "/usr/share/sip/PyQt5/QtCore/qbytearray.sip"
#include <qbytearray.h>
#line 57 "/home/lassegoncz/catkin_ws/devel/bin/sip/rviz_sip/siplibrviz_siprvizProperty.cpp"
#line 144 "/usr/share/sip/PyQt5/QtCore/qpycore_qlist.sip"
#include <qlist.h>
#line 60 "/home/lassegoncz/catkin_ws/devel/bin/sip/rviz_sip/siplibrviz_siprvizProperty.cpp"
#line 26 "/usr/share/sip/PyQt5/QtCore/qnamespace.sip"
#include <qnamespace.h>
#line 63 "/home/lassegoncz/catkin_ws/devel/bin/sip/rviz_sip/siplibrviz_siprvizProperty.cpp"
#line 26 "/usr/share/sip/PyQt5/QtCore/qthread.sip"
#include <qthread.h>
#line 66 "/home/lassegoncz/catkin_ws/devel/bin/sip/rviz_sip/siplibrviz_siprvizProperty.cpp"
#line 26 "/usr/share/sip/PyQt5/QtCore/qnamespace.sip"
#include <qnamespace.h>
#line 69 "/home/lassegoncz/catkin_ws/devel/bin/sip/rviz_sip/siplibrviz_siprvizProperty.cpp"
#line 26 "/usr/share/sip/PyQt5/QtCore/qregexp.sip"
#include <qregexp.h>
#line 72 "/home/lassegoncz/catkin_ws/devel/bin/sip/rviz_sip/siplibrviz_siprvizProperty.cpp"
#line 26 "/usr/share/sip/PyQt5/QtCore/qregularexpression.sip"
#include <qregularexpression.h>
#line 75 "/home/lassegoncz/catkin_ws/devel/bin/sip/rviz_sip/siplibrviz_siprvizProperty.cpp"
#line 26 "/usr/share/sip/PyQt5/QtCore/qobjectdefs.sip"
#include <qobjectdefs.h>
#line 78 "/home/lassegoncz/catkin_ws/devel/bin/sip/rviz_sip/siplibrviz_siprvizProperty.cpp"


class siprviz_Property : public rviz::Property
{
public:
    siprviz_Property(const QString&,const QVariant,const QString&,rviz::Property*);
    virtual ~siprviz_Property();

    int qt_metacall(QMetaObject::Call,int,void **);
    void *qt_metacast(const char *);
    const QMetaObject *metaObject() const;

    /*
     * There is a public method for every protected method visible from
     * this class.
     */
    QObject* sipProtect_sender() const;
    int sipProtect_receivers(const char*) const;
    void sipProtectVirt_timerEvent(bool,QTimerEvent*);
    void sipProtectVirt_childEvent(bool,QChildEvent*);
    void sipProtectVirt_customEvent(bool,QEvent*);
    void sipProtectVirt_connectNotify(bool,const QMetaMethod&);
    void sipProtectVirt_disconnectNotify(bool,const QMetaMethod&);
    int sipProtect_senderSignalIndex() const;
    bool sipProtect_isSignalConnected(const QMetaMethod&) const;

    /*
     * There is a protected method for every virtual method visible from
     * this class.
     */
protected:
    void disconnectNotify(const QMetaMethod&);
    void connectNotify(const QMetaMethod&);
    void customEvent(QEvent*);
    void childEvent(QChildEvent*);
    void timerEvent(QTimerEvent*);
    bool eventFilter(QObject*,QEvent*);
    bool event(QEvent*);
    void expand();
    void collapse();
    bool getReadOnly();
    void setReadOnly(bool);
    bool getHidden() const;
    void setHidden(bool);
    void save(rviz::Config) const;
    void load(const rviz::Config&);
    void moveChild(int,int);
    void addChild(rviz::Property*,int);
    rviz::Property* takeChildAt(int);
    QWidget* createEditor(QWidget*,const QStyleOptionViewItem&);
    bool paint(QPainter*,const QStyleOptionViewItem&) const;
    Qt::ItemFlags getViewFlags(int) const;
    QVariant getViewData(int,int) const;
    rviz::Property* childAtUnchecked(int) const;
    int numChildren() const;
    QString getDescription() const;
    void setDescription(const QString&);
    QString getName() const;
    void setName(const QString&);
    QVariant getValue() const;
    bool setValue(const QVariant&);
    void removeChildren(int,int);

public:
    sipSimpleWrapper *sipPySelf;

private:
    siprviz_Property(const siprviz_Property &);
    siprviz_Property &operator = (const siprviz_Property &);

    char sipPyMethods[31];
};

siprviz_Property::siprviz_Property(const QString& a0,const QVariant a1,const QString& a2,rviz::Property*a3): rviz::Property(a0,a1,a2,a3), sipPySelf(0)
{
    memset(sipPyMethods, 0, sizeof (sipPyMethods));
}

siprviz_Property::~siprviz_Property()
{
    sipCommonDtor(sipPySelf);
}

const QMetaObject *siprviz_Property::metaObject() const
{
    return QObject::d_ptr->metaObject ? QObject::d_ptr->dynamicMetaObject() : sip_librviz_sip_qt_metaobject(sipPySelf,sipType_rviz_Property);
}

int siprviz_Property::qt_metacall(QMetaObject::Call _c,int _id,void **_a)
{
    _id = rviz::Property::qt_metacall(_c,_id,_a);

    if (_id >= 0)
        _id = sip_librviz_sip_qt_metacall(sipPySelf,sipType_rviz_Property,_c,_id,_a);

    return _id;
}

void *siprviz_Property::qt_metacast(const char *_clname)
{
    void *sipCpp;

    return (sip_librviz_sip_qt_metacast(sipPySelf, sipType_rviz_Property, _clname, &sipCpp) ? sipCpp : rviz::Property::qt_metacast(_clname));
}

void siprviz_Property::disconnectNotify(const QMetaMethod& a0)
{
    sip_gilstate_t sipGILState;
    PyObject *sipMeth;

    sipMeth = sipIsPyMethod(&sipGILState,&sipPyMethods[0],sipPySelf,NULL,sipName_disconnectNotify);

    if (!sipMeth)
    {
        rviz::Property::disconnectNotify(a0);
        return;
    }

    typedef void (*sipVH_QtCore_46)(sip_gilstate_t, sipVirtErrorHandlerFunc, sipSimpleWrapper *, PyObject *, const QMetaMethod&);

    ((sipVH_QtCore_46)(sipModuleAPI_librviz_sip_QtCore->em_virthandlers[46]))(sipGILState, sipModuleAPI_librviz_sip_QtCore->em_virterrorhandlers[0], sipPySelf, sipMeth, a0);
}

void siprviz_Property::connectNotify(const QMetaMethod& a0)
{
    sip_gilstate_t sipGILState;
    PyObject *sipMeth;

    sipMeth = sipIsPyMethod(&sipGILState,&sipPyMethods[1],sipPySelf,NULL,sipName_connectNotify);

    if (!sipMeth)
    {
        rviz::Property::connectNotify(a0);
        return;
    }

    typedef void (*sipVH_QtCore_46)(sip_gilstate_t, sipVirtErrorHandlerFunc, sipSimpleWrapper *, PyObject *, const QMetaMethod&);

    ((sipVH_QtCore_46)(sipModuleAPI_librviz_sip_QtCore->em_virthandlers[46]))(sipGILState, sipModuleAPI_librviz_sip_QtCore->em_virterrorhandlers[0], sipPySelf, sipMeth, a0);
}

void siprviz_Property::customEvent(QEvent*a0)
{
    sip_gilstate_t sipGILState;
    PyObject *sipMeth;

    sipMeth = sipIsPyMethod(&sipGILState,&sipPyMethods[2],sipPySelf,NULL,sipName_customEvent);

    if (!sipMeth)
    {
        rviz::Property::customEvent(a0);
        return;
    }

    typedef void (*sipVH_QtCore_25)(sip_gilstate_t, sipVirtErrorHandlerFunc, sipSimpleWrapper *, PyObject *, QEvent*);

    ((sipVH_QtCore_25)(sipModuleAPI_librviz_sip_QtCore->em_virthandlers[25]))(sipGILState, sipModuleAPI_librviz_sip_QtCore->em_virterrorhandlers[0], sipPySelf, sipMeth, a0);
}

void siprviz_Property::childEvent(QChildEvent*a0)
{
    sip_gilstate_t sipGILState;
    PyObject *sipMeth;

    sipMeth = sipIsPyMethod(&sipGILState,&sipPyMethods[3],sipPySelf,NULL,sipName_childEvent);

    if (!sipMeth)
    {
        rviz::Property::childEvent(a0);
        return;
    }

    typedef void (*sipVH_QtCore_47)(sip_gilstate_t, sipVirtErrorHandlerFunc, sipSimpleWrapper *, PyObject *, QChildEvent*);

    ((sipVH_QtCore_47)(sipModuleAPI_librviz_sip_QtCore->em_virthandlers[47]))(sipGILState, sipModuleAPI_librviz_sip_QtCore->em_virterrorhandlers[0], sipPySelf, sipMeth, a0);
}

void siprviz_Property::timerEvent(QTimerEvent*a0)
{
    sip_gilstate_t sipGILState;
    PyObject *sipMeth;

    sipMeth = sipIsPyMethod(&sipGILState,&sipPyMethods[4],sipPySelf,NULL,sipName_timerEvent);

    if (!sipMeth)
    {
        rviz::Property::timerEvent(a0);
        return;
    }

    typedef void (*sipVH_QtCore_9)(sip_gilstate_t, sipVirtErrorHandlerFunc, sipSimpleWrapper *, PyObject *, QTimerEvent*);

    ((sipVH_QtCore_9)(sipModuleAPI_librviz_sip_QtCore->em_virthandlers[9]))(sipGILState, sipModuleAPI_librviz_sip_QtCore->em_virterrorhandlers[0], sipPySelf, sipMeth, a0);
}

bool siprviz_Property::eventFilter(QObject*a0,QEvent*a1)
{
    sip_gilstate_t sipGILState;
    PyObject *sipMeth;

    sipMeth = sipIsPyMethod(&sipGILState,&sipPyMethods[5],sipPySelf,NULL,sipName_eventFilter);

    if (!sipMeth)
        return rviz::Property::eventFilter(a0,a1);

    typedef bool (*sipVH_QtCore_26)(sip_gilstate_t, sipVirtErrorHandlerFunc, sipSimpleWrapper *, PyObject *, QObject*,QEvent*);

    return ((sipVH_QtCore_26)(sipModuleAPI_librviz_sip_QtCore->em_virthandlers[26]))(sipGILState, sipModuleAPI_librviz_sip_QtCore->em_virterrorhandlers[0], sipPySelf, sipMeth, a0, a1);
}

bool siprviz_Property::event(QEvent*a0)
{
    sip_gilstate_t sipGILState;
    PyObject *sipMeth;

    sipMeth = sipIsPyMethod(&sipGILState,&sipPyMethods[6],sipPySelf,NULL,sipName_event);

    if (!sipMeth)
        return rviz::Property::event(a0);

    typedef bool (*sipVH_QtCore_5)(sip_gilstate_t, sipVirtErrorHandlerFunc, sipSimpleWrapper *, PyObject *, QEvent*);

    return ((sipVH_QtCore_5)(sipModuleAPI_librviz_sip_QtCore->em_virthandlers[5]))(sipGILState, sipModuleAPI_librviz_sip_QtCore->em_virterrorhandlers[0], sipPySelf, sipMeth, a0);
}

void siprviz_Property::expand()
{
    sip_gilstate_t sipGILState;
    PyObject *sipMeth;

    sipMeth = sipIsPyMethod(&sipGILState,&sipPyMethods[7],sipPySelf,NULL,sipName_expand);

    if (!sipMeth)
    {
        rviz::Property::expand();
        return;
    }

    typedef void (*sipVH_QtCore_11)(sip_gilstate_t, sipVirtErrorHandlerFunc, sipSimpleWrapper *, PyObject *);

    ((sipVH_QtCore_11)(sipModuleAPI_librviz_sip_QtCore->em_virthandlers[11]))(sipGILState, sipModuleAPI_librviz_sip_QtCore->em_virterrorhandlers[0], sipPySelf, sipMeth);
}

void siprviz_Property::collapse()
{
    sip_gilstate_t sipGILState;
    PyObject *sipMeth;

    sipMeth = sipIsPyMethod(&sipGILState,&sipPyMethods[8],sipPySelf,NULL,sipName_collapse);

    if (!sipMeth)
    {
        rviz::Property::collapse();
        return;
    }

    typedef void (*sipVH_QtCore_11)(sip_gilstate_t, sipVirtErrorHandlerFunc, sipSimpleWrapper *, PyObject *);

    ((sipVH_QtCore_11)(sipModuleAPI_librviz_sip_QtCore->em_virthandlers[11]))(sipGILState, sipModuleAPI_librviz_sip_QtCore->em_virterrorhandlers[0], sipPySelf, sipMeth);
}

bool siprviz_Property::getReadOnly()
{
    sip_gilstate_t sipGILState;
    PyObject *sipMeth;

    sipMeth = sipIsPyMethod(&sipGILState,&sipPyMethods[9],sipPySelf,NULL,sipName_getReadOnly);

    if (!sipMeth)
        return rviz::Property::getReadOnly();

    typedef bool (*sipVH_QtCore_7)(sip_gilstate_t, sipVirtErrorHandlerFunc, sipSimpleWrapper *, PyObject *);

    return ((sipVH_QtCore_7)(sipModuleAPI_librviz_sip_QtCore->em_virthandlers[7]))(sipGILState, sipModuleAPI_librviz_sip_QtCore->em_virterrorhandlers[0], sipPySelf, sipMeth);
}

void siprviz_Property::setReadOnly(bool a0)
{
    sip_gilstate_t sipGILState;
    PyObject *sipMeth;

    sipMeth = sipIsPyMethod(&sipGILState,&sipPyMethods[10],sipPySelf,NULL,sipName_setReadOnly);

    if (!sipMeth)
    {
        rviz::Property::setReadOnly(a0);
        return;
    }

    typedef void (*sipVH_QtWidgets_0)(sip_gilstate_t, sipVirtErrorHandlerFunc, sipSimpleWrapper *, PyObject *, bool);

    ((sipVH_QtWidgets_0)(sipModuleAPI_librviz_sip_QtWidgets->em_virthandlers[0]))(sipGILState, sipModuleAPI_librviz_sip_QtCore->em_virterrorhandlers[0], sipPySelf, sipMeth, a0);
}

bool siprviz_Property::getHidden() const
{
    sip_gilstate_t sipGILState;
    PyObject *sipMeth;

    sipMeth = sipIsPyMethod(&sipGILState,const_cast<char *>(&sipPyMethods[11]),sipPySelf,NULL,sipName_getHidden);

    if (!sipMeth)
        return rviz::Property::getHidden();

    typedef bool (*sipVH_QtCore_7)(sip_gilstate_t, sipVirtErrorHandlerFunc, sipSimpleWrapper *, PyObject *);

    return ((sipVH_QtCore_7)(sipModuleAPI_librviz_sip_QtCore->em_virthandlers[7]))(sipGILState, sipModuleAPI_librviz_sip_QtCore->em_virterrorhandlers[0], sipPySelf, sipMeth);
}

void siprviz_Property::setHidden(bool a0)
{
    sip_gilstate_t sipGILState;
    PyObject *sipMeth;

    sipMeth = sipIsPyMethod(&sipGILState,&sipPyMethods[12],sipPySelf,NULL,sipName_setHidden);

    if (!sipMeth)
    {
        rviz::Property::setHidden(a0);
        return;
    }

    typedef void (*sipVH_QtWidgets_0)(sip_gilstate_t, sipVirtErrorHandlerFunc, sipSimpleWrapper *, PyObject *, bool);

    ((sipVH_QtWidgets_0)(sipModuleAPI_librviz_sip_QtWidgets->em_virthandlers[0]))(sipGILState, sipModuleAPI_librviz_sip_QtCore->em_virterrorhandlers[0], sipPySelf, sipMeth, a0);
}

void siprviz_Property::save(rviz::Config a0) const
{
    sip_gilstate_t sipGILState;
    PyObject *sipMeth;

    sipMeth = sipIsPyMethod(&sipGILState,const_cast<char *>(&sipPyMethods[13]),sipPySelf,NULL,sipName_save);

    if (!sipMeth)
    {
        rviz::Property::save(a0);
        return;
    }

    extern void sipVH_librviz_sip_0(sip_gilstate_t, sipVirtErrorHandlerFunc, sipSimpleWrapper *, PyObject *, rviz::Config);

    sipVH_librviz_sip_0(sipGILState, sipModuleAPI_librviz_sip_QtCore->em_virterrorhandlers[0], sipPySelf, sipMeth, a0);
}

void siprviz_Property::load(const rviz::Config& a0)
{
    sip_gilstate_t sipGILState;
    PyObject *sipMeth;

    sipMeth = sipIsPyMethod(&sipGILState,&sipPyMethods[14],sipPySelf,NULL,sipName_load);

    if (!sipMeth)
    {
        rviz::Property::load(a0);
        return;
    }

    extern void sipVH_librviz_sip_1(sip_gilstate_t, sipVirtErrorHandlerFunc, sipSimpleWrapper *, PyObject *, const rviz::Config&);

    sipVH_librviz_sip_1(sipGILState, sipModuleAPI_librviz_sip_QtCore->em_virterrorhandlers[0], sipPySelf, sipMeth, a0);
}

void siprviz_Property::moveChild(int a0,int a1)
{
    sip_gilstate_t sipGILState;
    PyObject *sipMeth;

    sipMeth = sipIsPyMethod(&sipGILState,&sipPyMethods[15],sipPySelf,NULL,sipName_moveChild);

    if (!sipMeth)
    {
        rviz::Property::moveChild(a0,a1);
        return;
    }

    typedef void (*sipVH_QtGui_17)(sip_gilstate_t, sipVirtErrorHandlerFunc, sipSimpleWrapper *, PyObject *, int,int);

    ((sipVH_QtGui_17)(sipModuleAPI_librviz_sip_QtGui->em_virthandlers[17]))(sipGILState, sipModuleAPI_librviz_sip_QtCore->em_virterrorhandlers[0], sipPySelf, sipMeth, a0, a1);
}

void siprviz_Property::addChild(rviz::Property*a0,int a1)
{
    sip_gilstate_t sipGILState;
    PyObject *sipMeth;

    sipMeth = sipIsPyMethod(&sipGILState,&sipPyMethods[16],sipPySelf,NULL,sipName_addChild);

    if (!sipMeth)
    {
        rviz::Property::addChild(a0,a1);
        return;
    }

    extern void sipVH_librviz_sip_7(sip_gilstate_t, sipVirtErrorHandlerFunc, sipSimpleWrapper *, PyObject *, rviz::Property*,int);

    sipVH_librviz_sip_7(sipGILState, sipModuleAPI_librviz_sip_QtCore->em_virterrorhandlers[0], sipPySelf, sipMeth, a0, a1);
}

rviz::Property* siprviz_Property::takeChildAt(int a0)
{
    sip_gilstate_t sipGILState;
    PyObject *sipMeth;

    sipMeth = sipIsPyMethod(&sipGILState,&sipPyMethods[17],sipPySelf,NULL,sipName_takeChildAt);

    if (!sipMeth)
        return rviz::Property::takeChildAt(a0);

    extern rviz::Property* sipVH_librviz_sip_8(sip_gilstate_t, sipVirtErrorHandlerFunc, sipSimpleWrapper *, PyObject *, int);

    return sipVH_librviz_sip_8(sipGILState, sipModuleAPI_librviz_sip_QtCore->em_virterrorhandlers[0], sipPySelf, sipMeth, a0);
}

QWidget* siprviz_Property::createEditor(QWidget*a0,const QStyleOptionViewItem& a1)
{
    sip_gilstate_t sipGILState;
    PyObject *sipMeth;

    sipMeth = sipIsPyMethod(&sipGILState,&sipPyMethods[18],sipPySelf,NULL,sipName_createEditor);

    if (!sipMeth)
        return rviz::Property::createEditor(a0,a1);

    extern QWidget* sipVH_librviz_sip_9(sip_gilstate_t, sipVirtErrorHandlerFunc, sipSimpleWrapper *, PyObject *, QWidget*,const QStyleOptionViewItem&);

    return sipVH_librviz_sip_9(sipGILState, sipModuleAPI_librviz_sip_QtCore->em_virterrorhandlers[0], sipPySelf, sipMeth, a0, a1);
}

bool siprviz_Property::paint(QPainter*a0,const QStyleOptionViewItem& a1) const
{
    sip_gilstate_t sipGILState;
    PyObject *sipMeth;

    sipMeth = sipIsPyMethod(&sipGILState,const_cast<char *>(&sipPyMethods[19]),sipPySelf,NULL,sipName_paint);

    if (!sipMeth)
        return rviz::Property::paint(a0,a1);

    extern bool sipVH_librviz_sip_10(sip_gilstate_t, sipVirtErrorHandlerFunc, sipSimpleWrapper *, PyObject *, QPainter*,const QStyleOptionViewItem&);

    return sipVH_librviz_sip_10(sipGILState, sipModuleAPI_librviz_sip_QtCore->em_virterrorhandlers[0], sipPySelf, sipMeth, a0, a1);
}

Qt::ItemFlags siprviz_Property::getViewFlags(int a0) const
{
    sip_gilstate_t sipGILState;
    PyObject *sipMeth;

    sipMeth = sipIsPyMethod(&sipGILState,const_cast<char *>(&sipPyMethods[20]),sipPySelf,NULL,sipName_getViewFlags);

    if (!sipMeth)
        return rviz::Property::getViewFlags(a0);

    extern Qt::ItemFlags sipVH_librviz_sip_6(sip_gilstate_t, sipVirtErrorHandlerFunc, sipSimpleWrapper *, PyObject *, int);

    return sipVH_librviz_sip_6(sipGILState, sipModuleAPI_librviz_sip_QtCore->em_virterrorhandlers[0], sipPySelf, sipMeth, a0);
}

QVariant siprviz_Property::getViewData(int a0,int a1) const
{
    sip_gilstate_t sipGILState;
    PyObject *sipMeth;

    sipMeth = sipIsPyMethod(&sipGILState,const_cast<char *>(&sipPyMethods[21]),sipPySelf,NULL,sipName_getViewData);

    if (!sipMeth)
        return rviz::Property::getViewData(a0,a1);

    typedef QVariant (*sipVH_QtWidgets_21)(sip_gilstate_t, sipVirtErrorHandlerFunc, sipSimpleWrapper *, PyObject *, int,int);

    return ((sipVH_QtWidgets_21)(sipModuleAPI_librviz_sip_QtWidgets->em_virthandlers[21]))(sipGILState, sipModuleAPI_librviz_sip_QtCore->em_virterrorhandlers[0], sipPySelf, sipMeth, a0, a1);
}

rviz::Property* siprviz_Property::childAtUnchecked(int a0) const
{
    sip_gilstate_t sipGILState;
    PyObject *sipMeth;

    sipMeth = sipIsPyMethod(&sipGILState,const_cast<char *>(&sipPyMethods[22]),sipPySelf,NULL,sipName_childAtUnchecked);

    if (!sipMeth)
        return rviz::Property::childAtUnchecked(a0);

    extern rviz::Property* sipVH_librviz_sip_8(sip_gilstate_t, sipVirtErrorHandlerFunc, sipSimpleWrapper *, PyObject *, int);

    return sipVH_librviz_sip_8(sipGILState, sipModuleAPI_librviz_sip_QtCore->em_virterrorhandlers[0], sipPySelf, sipMeth, a0);
}

int siprviz_Property::numChildren() const
{
    sip_gilstate_t sipGILState;
    PyObject *sipMeth;

    sipMeth = sipIsPyMethod(&sipGILState,const_cast<char *>(&sipPyMethods[23]),sipPySelf,NULL,sipName_numChildren);

    if (!sipMeth)
        return rviz::Property::numChildren();

    typedef int (*sipVH_QtCore_6)(sip_gilstate_t, sipVirtErrorHandlerFunc, sipSimpleWrapper *, PyObject *);

    return ((sipVH_QtCore_6)(sipModuleAPI_librviz_sip_QtCore->em_virthandlers[6]))(sipGILState, sipModuleAPI_librviz_sip_QtCore->em_virterrorhandlers[0], sipPySelf, sipMeth);
}

QString siprviz_Property::getDescription() const
{
    sip_gilstate_t sipGILState;
    PyObject *sipMeth;

    sipMeth = sipIsPyMethod(&sipGILState,const_cast<char *>(&sipPyMethods[24]),sipPySelf,NULL,sipName_getDescription);

    if (!sipMeth)
        return rviz::Property::getDescription();

    typedef QString (*sipVH_QtCore_16)(sip_gilstate_t, sipVirtErrorHandlerFunc, sipSimpleWrapper *, PyObject *);

    return ((sipVH_QtCore_16)(sipModuleAPI_librviz_sip_QtCore->em_virthandlers[16]))(sipGILState, sipModuleAPI_librviz_sip_QtCore->em_virterrorhandlers[0], sipPySelf, sipMeth);
}

void siprviz_Property::setDescription(const QString& a0)
{
    sip_gilstate_t sipGILState;
    PyObject *sipMeth;

    sipMeth = sipIsPyMethod(&sipGILState,&sipPyMethods[25],sipPySelf,NULL,sipName_setDescription);

    if (!sipMeth)
    {
        rviz::Property::setDescription(a0);
        return;
    }

    typedef void (*sipVH_QtGui_22)(sip_gilstate_t, sipVirtErrorHandlerFunc, sipSimpleWrapper *, PyObject *, const QString&);

    ((sipVH_QtGui_22)(sipModuleAPI_librviz_sip_QtGui->em_virthandlers[22]))(sipGILState, sipModuleAPI_librviz_sip_QtCore->em_virterrorhandlers[0], sipPySelf, sipMeth, a0);
}

QString siprviz_Property::getName() const
{
    sip_gilstate_t sipGILState;
    PyObject *sipMeth;

    sipMeth = sipIsPyMethod(&sipGILState,const_cast<char *>(&sipPyMethods[26]),sipPySelf,NULL,sipName_getName);

    if (!sipMeth)
        return rviz::Property::getName();

    typedef QString (*sipVH_QtCore_16)(sip_gilstate_t, sipVirtErrorHandlerFunc, sipSimpleWrapper *, PyObject *);

    return ((sipVH_QtCore_16)(sipModuleAPI_librviz_sip_QtCore->em_virthandlers[16]))(sipGILState, sipModuleAPI_librviz_sip_QtCore->em_virterrorhandlers[0], sipPySelf, sipMeth);
}

void siprviz_Property::setName(const QString& a0)
{
    sip_gilstate_t sipGILState;
    PyObject *sipMeth;

    sipMeth = sipIsPyMethod(&sipGILState,&sipPyMethods[27],sipPySelf,NULL,sipName_setName);

    if (!sipMeth)
    {
        rviz::Property::setName(a0);
        return;
    }

    typedef void (*sipVH_QtGui_22)(sip_gilstate_t, sipVirtErrorHandlerFunc, sipSimpleWrapper *, PyObject *, const QString&);

    ((sipVH_QtGui_22)(sipModuleAPI_librviz_sip_QtGui->em_virthandlers[22]))(sipGILState, sipModuleAPI_librviz_sip_QtCore->em_virterrorhandlers[0], sipPySelf, sipMeth, a0);
}

QVariant siprviz_Property::getValue() const
{
    sip_gilstate_t sipGILState;
    PyObject *sipMeth;

    sipMeth = sipIsPyMethod(&sipGILState,const_cast<char *>(&sipPyMethods[28]),sipPySelf,NULL,sipName_getValue);

    if (!sipMeth)
        return rviz::Property::getValue();

    extern QVariant sipVH_librviz_sip_11(sip_gilstate_t, sipVirtErrorHandlerFunc, sipSimpleWrapper *, PyObject *);

    return sipVH_librviz_sip_11(sipGILState, sipModuleAPI_librviz_sip_QtCore->em_virterrorhandlers[0], sipPySelf, sipMeth);
}

bool siprviz_Property::setValue(const QVariant& a0)
{
    sip_gilstate_t sipGILState;
    PyObject *sipMeth;

    sipMeth = sipIsPyMethod(&sipGILState,&sipPyMethods[29],sipPySelf,NULL,sipName_setValue);

    if (!sipMeth)
        return rviz::Property::setValue(a0);

    extern bool sipVH_librviz_sip_12(sip_gilstate_t, sipVirtErrorHandlerFunc, sipSimpleWrapper *, PyObject *, const QVariant&);

    return sipVH_librviz_sip_12(sipGILState, sipModuleAPI_librviz_sip_QtCore->em_virterrorhandlers[0], sipPySelf, sipMeth, a0);
}

void siprviz_Property::removeChildren(int a0,int a1)
{
    sip_gilstate_t sipGILState;
    PyObject *sipMeth;

    sipMeth = sipIsPyMethod(&sipGILState,&sipPyMethods[30],sipPySelf,NULL,sipName_removeChildren);

    if (!sipMeth)
    {
        rviz::Property::removeChildren(a0,a1);
        return;
    }

    typedef void (*sipVH_QtGui_17)(sip_gilstate_t, sipVirtErrorHandlerFunc, sipSimpleWrapper *, PyObject *, int,int);

    ((sipVH_QtGui_17)(sipModuleAPI_librviz_sip_QtGui->em_virthandlers[17]))(sipGILState, sipModuleAPI_librviz_sip_QtCore->em_virterrorhandlers[0], sipPySelf, sipMeth, a0, a1);
}

QObject* siprviz_Property::sipProtect_sender() const
{
    return QObject::sender();
}

int siprviz_Property::sipProtect_receivers(const char*a0) const
{
    return QObject::receivers(a0);
}

void siprviz_Property::sipProtectVirt_timerEvent(bool sipSelfWasArg,QTimerEvent*a0)
{
    (sipSelfWasArg ? QObject::timerEvent(a0) : timerEvent(a0));
}

void siprviz_Property::sipProtectVirt_childEvent(bool sipSelfWasArg,QChildEvent*a0)
{
    (sipSelfWasArg ? QObject::childEvent(a0) : childEvent(a0));
}

void siprviz_Property::sipProtectVirt_customEvent(bool sipSelfWasArg,QEvent*a0)
{
    (sipSelfWasArg ? QObject::customEvent(a0) : customEvent(a0));
}

void siprviz_Property::sipProtectVirt_connectNotify(bool sipSelfWasArg,const QMetaMethod& a0)
{
    (sipSelfWasArg ? QObject::connectNotify(a0) : connectNotify(a0));
}

void siprviz_Property::sipProtectVirt_disconnectNotify(bool sipSelfWasArg,const QMetaMethod& a0)
{
    (sipSelfWasArg ? QObject::disconnectNotify(a0) : disconnectNotify(a0));
}

int siprviz_Property::sipProtect_senderSignalIndex() const
{
    return QObject::senderSignalIndex();
}

bool siprviz_Property::sipProtect_isSignalConnected(const QMetaMethod& a0) const
{
    return QObject::isSignalConnected(a0);
}


extern "C" {static PyObject *meth_rviz_Property_sender(PyObject *, PyObject *, PyObject *);}
static PyObject *meth_rviz_Property_sender(PyObject *sipSelf, PyObject *sipArgs, PyObject *sipKwds)
{
    PyObject *sipParseErr = NULL;

    {
        const siprviz_Property *sipCpp;

        if (sipParseKwdArgs(&sipParseErr, sipArgs, sipKwds, NULL, NULL, "B", &sipSelf, sipType_rviz_Property, &sipCpp))
        {
            QObject*sipRes = 0;

#line 550 "/usr/share/sip/PyQt5/QtCore/qobject.sip"
        // sender() must be called without the GIL to avoid possible deadlocks between
        // the GIL and Qt's internal thread data mutex.
        
        Py_BEGIN_ALLOW_THREADS
        
        #if defined(SIP_PROTECTED_IS_PUBLIC)
        sipRes = sipCpp->sender();
        #else
        sipRes = sipCpp->sipProtect_sender();
        #endif
        
        Py_END_ALLOW_THREADS
        
        if (!sipRes)
        {
            typedef QObject *(*qtcore_qobject_sender_t)();
        
            static qtcore_qobject_sender_t qtcore_qobject_sender = 0;
        
            if (!qtcore_qobject_sender)
                qtcore_qobject_sender = (qtcore_qobject_sender_t)sipImportSymbol("qtcore_qobject_sender");
        
            if (qtcore_qobject_sender)
                sipRes = qtcore_qobject_sender();
        }
#line 781 "/home/lassegoncz/catkin_ws/devel/bin/sip/rviz_sip/siplibrviz_siprvizProperty.cpp"

            return sipConvertFromType(sipRes,sipType_QObject,NULL);
        }
    }

    /* Raise an exception if the arguments couldn't be parsed. */
    sipNoMethod(sipParseErr, sipName_Property, sipName_sender, NULL);

    return NULL;
}


extern "C" {static PyObject *meth_rviz_Property_receivers(PyObject *, PyObject *, PyObject *);}
static PyObject *meth_rviz_Property_receivers(PyObject *sipSelf, PyObject *sipArgs, PyObject *sipKwds)
{
    PyObject *sipParseErr = NULL;

    {
        PyObject * a0;
        const siprviz_Property *sipCpp;

        if (sipParseKwdArgs(&sipParseErr, sipArgs, sipKwds, NULL, NULL, "BP0", &sipSelf, sipType_rviz_Property, &sipCpp, &a0))
        {
            int sipRes = 0;
            sipErrorState sipError = sipErrorNone;

#line 579 "/usr/share/sip/PyQt5/QtCore/qobject.sip"
        // We need to handle the signal object.  Import the helper if it hasn't already
        // been done.
        typedef sipErrorState (*pyqt5_get_signal_signature_t)(PyObject *, const QObject *, const QByteArray &);
        
        static pyqt5_get_signal_signature_t pyqt5_get_signal_signature = 0;
        
        if (!pyqt5_get_signal_signature)
            pyqt5_get_signal_signature = (pyqt5_get_signal_signature_t)sipImportSymbol("pyqt5_get_signal_signature");
        
        if (pyqt5_get_signal_signature)
        {
            QByteArray signal_signature;
            
        #if defined(SIP_PROTECTED_IS_PUBLIC)
            if ((sipError = pyqt5_get_signal_signature(a0, sipCpp, signal_signature)) == sipErrorNone)
            {
                sipRes = sipCpp->receivers(signal_signature.constData());
            }
        #else
            if ((sipError = pyqt5_get_signal_signature(a0, static_cast<const QObject *>(sipCpp), signal_signature)) == sipErrorNone)
            {
                sipRes = sipCpp->sipProtect_receivers(signal_signature.constData());
            }
        #endif
            else if (sipError == sipErrorContinue)
            {
                sipError = sipBadCallableArg(0, a0);
            }
        }
#line 838 "/home/lassegoncz/catkin_ws/devel/bin/sip/rviz_sip/siplibrviz_siprvizProperty.cpp"

            if (sipError == sipErrorFail)
                return 0;

            if (sipError == sipErrorNone)
            {
            return SIPLong_FromLong(sipRes);
            }

            sipAddException(sipError, &sipParseErr);
        }
    }

    /* Raise an exception if the arguments couldn't be parsed. */
    sipNoMethod(sipParseErr, sipName_Property, sipName_receivers, NULL);

    return NULL;
}


extern "C" {static PyObject *meth_rviz_Property_timerEvent(PyObject *, PyObject *, PyObject *);}
static PyObject *meth_rviz_Property_timerEvent(PyObject *sipSelf, PyObject *sipArgs, PyObject *sipKwds)
{
    PyObject *sipParseErr = NULL;
    bool sipSelfWasArg = (!sipSelf || sipIsDerived((sipSimpleWrapper *)sipSelf));

    {
        QTimerEvent* a0;
        siprviz_Property *sipCpp;

        if (sipParseKwdArgs(&sipParseErr, sipArgs, sipKwds, NULL, NULL, "BJ8", &sipSelf, sipType_rviz_Property, &sipCpp, sipType_QTimerEvent, &a0))
        {
            sipCpp->sipProtectVirt_timerEvent(sipSelfWasArg,a0);

            Py_INCREF(Py_None);
            return Py_None;
        }
    }

    /* Raise an exception if the arguments couldn't be parsed. */
    sipNoMethod(sipParseErr, sipName_Property, sipName_timerEvent, NULL);

    return NULL;
}


extern "C" {static PyObject *meth_rviz_Property_childEvent(PyObject *, PyObject *, PyObject *);}
static PyObject *meth_rviz_Property_childEvent(PyObject *sipSelf, PyObject *sipArgs, PyObject *sipKwds)
{
    PyObject *sipParseErr = NULL;
    bool sipSelfWasArg = (!sipSelf || sipIsDerived((sipSimpleWrapper *)sipSelf));

    {
        QChildEvent* a0;
        siprviz_Property *sipCpp;

        if (sipParseKwdArgs(&sipParseErr, sipArgs, sipKwds, NULL, NULL, "BJ8", &sipSelf, sipType_rviz_Property, &sipCpp, sipType_QChildEvent, &a0))
        {
            sipCpp->sipProtectVirt_childEvent(sipSelfWasArg,a0);

            Py_INCREF(Py_None);
            return Py_None;
        }
    }

    /* Raise an exception if the arguments couldn't be parsed. */
    sipNoMethod(sipParseErr, sipName_Property, sipName_childEvent, NULL);

    return NULL;
}


extern "C" {static PyObject *meth_rviz_Property_customEvent(PyObject *, PyObject *, PyObject *);}
static PyObject *meth_rviz_Property_customEvent(PyObject *sipSelf, PyObject *sipArgs, PyObject *sipKwds)
{
    PyObject *sipParseErr = NULL;
    bool sipSelfWasArg = (!sipSelf || sipIsDerived((sipSimpleWrapper *)sipSelf));

    {
        QEvent* a0;
        siprviz_Property *sipCpp;

        if (sipParseKwdArgs(&sipParseErr, sipArgs, sipKwds, NULL, NULL, "BJ8", &sipSelf, sipType_rviz_Property, &sipCpp, sipType_QEvent, &a0))
        {
            sipCpp->sipProtectVirt_customEvent(sipSelfWasArg,a0);

            Py_INCREF(Py_None);
            return Py_None;
        }
    }

    /* Raise an exception if the arguments couldn't be parsed. */
    sipNoMethod(sipParseErr, sipName_Property, sipName_customEvent, NULL);

    return NULL;
}


extern "C" {static PyObject *meth_rviz_Property_connectNotify(PyObject *, PyObject *, PyObject *);}
static PyObject *meth_rviz_Property_connectNotify(PyObject *sipSelf, PyObject *sipArgs, PyObject *sipKwds)
{
    PyObject *sipParseErr = NULL;
    bool sipSelfWasArg = (!sipSelf || sipIsDerived((sipSimpleWrapper *)sipSelf));

    {
        const QMetaMethod* a0;
        siprviz_Property *sipCpp;

        if (sipParseKwdArgs(&sipParseErr, sipArgs, sipKwds, NULL, NULL, "BJ9", &sipSelf, sipType_rviz_Property, &sipCpp, sipType_QMetaMethod, &a0))
        {
            sipCpp->sipProtectVirt_connectNotify(sipSelfWasArg,*a0);

            Py_INCREF(Py_None);
            return Py_None;
        }
    }

    /* Raise an exception if the arguments couldn't be parsed. */
    sipNoMethod(sipParseErr, sipName_Property, sipName_connectNotify, NULL);

    return NULL;
}


extern "C" {static PyObject *meth_rviz_Property_disconnectNotify(PyObject *, PyObject *, PyObject *);}
static PyObject *meth_rviz_Property_disconnectNotify(PyObject *sipSelf, PyObject *sipArgs, PyObject *sipKwds)
{
    PyObject *sipParseErr = NULL;
    bool sipSelfWasArg = (!sipSelf || sipIsDerived((sipSimpleWrapper *)sipSelf));

    {
        const QMetaMethod* a0;
        siprviz_Property *sipCpp;

        if (sipParseKwdArgs(&sipParseErr, sipArgs, sipKwds, NULL, NULL, "BJ9", &sipSelf, sipType_rviz_Property, &sipCpp, sipType_QMetaMethod, &a0))
        {
            sipCpp->sipProtectVirt_disconnectNotify(sipSelfWasArg,*a0);

            Py_INCREF(Py_None);
            return Py_None;
        }
    }

    /* Raise an exception if the arguments couldn't be parsed. */
    sipNoMethod(sipParseErr, sipName_Property, sipName_disconnectNotify, NULL);

    return NULL;
}


extern "C" {static PyObject *meth_rviz_Property_senderSignalIndex(PyObject *, PyObject *, PyObject *);}
static PyObject *meth_rviz_Property_senderSignalIndex(PyObject *sipSelf, PyObject *sipArgs, PyObject *sipKwds)
{
    PyObject *sipParseErr = NULL;

    {
        const siprviz_Property *sipCpp;

        if (sipParseKwdArgs(&sipParseErr, sipArgs, sipKwds, NULL, NULL, "B", &sipSelf, sipType_rviz_Property, &sipCpp))
        {
            int sipRes;

            sipRes = sipCpp->sipProtect_senderSignalIndex();

            return SIPLong_FromLong(sipRes);
        }
    }

    /* Raise an exception if the arguments couldn't be parsed. */
    sipNoMethod(sipParseErr, sipName_Property, sipName_senderSignalIndex, NULL);

    return NULL;
}


extern "C" {static PyObject *meth_rviz_Property_isSignalConnected(PyObject *, PyObject *, PyObject *);}
static PyObject *meth_rviz_Property_isSignalConnected(PyObject *sipSelf, PyObject *sipArgs, PyObject *sipKwds)
{
    PyObject *sipParseErr = NULL;

    {
        const QMetaMethod* a0;
        const siprviz_Property *sipCpp;

        if (sipParseKwdArgs(&sipParseErr, sipArgs, sipKwds, NULL, NULL, "BJ9", &sipSelf, sipType_rviz_Property, &sipCpp, sipType_QMetaMethod, &a0))
        {
            bool sipRes;

            sipRes = sipCpp->sipProtect_isSignalConnected(*a0);

            return PyBool_FromLong(sipRes);
        }
    }

    /* Raise an exception if the arguments couldn't be parsed. */
    sipNoMethod(sipParseErr, sipName_Property, sipName_isSignalConnected, NULL);

    return NULL;
}


extern "C" {static PyObject *meth_rviz_Property_removeChildren(PyObject *, PyObject *);}
static PyObject *meth_rviz_Property_removeChildren(PyObject *sipSelf, PyObject *sipArgs)
{
    PyObject *sipParseErr = NULL;
    bool sipSelfWasArg = (!sipSelf || sipIsDerived((sipSimpleWrapper *)sipSelf));

    {
        int a0 = 0;
        int a1 = -1;
        rviz::Property *sipCpp;

        if (sipParseArgs(&sipParseErr, sipArgs, "B|ii", &sipSelf, sipType_rviz_Property, &sipCpp, &a0, &a1))
        {
            (sipSelfWasArg ? sipCpp->rviz::Property::removeChildren(a0,a1) : sipCpp->removeChildren(a0,a1));

            Py_INCREF(Py_None);
            return Py_None;
        }
    }

    /* Raise an exception if the arguments couldn't be parsed. */
    sipNoMethod(sipParseErr, sipName_Property, sipName_removeChildren, NULL);

    return NULL;
}


extern "C" {static PyObject *meth_rviz_Property_setValue(PyObject *, PyObject *);}
static PyObject *meth_rviz_Property_setValue(PyObject *sipSelf, PyObject *sipArgs)
{
    PyObject *sipParseErr = NULL;
    bool sipSelfWasArg = (!sipSelf || sipIsDerived((sipSimpleWrapper *)sipSelf));

    {
        const QVariant* a0;
        int a0State = 0;
        rviz::Property *sipCpp;

        if (sipParseArgs(&sipParseErr, sipArgs, "BJ1", &sipSelf, sipType_rviz_Property, &sipCpp, sipType_QVariant, &a0, &a0State))
        {
            bool sipRes;

            sipRes = (sipSelfWasArg ? sipCpp->rviz::Property::setValue(*a0) : sipCpp->setValue(*a0));
            sipReleaseType(const_cast<QVariant *>(a0),sipType_QVariant,a0State);

            return PyBool_FromLong(sipRes);
        }
    }

    /* Raise an exception if the arguments couldn't be parsed. */
    sipNoMethod(sipParseErr, sipName_Property, sipName_setValue, NULL);

    return NULL;
}


extern "C" {static PyObject *meth_rviz_Property_getValue(PyObject *, PyObject *);}
static PyObject *meth_rviz_Property_getValue(PyObject *sipSelf, PyObject *sipArgs)
{
    PyObject *sipParseErr = NULL;
    bool sipSelfWasArg = (!sipSelf || sipIsDerived((sipSimpleWrapper *)sipSelf));

    {
        const rviz::Property *sipCpp;

        if (sipParseArgs(&sipParseErr, sipArgs, "B", &sipSelf, sipType_rviz_Property, &sipCpp))
        {
            QVariant*sipRes;

            sipRes = new QVariant((sipSelfWasArg ? sipCpp->rviz::Property::getValue() : sipCpp->getValue()));

            return sipConvertFromNewType(sipRes,sipType_QVariant,NULL);
        }
    }

    /* Raise an exception if the arguments couldn't be parsed. */
    sipNoMethod(sipParseErr, sipName_Property, sipName_getValue, NULL);

    return NULL;
}


extern "C" {static PyObject *meth_rviz_Property_setName(PyObject *, PyObject *);}
static PyObject *meth_rviz_Property_setName(PyObject *sipSelf, PyObject *sipArgs)
{
    PyObject *sipParseErr = NULL;
    bool sipSelfWasArg = (!sipSelf || sipIsDerived((sipSimpleWrapper *)sipSelf));

    {
        const QString* a0;
        int a0State = 0;
        rviz::Property *sipCpp;

        if (sipParseArgs(&sipParseErr, sipArgs, "BJ1", &sipSelf, sipType_rviz_Property, &sipCpp, sipType_QString,&a0, &a0State))
        {
            (sipSelfWasArg ? sipCpp->rviz::Property::setName(*a0) : sipCpp->setName(*a0));
            sipReleaseType(const_cast<QString *>(a0),sipType_QString,a0State);

            Py_INCREF(Py_None);
            return Py_None;
        }
    }

    /* Raise an exception if the arguments couldn't be parsed. */
    sipNoMethod(sipParseErr, sipName_Property, sipName_setName, NULL);

    return NULL;
}


extern "C" {static PyObject *meth_rviz_Property_getName(PyObject *, PyObject *);}
static PyObject *meth_rviz_Property_getName(PyObject *sipSelf, PyObject *sipArgs)
{
    PyObject *sipParseErr = NULL;
    bool sipSelfWasArg = (!sipSelf || sipIsDerived((sipSimpleWrapper *)sipSelf));

    {
        const rviz::Property *sipCpp;

        if (sipParseArgs(&sipParseErr, sipArgs, "B", &sipSelf, sipType_rviz_Property, &sipCpp))
        {
            QString*sipRes;

            sipRes = new QString((sipSelfWasArg ? sipCpp->rviz::Property::getName() : sipCpp->getName()));

            return sipConvertFromNewType(sipRes,sipType_QString,NULL);
        }
    }

    /* Raise an exception if the arguments couldn't be parsed. */
    sipNoMethod(sipParseErr, sipName_Property, sipName_getName, NULL);

    return NULL;
}


extern "C" {static PyObject *meth_rviz_Property_setDescription(PyObject *, PyObject *);}
static PyObject *meth_rviz_Property_setDescription(PyObject *sipSelf, PyObject *sipArgs)
{
    PyObject *sipParseErr = NULL;
    bool sipSelfWasArg = (!sipSelf || sipIsDerived((sipSimpleWrapper *)sipSelf));

    {
        const QString* a0;
        int a0State = 0;
        rviz::Property *sipCpp;

        if (sipParseArgs(&sipParseErr, sipArgs, "BJ1", &sipSelf, sipType_rviz_Property, &sipCpp, sipType_QString,&a0, &a0State))
        {
            (sipSelfWasArg ? sipCpp->rviz::Property::setDescription(*a0) : sipCpp->setDescription(*a0));
            sipReleaseType(const_cast<QString *>(a0),sipType_QString,a0State);

            Py_INCREF(Py_None);
            return Py_None;
        }
    }

    /* Raise an exception if the arguments couldn't be parsed. */
    sipNoMethod(sipParseErr, sipName_Property, sipName_setDescription, NULL);

    return NULL;
}


extern "C" {static PyObject *meth_rviz_Property_getDescription(PyObject *, PyObject *);}
static PyObject *meth_rviz_Property_getDescription(PyObject *sipSelf, PyObject *sipArgs)
{
    PyObject *sipParseErr = NULL;
    bool sipSelfWasArg = (!sipSelf || sipIsDerived((sipSimpleWrapper *)sipSelf));

    {
        const rviz::Property *sipCpp;

        if (sipParseArgs(&sipParseErr, sipArgs, "B", &sipSelf, sipType_rviz_Property, &sipCpp))
        {
            QString*sipRes;

            sipRes = new QString((sipSelfWasArg ? sipCpp->rviz::Property::getDescription() : sipCpp->getDescription()));

            return sipConvertFromNewType(sipRes,sipType_QString,NULL);
        }
    }

    /* Raise an exception if the arguments couldn't be parsed. */
    sipNoMethod(sipParseErr, sipName_Property, sipName_getDescription, NULL);

    return NULL;
}


extern "C" {static PyObject *meth_rviz_Property_subProp(PyObject *, PyObject *);}
static PyObject *meth_rviz_Property_subProp(PyObject *sipSelf, PyObject *sipArgs)
{
    PyObject *sipParseErr = NULL;

    {
        const QString* a0;
        int a0State = 0;
        rviz::Property *sipCpp;

        if (sipParseArgs(&sipParseErr, sipArgs, "BJ1", &sipSelf, sipType_rviz_Property, &sipCpp, sipType_QString,&a0, &a0State))
        {
            rviz::Property*sipRes;

            sipRes = sipCpp->subProp(*a0);
            sipReleaseType(const_cast<QString *>(a0),sipType_QString,a0State);

            return sipConvertFromType(sipRes,sipType_rviz_Property,NULL);
        }
    }

    /* Raise an exception if the arguments couldn't be parsed. */
    sipNoMethod(sipParseErr, sipName_Property, sipName_subProp, NULL);

    return NULL;
}


extern "C" {static PyObject *meth_rviz_Property_numChildren(PyObject *, PyObject *);}
static PyObject *meth_rviz_Property_numChildren(PyObject *sipSelf, PyObject *sipArgs)
{
    PyObject *sipParseErr = NULL;
    bool sipSelfWasArg = (!sipSelf || sipIsDerived((sipSimpleWrapper *)sipSelf));

    {
        const rviz::Property *sipCpp;

        if (sipParseArgs(&sipParseErr, sipArgs, "B", &sipSelf, sipType_rviz_Property, &sipCpp))
        {
            int sipRes;

            sipRes = (sipSelfWasArg ? sipCpp->rviz::Property::numChildren() : sipCpp->numChildren());

            return SIPLong_FromLong(sipRes);
        }
    }

    /* Raise an exception if the arguments couldn't be parsed. */
    sipNoMethod(sipParseErr, sipName_Property, sipName_numChildren, NULL);

    return NULL;
}


extern "C" {static PyObject *meth_rviz_Property_childAt(PyObject *, PyObject *);}
static PyObject *meth_rviz_Property_childAt(PyObject *sipSelf, PyObject *sipArgs)
{
    PyObject *sipParseErr = NULL;

    {
        int a0;
        const rviz::Property *sipCpp;

        if (sipParseArgs(&sipParseErr, sipArgs, "Bi", &sipSelf, sipType_rviz_Property, &sipCpp, &a0))
        {
            rviz::Property*sipRes;

            sipRes = sipCpp->childAt(a0);

            return sipConvertFromType(sipRes,sipType_rviz_Property,NULL);
        }
    }

    /* Raise an exception if the arguments couldn't be parsed. */
    sipNoMethod(sipParseErr, sipName_Property, sipName_childAt, NULL);

    return NULL;
}


extern "C" {static PyObject *meth_rviz_Property_childAtUnchecked(PyObject *, PyObject *);}
static PyObject *meth_rviz_Property_childAtUnchecked(PyObject *sipSelf, PyObject *sipArgs)
{
    PyObject *sipParseErr = NULL;
    bool sipSelfWasArg = (!sipSelf || sipIsDerived((sipSimpleWrapper *)sipSelf));

    {
        int a0;
        const rviz::Property *sipCpp;

        if (sipParseArgs(&sipParseErr, sipArgs, "Bi", &sipSelf, sipType_rviz_Property, &sipCpp, &a0))
        {
            rviz::Property*sipRes;

            sipRes = (sipSelfWasArg ? sipCpp->rviz::Property::childAtUnchecked(a0) : sipCpp->childAtUnchecked(a0));

            return sipConvertFromType(sipRes,sipType_rviz_Property,NULL);
        }
    }

    /* Raise an exception if the arguments couldn't be parsed. */
    sipNoMethod(sipParseErr, sipName_Property, sipName_childAtUnchecked, NULL);

    return NULL;
}


extern "C" {static PyObject *meth_rviz_Property_getParent(PyObject *, PyObject *);}
static PyObject *meth_rviz_Property_getParent(PyObject *sipSelf, PyObject *sipArgs)
{
    PyObject *sipParseErr = NULL;

    {
        const rviz::Property *sipCpp;

        if (sipParseArgs(&sipParseErr, sipArgs, "B", &sipSelf, sipType_rviz_Property, &sipCpp))
        {
            rviz::Property*sipRes;

            sipRes = sipCpp->getParent();

            return sipConvertFromType(sipRes,sipType_rviz_Property,NULL);
        }
    }

    /* Raise an exception if the arguments couldn't be parsed. */
    sipNoMethod(sipParseErr, sipName_Property, sipName_getParent, NULL);

    return NULL;
}


extern "C" {static PyObject *meth_rviz_Property_setParent(PyObject *, PyObject *);}
static PyObject *meth_rviz_Property_setParent(PyObject *sipSelf, PyObject *sipArgs)
{
    PyObject *sipParseErr = NULL;

    {
        rviz::Property* a0;
        rviz::Property *sipCpp;

        if (sipParseArgs(&sipParseErr, sipArgs, "BJ8", &sipSelf, sipType_rviz_Property, &sipCpp, sipType_rviz_Property, &a0))
        {
            sipCpp->setParent(a0);

            Py_INCREF(Py_None);
            return Py_None;
        }
    }

    /* Raise an exception if the arguments couldn't be parsed. */
    sipNoMethod(sipParseErr, sipName_Property, sipName_setParent, NULL);

    return NULL;
}


extern "C" {static PyObject *meth_rviz_Property_getViewData(PyObject *, PyObject *);}
static PyObject *meth_rviz_Property_getViewData(PyObject *sipSelf, PyObject *sipArgs)
{
    PyObject *sipParseErr = NULL;
    bool sipSelfWasArg = (!sipSelf || sipIsDerived((sipSimpleWrapper *)sipSelf));

    {
        int a0;
        int a1;
        const rviz::Property *sipCpp;

        if (sipParseArgs(&sipParseErr, sipArgs, "Bii", &sipSelf, sipType_rviz_Property, &sipCpp, &a0, &a1))
        {
            QVariant*sipRes;

            sipRes = new QVariant((sipSelfWasArg ? sipCpp->rviz::Property::getViewData(a0,a1) : sipCpp->getViewData(a0,a1)));

            return sipConvertFromNewType(sipRes,sipType_QVariant,NULL);
        }
    }

    /* Raise an exception if the arguments couldn't be parsed. */
    sipNoMethod(sipParseErr, sipName_Property, sipName_getViewData, NULL);

    return NULL;
}


extern "C" {static PyObject *meth_rviz_Property_getViewFlags(PyObject *, PyObject *);}
static PyObject *meth_rviz_Property_getViewFlags(PyObject *sipSelf, PyObject *sipArgs)
{
    PyObject *sipParseErr = NULL;
    bool sipSelfWasArg = (!sipSelf || sipIsDerived((sipSimpleWrapper *)sipSelf));

    {
        int a0;
        const rviz::Property *sipCpp;

        if (sipParseArgs(&sipParseErr, sipArgs, "Bi", &sipSelf, sipType_rviz_Property, &sipCpp, &a0))
        {
            Qt::ItemFlags*sipRes;

            sipRes = new Qt::ItemFlags((sipSelfWasArg ? sipCpp->rviz::Property::getViewFlags(a0) : sipCpp->getViewFlags(a0)));

            return sipConvertFromNewType(sipRes,sipType_Qt_ItemFlags,NULL);
        }
    }

    /* Raise an exception if the arguments couldn't be parsed. */
    sipNoMethod(sipParseErr, sipName_Property, sipName_getViewFlags, NULL);

    return NULL;
}


extern "C" {static PyObject *meth_rviz_Property_paint(PyObject *, PyObject *);}
static PyObject *meth_rviz_Property_paint(PyObject *sipSelf, PyObject *sipArgs)
{
    PyObject *sipParseErr = NULL;
    bool sipSelfWasArg = (!sipSelf || sipIsDerived((sipSimpleWrapper *)sipSelf));

    {
        QPainter* a0;
        const QStyleOptionViewItem* a1;
        const rviz::Property *sipCpp;

        if (sipParseArgs(&sipParseErr, sipArgs, "BJ8J9", &sipSelf, sipType_rviz_Property, &sipCpp, sipType_QPainter, &a0, sipType_QStyleOptionViewItem, &a1))
        {
            bool sipRes;

            sipRes = (sipSelfWasArg ? sipCpp->rviz::Property::paint(a0,*a1) : sipCpp->paint(a0,*a1));

            return PyBool_FromLong(sipRes);
        }
    }

    /* Raise an exception if the arguments couldn't be parsed. */
    sipNoMethod(sipParseErr, sipName_Property, sipName_paint, NULL);

    return NULL;
}


extern "C" {static PyObject *meth_rviz_Property_createEditor(PyObject *, PyObject *);}
static PyObject *meth_rviz_Property_createEditor(PyObject *sipSelf, PyObject *sipArgs)
{
    PyObject *sipParseErr = NULL;
    bool sipSelfWasArg = (!sipSelf || sipIsDerived((sipSimpleWrapper *)sipSelf));

    {
        QWidget* a0;
        const QStyleOptionViewItem* a1;
        rviz::Property *sipCpp;

        if (sipParseArgs(&sipParseErr, sipArgs, "BJ8J9", &sipSelf, sipType_rviz_Property, &sipCpp, sipType_QWidget, &a0, sipType_QStyleOptionViewItem, &a1))
        {
            QWidget*sipRes;

            sipRes = (sipSelfWasArg ? sipCpp->rviz::Property::createEditor(a0,*a1) : sipCpp->createEditor(a0,*a1));

            return sipConvertFromType(sipRes,sipType_QWidget,NULL);
        }
    }

    /* Raise an exception if the arguments couldn't be parsed. */
    sipNoMethod(sipParseErr, sipName_Property, sipName_createEditor, NULL);

    return NULL;
}


extern "C" {static PyObject *meth_rviz_Property_isAncestorOf(PyObject *, PyObject *);}
static PyObject *meth_rviz_Property_isAncestorOf(PyObject *sipSelf, PyObject *sipArgs)
{
    PyObject *sipParseErr = NULL;

    {
        rviz::Property* a0;
        const rviz::Property *sipCpp;

        if (sipParseArgs(&sipParseErr, sipArgs, "BJ8", &sipSelf, sipType_rviz_Property, &sipCpp, sipType_rviz_Property, &a0))
        {
            bool sipRes;

            sipRes = sipCpp->isAncestorOf(a0);

            return PyBool_FromLong(sipRes);
        }
    }

    /* Raise an exception if the arguments couldn't be parsed. */
    sipNoMethod(sipParseErr, sipName_Property, sipName_isAncestorOf, NULL);

    return NULL;
}


extern "C" {static PyObject *meth_rviz_Property_takeChild(PyObject *, PyObject *);}
static PyObject *meth_rviz_Property_takeChild(PyObject *sipSelf, PyObject *sipArgs)
{
    PyObject *sipParseErr = NULL;

    {
        rviz::Property* a0;
        rviz::Property *sipCpp;

        if (sipParseArgs(&sipParseErr, sipArgs, "BJ8", &sipSelf, sipType_rviz_Property, &sipCpp, sipType_rviz_Property, &a0))
        {
            rviz::Property*sipRes;

            sipRes = sipCpp->takeChild(a0);

            return sipConvertFromType(sipRes,sipType_rviz_Property,NULL);
        }
    }

    /* Raise an exception if the arguments couldn't be parsed. */
    sipNoMethod(sipParseErr, sipName_Property, sipName_takeChild, NULL);

    return NULL;
}


extern "C" {static PyObject *meth_rviz_Property_takeChildAt(PyObject *, PyObject *);}
static PyObject *meth_rviz_Property_takeChildAt(PyObject *sipSelf, PyObject *sipArgs)
{
    PyObject *sipParseErr = NULL;
    bool sipSelfWasArg = (!sipSelf || sipIsDerived((sipSimpleWrapper *)sipSelf));

    {
        int a0;
        rviz::Property *sipCpp;

        if (sipParseArgs(&sipParseErr, sipArgs, "Bi", &sipSelf, sipType_rviz_Property, &sipCpp, &a0))
        {
            rviz::Property*sipRes;

            sipRes = (sipSelfWasArg ? sipCpp->rviz::Property::takeChildAt(a0) : sipCpp->takeChildAt(a0));

            return sipConvertFromType(sipRes,sipType_rviz_Property,NULL);
        }
    }

    /* Raise an exception if the arguments couldn't be parsed. */
    sipNoMethod(sipParseErr, sipName_Property, sipName_takeChildAt, NULL);

    return NULL;
}


extern "C" {static PyObject *meth_rviz_Property_addChild(PyObject *, PyObject *);}
static PyObject *meth_rviz_Property_addChild(PyObject *sipSelf, PyObject *sipArgs)
{
    PyObject *sipParseErr = NULL;
    bool sipSelfWasArg = (!sipSelf || sipIsDerived((sipSimpleWrapper *)sipSelf));

    {
        rviz::Property* a0;
        int a1 = -1;
        rviz::Property *sipCpp;

        if (sipParseArgs(&sipParseErr, sipArgs, "BJ8|i", &sipSelf, sipType_rviz_Property, &sipCpp, sipType_rviz_Property, &a0, &a1))
        {
            (sipSelfWasArg ? sipCpp->rviz::Property::addChild(a0,a1) : sipCpp->addChild(a0,a1));

            Py_INCREF(Py_None);
            return Py_None;
        }
    }

    /* Raise an exception if the arguments couldn't be parsed. */
    sipNoMethod(sipParseErr, sipName_Property, sipName_addChild, NULL);

    return NULL;
}


extern "C" {static PyObject *meth_rviz_Property_rowNumberInParent(PyObject *, PyObject *);}
static PyObject *meth_rviz_Property_rowNumberInParent(PyObject *sipSelf, PyObject *sipArgs)
{
    PyObject *sipParseErr = NULL;

    {
        const rviz::Property *sipCpp;

        if (sipParseArgs(&sipParseErr, sipArgs, "B", &sipSelf, sipType_rviz_Property, &sipCpp))
        {
            int sipRes;

            sipRes = sipCpp->rowNumberInParent();

            return SIPLong_FromLong(sipRes);
        }
    }

    /* Raise an exception if the arguments couldn't be parsed. */
    sipNoMethod(sipParseErr, sipName_Property, sipName_rowNumberInParent, NULL);

    return NULL;
}


extern "C" {static PyObject *meth_rviz_Property_moveChild(PyObject *, PyObject *);}
static PyObject *meth_rviz_Property_moveChild(PyObject *sipSelf, PyObject *sipArgs)
{
    PyObject *sipParseErr = NULL;
    bool sipSelfWasArg = (!sipSelf || sipIsDerived((sipSimpleWrapper *)sipSelf));

    {
        int a0;
        int a1;
        rviz::Property *sipCpp;

        if (sipParseArgs(&sipParseErr, sipArgs, "Bii", &sipSelf, sipType_rviz_Property, &sipCpp, &a0, &a1))
        {
            (sipSelfWasArg ? sipCpp->rviz::Property::moveChild(a0,a1) : sipCpp->moveChild(a0,a1));

            Py_INCREF(Py_None);
            return Py_None;
        }
    }

    /* Raise an exception if the arguments couldn't be parsed. */
    sipNoMethod(sipParseErr, sipName_Property, sipName_moveChild, NULL);

    return NULL;
}


extern "C" {static PyObject *meth_rviz_Property_load(PyObject *, PyObject *);}
static PyObject *meth_rviz_Property_load(PyObject *sipSelf, PyObject *sipArgs)
{
    PyObject *sipParseErr = NULL;
    bool sipSelfWasArg = (!sipSelf || sipIsDerived((sipSimpleWrapper *)sipSelf));

    {
        const rviz::Config* a0;
        rviz::Property *sipCpp;

        if (sipParseArgs(&sipParseErr, sipArgs, "BJ9", &sipSelf, sipType_rviz_Property, &sipCpp, sipType_rviz_Config, &a0))
        {
            (sipSelfWasArg ? sipCpp->rviz::Property::load(*a0) : sipCpp->load(*a0));

            Py_INCREF(Py_None);
            return Py_None;
        }
    }

    /* Raise an exception if the arguments couldn't be parsed. */
    sipNoMethod(sipParseErr, sipName_Property, sipName_load, NULL);

    return NULL;
}


extern "C" {static PyObject *meth_rviz_Property_save(PyObject *, PyObject *);}
static PyObject *meth_rviz_Property_save(PyObject *sipSelf, PyObject *sipArgs)
{
    PyObject *sipParseErr = NULL;
    bool sipSelfWasArg = (!sipSelf || sipIsDerived((sipSimpleWrapper *)sipSelf));

    {
        rviz::Config* a0;
        const rviz::Property *sipCpp;

        if (sipParseArgs(&sipParseErr, sipArgs, "BJ9", &sipSelf, sipType_rviz_Property, &sipCpp, sipType_rviz_Config, &a0))
        {
            (sipSelfWasArg ? sipCpp->rviz::Property::save(*a0) : sipCpp->save(*a0));

            Py_INCREF(Py_None);
            return Py_None;
        }
    }

    /* Raise an exception if the arguments couldn't be parsed. */
    sipNoMethod(sipParseErr, sipName_Property, sipName_save, NULL);

    return NULL;
}


extern "C" {static PyObject *meth_rviz_Property_shouldBeSaved(PyObject *, PyObject *);}
static PyObject *meth_rviz_Property_shouldBeSaved(PyObject *sipSelf, PyObject *sipArgs)
{
    PyObject *sipParseErr = NULL;

    {
        const rviz::Property *sipCpp;

        if (sipParseArgs(&sipParseErr, sipArgs, "B", &sipSelf, sipType_rviz_Property, &sipCpp))
        {
            bool sipRes;

            sipRes = sipCpp->shouldBeSaved();

            return PyBool_FromLong(sipRes);
        }
    }

    /* Raise an exception if the arguments couldn't be parsed. */
    sipNoMethod(sipParseErr, sipName_Property, sipName_shouldBeSaved, NULL);

    return NULL;
}


extern "C" {static PyObject *meth_rviz_Property_setShouldBeSaved(PyObject *, PyObject *);}
static PyObject *meth_rviz_Property_setShouldBeSaved(PyObject *sipSelf, PyObject *sipArgs)
{
    PyObject *sipParseErr = NULL;

    {
        bool a0;
        rviz::Property *sipCpp;

        if (sipParseArgs(&sipParseErr, sipArgs, "Bb", &sipSelf, sipType_rviz_Property, &sipCpp, &a0))
        {
            sipCpp->setShouldBeSaved(a0);

            Py_INCREF(Py_None);
            return Py_None;
        }
    }

    /* Raise an exception if the arguments couldn't be parsed. */
    sipNoMethod(sipParseErr, sipName_Property, sipName_setShouldBeSaved, NULL);

    return NULL;
}


extern "C" {static PyObject *meth_rviz_Property_hide(PyObject *, PyObject *);}
static PyObject *meth_rviz_Property_hide(PyObject *sipSelf, PyObject *sipArgs)
{
    PyObject *sipParseErr = NULL;

    {
        rviz::Property *sipCpp;

        if (sipParseArgs(&sipParseErr, sipArgs, "B", &sipSelf, sipType_rviz_Property, &sipCpp))
        {
            sipCpp->hide();

            Py_INCREF(Py_None);
            return Py_None;
        }
    }

    /* Raise an exception if the arguments couldn't be parsed. */
    sipNoMethod(sipParseErr, sipName_Property, sipName_hide, NULL);

    return NULL;
}


extern "C" {static PyObject *meth_rviz_Property_show(PyObject *, PyObject *);}
static PyObject *meth_rviz_Property_show(PyObject *sipSelf, PyObject *sipArgs)
{
    PyObject *sipParseErr = NULL;

    {
        rviz::Property *sipCpp;

        if (sipParseArgs(&sipParseErr, sipArgs, "B", &sipSelf, sipType_rviz_Property, &sipCpp))
        {
            sipCpp->show();

            Py_INCREF(Py_None);
            return Py_None;
        }
    }

    /* Raise an exception if the arguments couldn't be parsed. */
    sipNoMethod(sipParseErr, sipName_Property, sipName_show, NULL);

    return NULL;
}


extern "C" {static PyObject *meth_rviz_Property_setHidden(PyObject *, PyObject *);}
static PyObject *meth_rviz_Property_setHidden(PyObject *sipSelf, PyObject *sipArgs)
{
    PyObject *sipParseErr = NULL;
    bool sipSelfWasArg = (!sipSelf || sipIsDerived((sipSimpleWrapper *)sipSelf));

    {
        bool a0;
        rviz::Property *sipCpp;

        if (sipParseArgs(&sipParseErr, sipArgs, "Bb", &sipSelf, sipType_rviz_Property, &sipCpp, &a0))
        {
            (sipSelfWasArg ? sipCpp->rviz::Property::setHidden(a0) : sipCpp->setHidden(a0));

            Py_INCREF(Py_None);
            return Py_None;
        }
    }

    /* Raise an exception if the arguments couldn't be parsed. */
    sipNoMethod(sipParseErr, sipName_Property, sipName_setHidden, NULL);

    return NULL;
}


extern "C" {static PyObject *meth_rviz_Property_getHidden(PyObject *, PyObject *);}
static PyObject *meth_rviz_Property_getHidden(PyObject *sipSelf, PyObject *sipArgs)
{
    PyObject *sipParseErr = NULL;
    bool sipSelfWasArg = (!sipSelf || sipIsDerived((sipSimpleWrapper *)sipSelf));

    {
        const rviz::Property *sipCpp;

        if (sipParseArgs(&sipParseErr, sipArgs, "B", &sipSelf, sipType_rviz_Property, &sipCpp))
        {
            bool sipRes;

            sipRes = (sipSelfWasArg ? sipCpp->rviz::Property::getHidden() : sipCpp->getHidden());

            return PyBool_FromLong(sipRes);
        }
    }

    /* Raise an exception if the arguments couldn't be parsed. */
    sipNoMethod(sipParseErr, sipName_Property, sipName_getHidden, NULL);

    return NULL;
}


extern "C" {static PyObject *meth_rviz_Property_setReadOnly(PyObject *, PyObject *);}
static PyObject *meth_rviz_Property_setReadOnly(PyObject *sipSelf, PyObject *sipArgs)
{
    PyObject *sipParseErr = NULL;
    bool sipSelfWasArg = (!sipSelf || sipIsDerived((sipSimpleWrapper *)sipSelf));

    {
        bool a0;
        rviz::Property *sipCpp;

        if (sipParseArgs(&sipParseErr, sipArgs, "Bb", &sipSelf, sipType_rviz_Property, &sipCpp, &a0))
        {
            (sipSelfWasArg ? sipCpp->rviz::Property::setReadOnly(a0) : sipCpp->setReadOnly(a0));

            Py_INCREF(Py_None);
            return Py_None;
        }
    }

    /* Raise an exception if the arguments couldn't be parsed. */
    sipNoMethod(sipParseErr, sipName_Property, sipName_setReadOnly, NULL);

    return NULL;
}


extern "C" {static PyObject *meth_rviz_Property_getReadOnly(PyObject *, PyObject *);}
static PyObject *meth_rviz_Property_getReadOnly(PyObject *sipSelf, PyObject *sipArgs)
{
    PyObject *sipParseErr = NULL;
    bool sipSelfWasArg = (!sipSelf || sipIsDerived((sipSimpleWrapper *)sipSelf));

    {
        rviz::Property *sipCpp;

        if (sipParseArgs(&sipParseErr, sipArgs, "B", &sipSelf, sipType_rviz_Property, &sipCpp))
        {
            bool sipRes;

            sipRes = (sipSelfWasArg ? sipCpp->rviz::Property::getReadOnly() : sipCpp->getReadOnly());

            return PyBool_FromLong(sipRes);
        }
    }

    /* Raise an exception if the arguments couldn't be parsed. */
    sipNoMethod(sipParseErr, sipName_Property, sipName_getReadOnly, NULL);

    return NULL;
}


extern "C" {static PyObject *meth_rviz_Property_collapse(PyObject *, PyObject *);}
static PyObject *meth_rviz_Property_collapse(PyObject *sipSelf, PyObject *sipArgs)
{
    PyObject *sipParseErr = NULL;
    bool sipSelfWasArg = (!sipSelf || sipIsDerived((sipSimpleWrapper *)sipSelf));

    {
        rviz::Property *sipCpp;

        if (sipParseArgs(&sipParseErr, sipArgs, "B", &sipSelf, sipType_rviz_Property, &sipCpp))
        {
            (sipSelfWasArg ? sipCpp->rviz::Property::collapse() : sipCpp->collapse());

            Py_INCREF(Py_None);
            return Py_None;
        }
    }

    /* Raise an exception if the arguments couldn't be parsed. */
    sipNoMethod(sipParseErr, sipName_Property, sipName_collapse, NULL);

    return NULL;
}


extern "C" {static PyObject *meth_rviz_Property_expand(PyObject *, PyObject *);}
static PyObject *meth_rviz_Property_expand(PyObject *sipSelf, PyObject *sipArgs)
{
    PyObject *sipParseErr = NULL;
    bool sipSelfWasArg = (!sipSelf || sipIsDerived((sipSimpleWrapper *)sipSelf));

    {
        rviz::Property *sipCpp;

        if (sipParseArgs(&sipParseErr, sipArgs, "B", &sipSelf, sipType_rviz_Property, &sipCpp))
        {
            (sipSelfWasArg ? sipCpp->rviz::Property::expand() : sipCpp->expand());

            Py_INCREF(Py_None);
            return Py_None;
        }
    }

    /* Raise an exception if the arguments couldn't be parsed. */
    sipNoMethod(sipParseErr, sipName_Property, sipName_expand, NULL);

    return NULL;
}


/* Cast a pointer to a type somewhere in its superclass hierarchy. */
extern "C" {static void *cast_rviz_Property(void *, const sipTypeDef *);}
static void *cast_rviz_Property(void *ptr, const sipTypeDef *targetType)
{
    void *res;

    if (targetType == sipType_rviz_Property)
        return ptr;

    if ((res = ((const sipClassTypeDef *)sipType_QObject)->ctd_cast((QObject *)(rviz::Property *)ptr,targetType)) != NULL)
        return res;

    return NULL;
}


/* Call the instance's destructor. */
extern "C" {static void release_rviz_Property(void *, int);}
static void release_rviz_Property(void *sipCppV,int)
{
    rviz::Property *sipCpp = reinterpret_cast<rviz::Property *>(sipCppV);

    if (QThread::currentThread() == sipCpp->thread())
        delete sipCpp;
    else
        sipCpp->deleteLater();
}


extern "C" {static void dealloc_rviz_Property(sipSimpleWrapper *);}
static void dealloc_rviz_Property(sipSimpleWrapper *sipSelf)
{
    if (sipIsDerived(sipSelf))
        reinterpret_cast<siprviz_Property *>(sipGetAddress(sipSelf))->sipPySelf = NULL;

    if (sipIsPyOwned(sipSelf))
    {
        release_rviz_Property(sipGetAddress(sipSelf),sipSelf->flags);
    }
}


extern "C" {static void *init_type_rviz_Property(sipSimpleWrapper *, PyObject *, PyObject *, PyObject **, PyObject **, PyObject **);}
static void *init_type_rviz_Property(sipSimpleWrapper *sipSelf, PyObject *sipArgs, PyObject *sipKwds, PyObject **sipUnused, PyObject **, PyObject **sipParseErr)
{
    siprviz_Property *sipCpp = 0;

    {
        const QString& a0def = QString();
        const QString* a0 = &a0def;
        int a0State = 0;
        const QVariant a1def = QVariant();
        const QVariant* a1 = &a1def;
        int a1State = 0;
        const QString& a2def = QString();
        const QString* a2 = &a2def;
        int a2State = 0;
        rviz::Property* a3 = 0;

        if (sipParseKwdArgs(sipParseErr, sipArgs, sipKwds, NULL, sipUnused, "|J1J1J1J8", sipType_QString,&a0, &a0State, sipType_QVariant, &a1, &a1State, sipType_QString,&a2, &a2State, sipType_rviz_Property, &a3))
        {
            sipCpp = new siprviz_Property(*a0,*a1,*a2,a3);
            sipReleaseType(const_cast<QString *>(a0),sipType_QString,a0State);
            sipReleaseType(const_cast<QVariant *>(a1),sipType_QVariant,a1State);
            sipReleaseType(const_cast<QString *>(a2),sipType_QString,a2State);

            sipCpp->sipPySelf = sipSelf;

            return sipCpp;
        }
    }

    return NULL;
}


/* Define this type's super-types. */
static sipEncodedTypeDef supers_rviz_Property[] = {{163, 0, 1}};


static PyMethodDef methods_rviz_Property[] = {
    {SIP_MLNAME_CAST(sipName_addChild), meth_rviz_Property_addChild, METH_VARARGS, NULL},
    {SIP_MLNAME_CAST(sipName_childAt), meth_rviz_Property_childAt, METH_VARARGS, NULL},
    {SIP_MLNAME_CAST(sipName_childAtUnchecked), meth_rviz_Property_childAtUnchecked, METH_VARARGS, NULL},
    {SIP_MLNAME_CAST(sipName_childEvent), (PyCFunction)meth_rviz_Property_childEvent, METH_VARARGS|METH_KEYWORDS, NULL},
    {SIP_MLNAME_CAST(sipName_collapse), meth_rviz_Property_collapse, METH_VARARGS, NULL},
    {SIP_MLNAME_CAST(sipName_connectNotify), (PyCFunction)meth_rviz_Property_connectNotify, METH_VARARGS|METH_KEYWORDS, NULL},
    {SIP_MLNAME_CAST(sipName_createEditor), meth_rviz_Property_createEditor, METH_VARARGS, NULL},
    {SIP_MLNAME_CAST(sipName_customEvent), (PyCFunction)meth_rviz_Property_customEvent, METH_VARARGS|METH_KEYWORDS, NULL},
    {SIP_MLNAME_CAST(sipName_disconnectNotify), (PyCFunction)meth_rviz_Property_disconnectNotify, METH_VARARGS|METH_KEYWORDS, NULL},
    {SIP_MLNAME_CAST(sipName_expand), meth_rviz_Property_expand, METH_VARARGS, NULL},
    {SIP_MLNAME_CAST(sipName_getDescription), meth_rviz_Property_getDescription, METH_VARARGS, NULL},
    {SIP_MLNAME_CAST(sipName_getHidden), meth_rviz_Property_getHidden, METH_VARARGS, NULL},
    {SIP_MLNAME_CAST(sipName_getName), meth_rviz_Property_getName, METH_VARARGS, NULL},
    {SIP_MLNAME_CAST(sipName_getParent), meth_rviz_Property_getParent, METH_VARARGS, NULL},
    {SIP_MLNAME_CAST(sipName_getReadOnly), meth_rviz_Property_getReadOnly, METH_VARARGS, NULL},
    {SIP_MLNAME_CAST(sipName_getValue), meth_rviz_Property_getValue, METH_VARARGS, NULL},
    {SIP_MLNAME_CAST(sipName_getViewData), meth_rviz_Property_getViewData, METH_VARARGS, NULL},
    {SIP_MLNAME_CAST(sipName_getViewFlags), meth_rviz_Property_getViewFlags, METH_VARARGS, NULL},
    {SIP_MLNAME_CAST(sipName_hide), meth_rviz_Property_hide, METH_VARARGS, NULL},
    {SIP_MLNAME_CAST(sipName_isAncestorOf), meth_rviz_Property_isAncestorOf, METH_VARARGS, NULL},
    {SIP_MLNAME_CAST(sipName_isSignalConnected), (PyCFunction)meth_rviz_Property_isSignalConnected, METH_VARARGS|METH_KEYWORDS, NULL},
    {SIP_MLNAME_CAST(sipName_load), meth_rviz_Property_load, METH_VARARGS, NULL},
    {SIP_MLNAME_CAST(sipName_moveChild), meth_rviz_Property_moveChild, METH_VARARGS, NULL},
    {SIP_MLNAME_CAST(sipName_numChildren), meth_rviz_Property_numChildren, METH_VARARGS, NULL},
    {SIP_MLNAME_CAST(sipName_paint), meth_rviz_Property_paint, METH_VARARGS, NULL},
    {SIP_MLNAME_CAST(sipName_receivers), (PyCFunction)meth_rviz_Property_receivers, METH_VARARGS|METH_KEYWORDS, NULL},
    {SIP_MLNAME_CAST(sipName_removeChildren), meth_rviz_Property_removeChildren, METH_VARARGS, NULL},
    {SIP_MLNAME_CAST(sipName_rowNumberInParent), meth_rviz_Property_rowNumberInParent, METH_VARARGS, NULL},
    {SIP_MLNAME_CAST(sipName_save), meth_rviz_Property_save, METH_VARARGS, NULL},
    {SIP_MLNAME_CAST(sipName_sender), (PyCFunction)meth_rviz_Property_sender, METH_VARARGS|METH_KEYWORDS, NULL},
    {SIP_MLNAME_CAST(sipName_senderSignalIndex), (PyCFunction)meth_rviz_Property_senderSignalIndex, METH_VARARGS|METH_KEYWORDS, NULL},
    {SIP_MLNAME_CAST(sipName_setDescription), meth_rviz_Property_setDescription, METH_VARARGS, NULL},
    {SIP_MLNAME_CAST(sipName_setHidden), meth_rviz_Property_setHidden, METH_VARARGS, NULL},
    {SIP_MLNAME_CAST(sipName_setName), meth_rviz_Property_setName, METH_VARARGS, NULL},
    {SIP_MLNAME_CAST(sipName_setParent), meth_rviz_Property_setParent, METH_VARARGS, NULL},
    {SIP_MLNAME_CAST(sipName_setReadOnly), meth_rviz_Property_setReadOnly, METH_VARARGS, NULL},
    {SIP_MLNAME_CAST(sipName_setShouldBeSaved), meth_rviz_Property_setShouldBeSaved, METH_VARARGS, NULL},
    {SIP_MLNAME_CAST(sipName_setValue), meth_rviz_Property_setValue, METH_VARARGS, NULL},
    {SIP_MLNAME_CAST(sipName_shouldBeSaved), meth_rviz_Property_shouldBeSaved, METH_VARARGS, NULL},
    {SIP_MLNAME_CAST(sipName_show), meth_rviz_Property_show, METH_VARARGS, NULL},
    {SIP_MLNAME_CAST(sipName_subProp), meth_rviz_Property_subProp, METH_VARARGS, NULL},
    {SIP_MLNAME_CAST(sipName_takeChild), meth_rviz_Property_takeChild, METH_VARARGS, NULL},
    {SIP_MLNAME_CAST(sipName_takeChildAt), meth_rviz_Property_takeChildAt, METH_VARARGS, NULL},
    {SIP_MLNAME_CAST(sipName_timerEvent), (PyCFunction)meth_rviz_Property_timerEvent, METH_VARARGS|METH_KEYWORDS, NULL}
};


/* Define this type's signals. */
static const pyqt5QtSignal signals_rviz_Property[] = {
    {"changed()", 0, 0, 0},
    {"aboutToChange()", 0, 0, 0},
    {0, 0, 0, 0}
};


pyqt5ClassTypeDef sipTypeDef_librviz_sip_rviz_Property = {
{
    {
        -1,
        0,
        0,
        SIP_TYPE_SCC|SIP_TYPE_SUPER_INIT|SIP_TYPE_CLASS,
        sipNameNr_rviz__Property,
        {0}
    },
    {
        sipNameNr_Property,
        {0, 255, 0},
        44, methods_rviz_Property,
        0, 0,
        0, 0,
        {0, 0, 0, 0, 0, 0, 0, 0, 0, 0},
    },
    0,
    -1,
    -1,
    supers_rviz_Property,
    0,
    init_type_rviz_Property,
    0,
    0,
#if PY_MAJOR_VERSION >= 3
    0,
    0,
#else
    0,
    0,
    0,
    0,
#endif
    dealloc_rviz_Property,
    0,
    0,
    0,
    release_rviz_Property,
    cast_rviz_Property,
    0,
    0,
    0,
    0,
    0,
    0
},
    &rviz::Property::staticMetaObject,
    0,
    signals_rviz_Property,
    0
};
