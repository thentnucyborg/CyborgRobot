/*
 * Interface wrapper code.
 *
 * Generated by SIP 4.17
 */

#include "sipAPIlibrviz_sip.h"

#line 7 "display_group.sip"
#define ROS_PACKAGE_NAME "rviz"
#include <rviz/display_group.h>
#line 13 "/home/lassegoncz/catkin_ws/devel/bin/sip/rviz_sip/siplibrviz_siprvizDisplayGroup.cpp"

#line 7 "display.sip"
#define ROS_PACKAGE_NAME "rviz"
#include <rviz/display.h>
#line 18 "/home/lassegoncz/catkin_ws/devel/bin/sip/rviz_sip/siplibrviz_siprvizDisplayGroup.cpp"
#line 7 "config.sip"
#define ROS_PACKAGE_NAME "rviz"
#include <rviz/config.h>
#line 22 "/home/lassegoncz/catkin_ws/devel/bin/sip/rviz_sip/siplibrviz_siprvizDisplayGroup.cpp"
#line 26 "/usr/share/sip/PyQt5/QtCore/qnamespace.sip"
#include <qnamespace.h>
#line 25 "/home/lassegoncz/catkin_ws/devel/bin/sip/rviz_sip/siplibrviz_siprvizDisplayGroup.cpp"
#line 26 "/usr/share/sip/PyQt5/QtCore/qvariant.sip"
#include <qvariant.h>
#line 28 "/home/lassegoncz/catkin_ws/devel/bin/sip/rviz_sip/siplibrviz_siprvizDisplayGroup.cpp"
#line 7 "property.sip"
#define ROS_PACKAGE_NAME "rviz"
#include <rviz/properties/property.h>
#line 32 "/home/lassegoncz/catkin_ws/devel/bin/sip/rviz_sip/siplibrviz_siprvizDisplayGroup.cpp"
#line 27 "/usr/share/sip/PyQt5/QtCore/qstring.sip"
#include <qstring.h>
#line 35 "/home/lassegoncz/catkin_ws/devel/bin/sip/rviz_sip/siplibrviz_siprvizDisplayGroup.cpp"
#line 26 "/usr/share/sip/PyQt5/QtGui/qicon.sip"
#include <qicon.h>
#line 38 "/home/lassegoncz/catkin_ws/devel/bin/sip/rviz_sip/siplibrviz_siprvizDisplayGroup.cpp"
#line 28 "/usr/share/sip/PyQt5/QtWidgets/qwidget.sip"
#include <qwidget.h>
#line 41 "/home/lassegoncz/catkin_ws/devel/bin/sip/rviz_sip/siplibrviz_siprvizDisplayGroup.cpp"
#line 560 "/usr/share/sip/PyQt5/QtWidgets/qstyleoption.sip"
#include <qstyleoption.h>
#line 44 "/home/lassegoncz/catkin_ws/devel/bin/sip/rviz_sip/siplibrviz_siprvizDisplayGroup.cpp"
#line 26 "/usr/share/sip/PyQt5/QtGui/qpainter.sip"
#include <qpainter.h>
#line 47 "/home/lassegoncz/catkin_ws/devel/bin/sip/rviz_sip/siplibrviz_siprvizDisplayGroup.cpp"
#line 26 "/usr/share/sip/PyQt5/QtCore/qmetaobject.sip"
#include <qmetaobject.h>
#line 50 "/home/lassegoncz/catkin_ws/devel/bin/sip/rviz_sip/siplibrviz_siprvizDisplayGroup.cpp"
#line 26 "/usr/share/sip/PyQt5/QtCore/qcoreevent.sip"
#include <qcoreevent.h>
#line 53 "/home/lassegoncz/catkin_ws/devel/bin/sip/rviz_sip/siplibrviz_siprvizDisplayGroup.cpp"
#line 244 "/usr/share/sip/PyQt5/QtCore/qcoreevent.sip"
#include <qcoreevent.h>
#line 56 "/home/lassegoncz/catkin_ws/devel/bin/sip/rviz_sip/siplibrviz_siprvizDisplayGroup.cpp"
#line 232 "/usr/share/sip/PyQt5/QtCore/qcoreevent.sip"
#include <qcoreevent.h>
#line 59 "/home/lassegoncz/catkin_ws/devel/bin/sip/rviz_sip/siplibrviz_siprvizDisplayGroup.cpp"
#line 28 "/usr/share/sip/PyQt5/QtCore/qobject.sip"
#include <qobject.h>
#line 62 "/home/lassegoncz/catkin_ws/devel/bin/sip/rviz_sip/siplibrviz_siprvizDisplayGroup.cpp"
#line 36 "/usr/share/sip/PyQt5/QtCore/qpycore_qlist.sip"
#include <qlist.h>
#line 65 "/home/lassegoncz/catkin_ws/devel/bin/sip/rviz_sip/siplibrviz_siprvizDisplayGroup.cpp"
#line 32 "/usr/share/sip/PyQt5/QtCore/qbytearray.sip"
#include <qbytearray.h>
#line 68 "/home/lassegoncz/catkin_ws/devel/bin/sip/rviz_sip/siplibrviz_siprvizDisplayGroup.cpp"
#line 144 "/usr/share/sip/PyQt5/QtCore/qpycore_qlist.sip"
#include <qlist.h>
#line 71 "/home/lassegoncz/catkin_ws/devel/bin/sip/rviz_sip/siplibrviz_siprvizDisplayGroup.cpp"
#line 26 "/usr/share/sip/PyQt5/QtCore/qnamespace.sip"
#include <qnamespace.h>
#line 74 "/home/lassegoncz/catkin_ws/devel/bin/sip/rviz_sip/siplibrviz_siprvizDisplayGroup.cpp"
#line 26 "/usr/share/sip/PyQt5/QtCore/qthread.sip"
#include <qthread.h>
#line 77 "/home/lassegoncz/catkin_ws/devel/bin/sip/rviz_sip/siplibrviz_siprvizDisplayGroup.cpp"
#line 26 "/usr/share/sip/PyQt5/QtCore/qnamespace.sip"
#include <qnamespace.h>
#line 80 "/home/lassegoncz/catkin_ws/devel/bin/sip/rviz_sip/siplibrviz_siprvizDisplayGroup.cpp"
#line 26 "/usr/share/sip/PyQt5/QtCore/qregexp.sip"
#include <qregexp.h>
#line 83 "/home/lassegoncz/catkin_ws/devel/bin/sip/rviz_sip/siplibrviz_siprvizDisplayGroup.cpp"
#line 26 "/usr/share/sip/PyQt5/QtCore/qregularexpression.sip"
#include <qregularexpression.h>
#line 86 "/home/lassegoncz/catkin_ws/devel/bin/sip/rviz_sip/siplibrviz_siprvizDisplayGroup.cpp"
#line 26 "/usr/share/sip/PyQt5/QtCore/qobjectdefs.sip"
#include <qobjectdefs.h>
#line 89 "/home/lassegoncz/catkin_ws/devel/bin/sip/rviz_sip/siplibrviz_siprvizDisplayGroup.cpp"


class siprviz_DisplayGroup : public rviz::DisplayGroup
{
public:
    siprviz_DisplayGroup();
    virtual ~siprviz_DisplayGroup();

    int qt_metacall(QMetaObject::Call,int,void **);
    void *qt_metacast(const char *);
    const QMetaObject *metaObject() const;

    /*
     * There is a public method for every protected method visible from
     * this class.
     */
    QObject* sipProtect_sender() const;
    int sipProtect_receivers(const char*) const;
    void sipProtectVirt_timerEvent(bool,QTimerEvent*);
    void sipProtectVirt_childEvent(bool,QChildEvent*);
    void sipProtectVirt_customEvent(bool,QEvent*);
    void sipProtectVirt_connectNotify(bool,const QMetaMethod&);
    void sipProtectVirt_disconnectNotify(bool,const QMetaMethod&);
    int sipProtect_senderSignalIndex() const;
    bool sipProtect_isSignalConnected(const QMetaMethod&) const;

    /*
     * There is a protected method for every virtual method visible from
     * this class.
     */
protected:
    void disconnectNotify(const QMetaMethod&);
    void connectNotify(const QMetaMethod&);
    void customEvent(QEvent*);
    void childEvent(QChildEvent*);
    void timerEvent(QTimerEvent*);
    bool eventFilter(QObject*,QEvent*);
    bool event(QEvent*);
    void expand();
    void collapse();
    bool getReadOnly();
    void setReadOnly(bool);
    bool getHidden() const;
    void setHidden(bool);
    void moveChild(int,int);
    QWidget* createEditor(QWidget*,const QStyleOptionViewItem&);
    bool paint(QPainter*,const QStyleOptionViewItem&) const;
    QString getDescription() const;
    void setDescription(const QString&);
    QString getName() const;
    void setName(const QString&);
    QVariant getValue() const;
    bool setValue(const QVariant&);
    void removeChildren(int,int);
    void deleteStatus(const QString&);
    void setClassId(const QString&);
    QString getClassId() const;
    void reset();
    void update(float,float);
    rviz::DisplayGroup* getGroupAt(int) const;
    rviz::Display* getDisplayAt(int) const;
    int numDisplays() const;
    void removeAllDisplays();
    rviz::Display* takeDisplay(rviz::Display*);
    void addDisplay(rviz::Display*);
    void save(rviz::Config) const;
    void load(const rviz::Config&);
    Qt::ItemFlags getViewFlags(int) const;
    QVariant getViewData(int,int) const;
    void addChild(rviz::Property*,int);
    rviz::Property* takeChildAt(int);
    rviz::Property* childAtUnchecked(int) const;
    int numChildren() const;

public:
    sipSimpleWrapper *sipPySelf;

private:
    siprviz_DisplayGroup(const siprviz_DisplayGroup &);
    siprviz_DisplayGroup &operator = (const siprviz_DisplayGroup &);

    char sipPyMethods[42];
};

siprviz_DisplayGroup::siprviz_DisplayGroup(): rviz::DisplayGroup(), sipPySelf(0)
{
    memset(sipPyMethods, 0, sizeof (sipPyMethods));
}

siprviz_DisplayGroup::~siprviz_DisplayGroup()
{
    sipCommonDtor(sipPySelf);
}

const QMetaObject *siprviz_DisplayGroup::metaObject() const
{
    return QObject::d_ptr->metaObject ? QObject::d_ptr->dynamicMetaObject() : sip_librviz_sip_qt_metaobject(sipPySelf,sipType_rviz_DisplayGroup);
}

int siprviz_DisplayGroup::qt_metacall(QMetaObject::Call _c,int _id,void **_a)
{
    _id = rviz::DisplayGroup::qt_metacall(_c,_id,_a);

    if (_id >= 0)
        _id = sip_librviz_sip_qt_metacall(sipPySelf,sipType_rviz_DisplayGroup,_c,_id,_a);

    return _id;
}

void *siprviz_DisplayGroup::qt_metacast(const char *_clname)
{
    void *sipCpp;

    return (sip_librviz_sip_qt_metacast(sipPySelf, sipType_rviz_DisplayGroup, _clname, &sipCpp) ? sipCpp : rviz::DisplayGroup::qt_metacast(_clname));
}

void siprviz_DisplayGroup::disconnectNotify(const QMetaMethod& a0)
{
    sip_gilstate_t sipGILState;
    PyObject *sipMeth;

    sipMeth = sipIsPyMethod(&sipGILState,&sipPyMethods[0],sipPySelf,NULL,sipName_disconnectNotify);

    if (!sipMeth)
    {
        rviz::DisplayGroup::disconnectNotify(a0);
        return;
    }

    typedef void (*sipVH_QtCore_46)(sip_gilstate_t, sipVirtErrorHandlerFunc, sipSimpleWrapper *, PyObject *, const QMetaMethod&);

    ((sipVH_QtCore_46)(sipModuleAPI_librviz_sip_QtCore->em_virthandlers[46]))(sipGILState, sipModuleAPI_librviz_sip_QtCore->em_virterrorhandlers[0], sipPySelf, sipMeth, a0);
}

void siprviz_DisplayGroup::connectNotify(const QMetaMethod& a0)
{
    sip_gilstate_t sipGILState;
    PyObject *sipMeth;

    sipMeth = sipIsPyMethod(&sipGILState,&sipPyMethods[1],sipPySelf,NULL,sipName_connectNotify);

    if (!sipMeth)
    {
        rviz::DisplayGroup::connectNotify(a0);
        return;
    }

    typedef void (*sipVH_QtCore_46)(sip_gilstate_t, sipVirtErrorHandlerFunc, sipSimpleWrapper *, PyObject *, const QMetaMethod&);

    ((sipVH_QtCore_46)(sipModuleAPI_librviz_sip_QtCore->em_virthandlers[46]))(sipGILState, sipModuleAPI_librviz_sip_QtCore->em_virterrorhandlers[0], sipPySelf, sipMeth, a0);
}

void siprviz_DisplayGroup::customEvent(QEvent*a0)
{
    sip_gilstate_t sipGILState;
    PyObject *sipMeth;

    sipMeth = sipIsPyMethod(&sipGILState,&sipPyMethods[2],sipPySelf,NULL,sipName_customEvent);

    if (!sipMeth)
    {
        rviz::DisplayGroup::customEvent(a0);
        return;
    }

    typedef void (*sipVH_QtCore_25)(sip_gilstate_t, sipVirtErrorHandlerFunc, sipSimpleWrapper *, PyObject *, QEvent*);

    ((sipVH_QtCore_25)(sipModuleAPI_librviz_sip_QtCore->em_virthandlers[25]))(sipGILState, sipModuleAPI_librviz_sip_QtCore->em_virterrorhandlers[0], sipPySelf, sipMeth, a0);
}

void siprviz_DisplayGroup::childEvent(QChildEvent*a0)
{
    sip_gilstate_t sipGILState;
    PyObject *sipMeth;

    sipMeth = sipIsPyMethod(&sipGILState,&sipPyMethods[3],sipPySelf,NULL,sipName_childEvent);

    if (!sipMeth)
    {
        rviz::DisplayGroup::childEvent(a0);
        return;
    }

    typedef void (*sipVH_QtCore_47)(sip_gilstate_t, sipVirtErrorHandlerFunc, sipSimpleWrapper *, PyObject *, QChildEvent*);

    ((sipVH_QtCore_47)(sipModuleAPI_librviz_sip_QtCore->em_virthandlers[47]))(sipGILState, sipModuleAPI_librviz_sip_QtCore->em_virterrorhandlers[0], sipPySelf, sipMeth, a0);
}

void siprviz_DisplayGroup::timerEvent(QTimerEvent*a0)
{
    sip_gilstate_t sipGILState;
    PyObject *sipMeth;

    sipMeth = sipIsPyMethod(&sipGILState,&sipPyMethods[4],sipPySelf,NULL,sipName_timerEvent);

    if (!sipMeth)
    {
        rviz::DisplayGroup::timerEvent(a0);
        return;
    }

    typedef void (*sipVH_QtCore_9)(sip_gilstate_t, sipVirtErrorHandlerFunc, sipSimpleWrapper *, PyObject *, QTimerEvent*);

    ((sipVH_QtCore_9)(sipModuleAPI_librviz_sip_QtCore->em_virthandlers[9]))(sipGILState, sipModuleAPI_librviz_sip_QtCore->em_virterrorhandlers[0], sipPySelf, sipMeth, a0);
}

bool siprviz_DisplayGroup::eventFilter(QObject*a0,QEvent*a1)
{
    sip_gilstate_t sipGILState;
    PyObject *sipMeth;

    sipMeth = sipIsPyMethod(&sipGILState,&sipPyMethods[5],sipPySelf,NULL,sipName_eventFilter);

    if (!sipMeth)
        return rviz::DisplayGroup::eventFilter(a0,a1);

    typedef bool (*sipVH_QtCore_26)(sip_gilstate_t, sipVirtErrorHandlerFunc, sipSimpleWrapper *, PyObject *, QObject*,QEvent*);

    return ((sipVH_QtCore_26)(sipModuleAPI_librviz_sip_QtCore->em_virthandlers[26]))(sipGILState, sipModuleAPI_librviz_sip_QtCore->em_virterrorhandlers[0], sipPySelf, sipMeth, a0, a1);
}

bool siprviz_DisplayGroup::event(QEvent*a0)
{
    sip_gilstate_t sipGILState;
    PyObject *sipMeth;

    sipMeth = sipIsPyMethod(&sipGILState,&sipPyMethods[6],sipPySelf,NULL,sipName_event);

    if (!sipMeth)
        return rviz::DisplayGroup::event(a0);

    typedef bool (*sipVH_QtCore_5)(sip_gilstate_t, sipVirtErrorHandlerFunc, sipSimpleWrapper *, PyObject *, QEvent*);

    return ((sipVH_QtCore_5)(sipModuleAPI_librviz_sip_QtCore->em_virthandlers[5]))(sipGILState, sipModuleAPI_librviz_sip_QtCore->em_virterrorhandlers[0], sipPySelf, sipMeth, a0);
}

void siprviz_DisplayGroup::expand()
{
    sip_gilstate_t sipGILState;
    PyObject *sipMeth;

    sipMeth = sipIsPyMethod(&sipGILState,&sipPyMethods[7],sipPySelf,NULL,sipName_expand);

    if (!sipMeth)
    {
        rviz::DisplayGroup::expand();
        return;
    }

    typedef void (*sipVH_QtCore_11)(sip_gilstate_t, sipVirtErrorHandlerFunc, sipSimpleWrapper *, PyObject *);

    ((sipVH_QtCore_11)(sipModuleAPI_librviz_sip_QtCore->em_virthandlers[11]))(sipGILState, sipModuleAPI_librviz_sip_QtCore->em_virterrorhandlers[0], sipPySelf, sipMeth);
}

void siprviz_DisplayGroup::collapse()
{
    sip_gilstate_t sipGILState;
    PyObject *sipMeth;

    sipMeth = sipIsPyMethod(&sipGILState,&sipPyMethods[8],sipPySelf,NULL,sipName_collapse);

    if (!sipMeth)
    {
        rviz::DisplayGroup::collapse();
        return;
    }

    typedef void (*sipVH_QtCore_11)(sip_gilstate_t, sipVirtErrorHandlerFunc, sipSimpleWrapper *, PyObject *);

    ((sipVH_QtCore_11)(sipModuleAPI_librviz_sip_QtCore->em_virthandlers[11]))(sipGILState, sipModuleAPI_librviz_sip_QtCore->em_virterrorhandlers[0], sipPySelf, sipMeth);
}

bool siprviz_DisplayGroup::getReadOnly()
{
    sip_gilstate_t sipGILState;
    PyObject *sipMeth;

    sipMeth = sipIsPyMethod(&sipGILState,&sipPyMethods[9],sipPySelf,NULL,sipName_getReadOnly);

    if (!sipMeth)
        return rviz::DisplayGroup::getReadOnly();

    typedef bool (*sipVH_QtCore_7)(sip_gilstate_t, sipVirtErrorHandlerFunc, sipSimpleWrapper *, PyObject *);

    return ((sipVH_QtCore_7)(sipModuleAPI_librviz_sip_QtCore->em_virthandlers[7]))(sipGILState, sipModuleAPI_librviz_sip_QtCore->em_virterrorhandlers[0], sipPySelf, sipMeth);
}

void siprviz_DisplayGroup::setReadOnly(bool a0)
{
    sip_gilstate_t sipGILState;
    PyObject *sipMeth;

    sipMeth = sipIsPyMethod(&sipGILState,&sipPyMethods[10],sipPySelf,NULL,sipName_setReadOnly);

    if (!sipMeth)
    {
        rviz::DisplayGroup::setReadOnly(a0);
        return;
    }

    typedef void (*sipVH_QtWidgets_0)(sip_gilstate_t, sipVirtErrorHandlerFunc, sipSimpleWrapper *, PyObject *, bool);

    ((sipVH_QtWidgets_0)(sipModuleAPI_librviz_sip_QtWidgets->em_virthandlers[0]))(sipGILState, sipModuleAPI_librviz_sip_QtCore->em_virterrorhandlers[0], sipPySelf, sipMeth, a0);
}

bool siprviz_DisplayGroup::getHidden() const
{
    sip_gilstate_t sipGILState;
    PyObject *sipMeth;

    sipMeth = sipIsPyMethod(&sipGILState,const_cast<char *>(&sipPyMethods[11]),sipPySelf,NULL,sipName_getHidden);

    if (!sipMeth)
        return rviz::DisplayGroup::getHidden();

    typedef bool (*sipVH_QtCore_7)(sip_gilstate_t, sipVirtErrorHandlerFunc, sipSimpleWrapper *, PyObject *);

    return ((sipVH_QtCore_7)(sipModuleAPI_librviz_sip_QtCore->em_virthandlers[7]))(sipGILState, sipModuleAPI_librviz_sip_QtCore->em_virterrorhandlers[0], sipPySelf, sipMeth);
}

void siprviz_DisplayGroup::setHidden(bool a0)
{
    sip_gilstate_t sipGILState;
    PyObject *sipMeth;

    sipMeth = sipIsPyMethod(&sipGILState,&sipPyMethods[12],sipPySelf,NULL,sipName_setHidden);

    if (!sipMeth)
    {
        rviz::DisplayGroup::setHidden(a0);
        return;
    }

    typedef void (*sipVH_QtWidgets_0)(sip_gilstate_t, sipVirtErrorHandlerFunc, sipSimpleWrapper *, PyObject *, bool);

    ((sipVH_QtWidgets_0)(sipModuleAPI_librviz_sip_QtWidgets->em_virthandlers[0]))(sipGILState, sipModuleAPI_librviz_sip_QtCore->em_virterrorhandlers[0], sipPySelf, sipMeth, a0);
}

void siprviz_DisplayGroup::moveChild(int a0,int a1)
{
    sip_gilstate_t sipGILState;
    PyObject *sipMeth;

    sipMeth = sipIsPyMethod(&sipGILState,&sipPyMethods[13],sipPySelf,NULL,sipName_moveChild);

    if (!sipMeth)
    {
        rviz::DisplayGroup::moveChild(a0,a1);
        return;
    }

    typedef void (*sipVH_QtGui_17)(sip_gilstate_t, sipVirtErrorHandlerFunc, sipSimpleWrapper *, PyObject *, int,int);

    ((sipVH_QtGui_17)(sipModuleAPI_librviz_sip_QtGui->em_virthandlers[17]))(sipGILState, sipModuleAPI_librviz_sip_QtCore->em_virterrorhandlers[0], sipPySelf, sipMeth, a0, a1);
}

QWidget* siprviz_DisplayGroup::createEditor(QWidget*a0,const QStyleOptionViewItem& a1)
{
    sip_gilstate_t sipGILState;
    PyObject *sipMeth;

    sipMeth = sipIsPyMethod(&sipGILState,&sipPyMethods[14],sipPySelf,NULL,sipName_createEditor);

    if (!sipMeth)
        return rviz::DisplayGroup::createEditor(a0,a1);

    extern QWidget* sipVH_librviz_sip_9(sip_gilstate_t, sipVirtErrorHandlerFunc, sipSimpleWrapper *, PyObject *, QWidget*,const QStyleOptionViewItem&);

    return sipVH_librviz_sip_9(sipGILState, sipModuleAPI_librviz_sip_QtCore->em_virterrorhandlers[0], sipPySelf, sipMeth, a0, a1);
}

bool siprviz_DisplayGroup::paint(QPainter*a0,const QStyleOptionViewItem& a1) const
{
    sip_gilstate_t sipGILState;
    PyObject *sipMeth;

    sipMeth = sipIsPyMethod(&sipGILState,const_cast<char *>(&sipPyMethods[15]),sipPySelf,NULL,sipName_paint);

    if (!sipMeth)
        return rviz::DisplayGroup::paint(a0,a1);

    extern bool sipVH_librviz_sip_10(sip_gilstate_t, sipVirtErrorHandlerFunc, sipSimpleWrapper *, PyObject *, QPainter*,const QStyleOptionViewItem&);

    return sipVH_librviz_sip_10(sipGILState, sipModuleAPI_librviz_sip_QtCore->em_virterrorhandlers[0], sipPySelf, sipMeth, a0, a1);
}

QString siprviz_DisplayGroup::getDescription() const
{
    sip_gilstate_t sipGILState;
    PyObject *sipMeth;

    sipMeth = sipIsPyMethod(&sipGILState,const_cast<char *>(&sipPyMethods[16]),sipPySelf,NULL,sipName_getDescription);

    if (!sipMeth)
        return rviz::DisplayGroup::getDescription();

    typedef QString (*sipVH_QtCore_16)(sip_gilstate_t, sipVirtErrorHandlerFunc, sipSimpleWrapper *, PyObject *);

    return ((sipVH_QtCore_16)(sipModuleAPI_librviz_sip_QtCore->em_virthandlers[16]))(sipGILState, sipModuleAPI_librviz_sip_QtCore->em_virterrorhandlers[0], sipPySelf, sipMeth);
}

void siprviz_DisplayGroup::setDescription(const QString& a0)
{
    sip_gilstate_t sipGILState;
    PyObject *sipMeth;

    sipMeth = sipIsPyMethod(&sipGILState,&sipPyMethods[17],sipPySelf,NULL,sipName_setDescription);

    if (!sipMeth)
    {
        rviz::DisplayGroup::setDescription(a0);
        return;
    }

    typedef void (*sipVH_QtGui_22)(sip_gilstate_t, sipVirtErrorHandlerFunc, sipSimpleWrapper *, PyObject *, const QString&);

    ((sipVH_QtGui_22)(sipModuleAPI_librviz_sip_QtGui->em_virthandlers[22]))(sipGILState, sipModuleAPI_librviz_sip_QtCore->em_virterrorhandlers[0], sipPySelf, sipMeth, a0);
}

QString siprviz_DisplayGroup::getName() const
{
    sip_gilstate_t sipGILState;
    PyObject *sipMeth;

    sipMeth = sipIsPyMethod(&sipGILState,const_cast<char *>(&sipPyMethods[18]),sipPySelf,NULL,sipName_getName);

    if (!sipMeth)
        return rviz::DisplayGroup::getName();

    typedef QString (*sipVH_QtCore_16)(sip_gilstate_t, sipVirtErrorHandlerFunc, sipSimpleWrapper *, PyObject *);

    return ((sipVH_QtCore_16)(sipModuleAPI_librviz_sip_QtCore->em_virthandlers[16]))(sipGILState, sipModuleAPI_librviz_sip_QtCore->em_virterrorhandlers[0], sipPySelf, sipMeth);
}

void siprviz_DisplayGroup::setName(const QString& a0)
{
    sip_gilstate_t sipGILState;
    PyObject *sipMeth;

    sipMeth = sipIsPyMethod(&sipGILState,&sipPyMethods[19],sipPySelf,NULL,sipName_setName);

    if (!sipMeth)
    {
        rviz::DisplayGroup::setName(a0);
        return;
    }

    typedef void (*sipVH_QtGui_22)(sip_gilstate_t, sipVirtErrorHandlerFunc, sipSimpleWrapper *, PyObject *, const QString&);

    ((sipVH_QtGui_22)(sipModuleAPI_librviz_sip_QtGui->em_virthandlers[22]))(sipGILState, sipModuleAPI_librviz_sip_QtCore->em_virterrorhandlers[0], sipPySelf, sipMeth, a0);
}

QVariant siprviz_DisplayGroup::getValue() const
{
    sip_gilstate_t sipGILState;
    PyObject *sipMeth;

    sipMeth = sipIsPyMethod(&sipGILState,const_cast<char *>(&sipPyMethods[20]),sipPySelf,NULL,sipName_getValue);

    if (!sipMeth)
        return rviz::DisplayGroup::getValue();

    extern QVariant sipVH_librviz_sip_11(sip_gilstate_t, sipVirtErrorHandlerFunc, sipSimpleWrapper *, PyObject *);

    return sipVH_librviz_sip_11(sipGILState, sipModuleAPI_librviz_sip_QtCore->em_virterrorhandlers[0], sipPySelf, sipMeth);
}

bool siprviz_DisplayGroup::setValue(const QVariant& a0)
{
    sip_gilstate_t sipGILState;
    PyObject *sipMeth;

    sipMeth = sipIsPyMethod(&sipGILState,&sipPyMethods[21],sipPySelf,NULL,sipName_setValue);

    if (!sipMeth)
        return rviz::DisplayGroup::setValue(a0);

    extern bool sipVH_librviz_sip_12(sip_gilstate_t, sipVirtErrorHandlerFunc, sipSimpleWrapper *, PyObject *, const QVariant&);

    return sipVH_librviz_sip_12(sipGILState, sipModuleAPI_librviz_sip_QtCore->em_virterrorhandlers[0], sipPySelf, sipMeth, a0);
}

void siprviz_DisplayGroup::removeChildren(int a0,int a1)
{
    sip_gilstate_t sipGILState;
    PyObject *sipMeth;

    sipMeth = sipIsPyMethod(&sipGILState,&sipPyMethods[22],sipPySelf,NULL,sipName_removeChildren);

    if (!sipMeth)
    {
        rviz::DisplayGroup::removeChildren(a0,a1);
        return;
    }

    typedef void (*sipVH_QtGui_17)(sip_gilstate_t, sipVirtErrorHandlerFunc, sipSimpleWrapper *, PyObject *, int,int);

    ((sipVH_QtGui_17)(sipModuleAPI_librviz_sip_QtGui->em_virthandlers[17]))(sipGILState, sipModuleAPI_librviz_sip_QtCore->em_virterrorhandlers[0], sipPySelf, sipMeth, a0, a1);
}

void siprviz_DisplayGroup::deleteStatus(const QString& a0)
{
    sip_gilstate_t sipGILState;
    PyObject *sipMeth;

    sipMeth = sipIsPyMethod(&sipGILState,&sipPyMethods[23],sipPySelf,NULL,sipName_deleteStatus);

    if (!sipMeth)
    {
        rviz::DisplayGroup::deleteStatus(a0);
        return;
    }

    typedef void (*sipVH_QtGui_22)(sip_gilstate_t, sipVirtErrorHandlerFunc, sipSimpleWrapper *, PyObject *, const QString&);

    ((sipVH_QtGui_22)(sipModuleAPI_librviz_sip_QtGui->em_virthandlers[22]))(sipGILState, sipModuleAPI_librviz_sip_QtCore->em_virterrorhandlers[0], sipPySelf, sipMeth, a0);
}

void siprviz_DisplayGroup::setClassId(const QString& a0)
{
    sip_gilstate_t sipGILState;
    PyObject *sipMeth;

    sipMeth = sipIsPyMethod(&sipGILState,&sipPyMethods[24],sipPySelf,NULL,sipName_setClassId);

    if (!sipMeth)
    {
        rviz::DisplayGroup::setClassId(a0);
        return;
    }

    typedef void (*sipVH_QtGui_22)(sip_gilstate_t, sipVirtErrorHandlerFunc, sipSimpleWrapper *, PyObject *, const QString&);

    ((sipVH_QtGui_22)(sipModuleAPI_librviz_sip_QtGui->em_virthandlers[22]))(sipGILState, sipModuleAPI_librviz_sip_QtCore->em_virterrorhandlers[0], sipPySelf, sipMeth, a0);
}

QString siprviz_DisplayGroup::getClassId() const
{
    sip_gilstate_t sipGILState;
    PyObject *sipMeth;

    sipMeth = sipIsPyMethod(&sipGILState,const_cast<char *>(&sipPyMethods[25]),sipPySelf,NULL,sipName_getClassId);

    if (!sipMeth)
        return rviz::DisplayGroup::getClassId();

    typedef QString (*sipVH_QtCore_16)(sip_gilstate_t, sipVirtErrorHandlerFunc, sipSimpleWrapper *, PyObject *);

    return ((sipVH_QtCore_16)(sipModuleAPI_librviz_sip_QtCore->em_virthandlers[16]))(sipGILState, sipModuleAPI_librviz_sip_QtCore->em_virterrorhandlers[0], sipPySelf, sipMeth);
}

void siprviz_DisplayGroup::reset()
{
    sip_gilstate_t sipGILState;
    PyObject *sipMeth;

    sipMeth = sipIsPyMethod(&sipGILState,&sipPyMethods[26],sipPySelf,NULL,sipName_reset);

    if (!sipMeth)
    {
        rviz::DisplayGroup::reset();
        return;
    }

    typedef void (*sipVH_QtCore_11)(sip_gilstate_t, sipVirtErrorHandlerFunc, sipSimpleWrapper *, PyObject *);

    ((sipVH_QtCore_11)(sipModuleAPI_librviz_sip_QtCore->em_virthandlers[11]))(sipGILState, sipModuleAPI_librviz_sip_QtCore->em_virterrorhandlers[0], sipPySelf, sipMeth);
}

void siprviz_DisplayGroup::update(float a0,float a1)
{
    sip_gilstate_t sipGILState;
    PyObject *sipMeth;

    sipMeth = sipIsPyMethod(&sipGILState,&sipPyMethods[27],sipPySelf,NULL,sipName_update);

    if (!sipMeth)
    {
        rviz::DisplayGroup::update(a0,a1);
        return;
    }

    extern void sipVH_librviz_sip_2(sip_gilstate_t, sipVirtErrorHandlerFunc, sipSimpleWrapper *, PyObject *, float,float);

    sipVH_librviz_sip_2(sipGILState, sipModuleAPI_librviz_sip_QtCore->em_virterrorhandlers[0], sipPySelf, sipMeth, a0, a1);
}

rviz::DisplayGroup* siprviz_DisplayGroup::getGroupAt(int a0) const
{
    sip_gilstate_t sipGILState;
    PyObject *sipMeth;

    sipMeth = sipIsPyMethod(&sipGILState,const_cast<char *>(&sipPyMethods[28]),sipPySelf,NULL,sipName_getGroupAt);

    if (!sipMeth)
        return rviz::DisplayGroup::getGroupAt(a0);

    extern rviz::DisplayGroup* sipVH_librviz_sip_13(sip_gilstate_t, sipVirtErrorHandlerFunc, sipSimpleWrapper *, PyObject *, int);

    return sipVH_librviz_sip_13(sipGILState, sipModuleAPI_librviz_sip_QtCore->em_virterrorhandlers[0], sipPySelf, sipMeth, a0);
}

rviz::Display* siprviz_DisplayGroup::getDisplayAt(int a0) const
{
    sip_gilstate_t sipGILState;
    PyObject *sipMeth;

    sipMeth = sipIsPyMethod(&sipGILState,const_cast<char *>(&sipPyMethods[29]),sipPySelf,NULL,sipName_getDisplayAt);

    if (!sipMeth)
        return rviz::DisplayGroup::getDisplayAt(a0);

    extern rviz::Display* sipVH_librviz_sip_14(sip_gilstate_t, sipVirtErrorHandlerFunc, sipSimpleWrapper *, PyObject *, int);

    return sipVH_librviz_sip_14(sipGILState, sipModuleAPI_librviz_sip_QtCore->em_virterrorhandlers[0], sipPySelf, sipMeth, a0);
}

int siprviz_DisplayGroup::numDisplays() const
{
    sip_gilstate_t sipGILState;
    PyObject *sipMeth;

    sipMeth = sipIsPyMethod(&sipGILState,const_cast<char *>(&sipPyMethods[30]),sipPySelf,NULL,sipName_numDisplays);

    if (!sipMeth)
        return rviz::DisplayGroup::numDisplays();

    typedef int (*sipVH_QtCore_6)(sip_gilstate_t, sipVirtErrorHandlerFunc, sipSimpleWrapper *, PyObject *);

    return ((sipVH_QtCore_6)(sipModuleAPI_librviz_sip_QtCore->em_virthandlers[6]))(sipGILState, sipModuleAPI_librviz_sip_QtCore->em_virterrorhandlers[0], sipPySelf, sipMeth);
}

void siprviz_DisplayGroup::removeAllDisplays()
{
    sip_gilstate_t sipGILState;
    PyObject *sipMeth;

    sipMeth = sipIsPyMethod(&sipGILState,&sipPyMethods[31],sipPySelf,NULL,sipName_removeAllDisplays);

    if (!sipMeth)
    {
        rviz::DisplayGroup::removeAllDisplays();
        return;
    }

    typedef void (*sipVH_QtCore_11)(sip_gilstate_t, sipVirtErrorHandlerFunc, sipSimpleWrapper *, PyObject *);

    ((sipVH_QtCore_11)(sipModuleAPI_librviz_sip_QtCore->em_virthandlers[11]))(sipGILState, sipModuleAPI_librviz_sip_QtCore->em_virterrorhandlers[0], sipPySelf, sipMeth);
}

rviz::Display* siprviz_DisplayGroup::takeDisplay(rviz::Display*a0)
{
    sip_gilstate_t sipGILState;
    PyObject *sipMeth;

    sipMeth = sipIsPyMethod(&sipGILState,&sipPyMethods[32],sipPySelf,NULL,sipName_takeDisplay);

    if (!sipMeth)
        return rviz::DisplayGroup::takeDisplay(a0);

    extern rviz::Display* sipVH_librviz_sip_15(sip_gilstate_t, sipVirtErrorHandlerFunc, sipSimpleWrapper *, PyObject *, rviz::Display*);

    return sipVH_librviz_sip_15(sipGILState, sipModuleAPI_librviz_sip_QtCore->em_virterrorhandlers[0], sipPySelf, sipMeth, a0);
}

void siprviz_DisplayGroup::addDisplay(rviz::Display*a0)
{
    sip_gilstate_t sipGILState;
    PyObject *sipMeth;

    sipMeth = sipIsPyMethod(&sipGILState,&sipPyMethods[33],sipPySelf,NULL,sipName_addDisplay);

    if (!sipMeth)
    {
        rviz::DisplayGroup::addDisplay(a0);
        return;
    }

    extern void sipVH_librviz_sip_16(sip_gilstate_t, sipVirtErrorHandlerFunc, sipSimpleWrapper *, PyObject *, rviz::Display*);

    sipVH_librviz_sip_16(sipGILState, sipModuleAPI_librviz_sip_QtCore->em_virterrorhandlers[0], sipPySelf, sipMeth, a0);
}

void siprviz_DisplayGroup::save(rviz::Config a0) const
{
    sip_gilstate_t sipGILState;
    PyObject *sipMeth;

    sipMeth = sipIsPyMethod(&sipGILState,const_cast<char *>(&sipPyMethods[34]),sipPySelf,NULL,sipName_save);

    if (!sipMeth)
    {
        rviz::DisplayGroup::save(a0);
        return;
    }

    extern void sipVH_librviz_sip_0(sip_gilstate_t, sipVirtErrorHandlerFunc, sipSimpleWrapper *, PyObject *, rviz::Config);

    sipVH_librviz_sip_0(sipGILState, sipModuleAPI_librviz_sip_QtCore->em_virterrorhandlers[0], sipPySelf, sipMeth, a0);
}

void siprviz_DisplayGroup::load(const rviz::Config& a0)
{
    sip_gilstate_t sipGILState;
    PyObject *sipMeth;

    sipMeth = sipIsPyMethod(&sipGILState,&sipPyMethods[35],sipPySelf,NULL,sipName_load);

    if (!sipMeth)
    {
        rviz::DisplayGroup::load(a0);
        return;
    }

    extern void sipVH_librviz_sip_1(sip_gilstate_t, sipVirtErrorHandlerFunc, sipSimpleWrapper *, PyObject *, const rviz::Config&);

    sipVH_librviz_sip_1(sipGILState, sipModuleAPI_librviz_sip_QtCore->em_virterrorhandlers[0], sipPySelf, sipMeth, a0);
}

Qt::ItemFlags siprviz_DisplayGroup::getViewFlags(int a0) const
{
    sip_gilstate_t sipGILState;
    PyObject *sipMeth;

    sipMeth = sipIsPyMethod(&sipGILState,const_cast<char *>(&sipPyMethods[36]),sipPySelf,NULL,sipName_getViewFlags);

    if (!sipMeth)
        return rviz::DisplayGroup::getViewFlags(a0);

    extern Qt::ItemFlags sipVH_librviz_sip_6(sip_gilstate_t, sipVirtErrorHandlerFunc, sipSimpleWrapper *, PyObject *, int);

    return sipVH_librviz_sip_6(sipGILState, sipModuleAPI_librviz_sip_QtCore->em_virterrorhandlers[0], sipPySelf, sipMeth, a0);
}

QVariant siprviz_DisplayGroup::getViewData(int a0,int a1) const
{
    sip_gilstate_t sipGILState;
    PyObject *sipMeth;

    sipMeth = sipIsPyMethod(&sipGILState,const_cast<char *>(&sipPyMethods[37]),sipPySelf,NULL,sipName_getViewData);

    if (!sipMeth)
        return rviz::DisplayGroup::getViewData(a0,a1);

    typedef QVariant (*sipVH_QtWidgets_21)(sip_gilstate_t, sipVirtErrorHandlerFunc, sipSimpleWrapper *, PyObject *, int,int);

    return ((sipVH_QtWidgets_21)(sipModuleAPI_librviz_sip_QtWidgets->em_virthandlers[21]))(sipGILState, sipModuleAPI_librviz_sip_QtCore->em_virterrorhandlers[0], sipPySelf, sipMeth, a0, a1);
}

void siprviz_DisplayGroup::addChild(rviz::Property*a0,int a1)
{
    sip_gilstate_t sipGILState;
    PyObject *sipMeth;

    sipMeth = sipIsPyMethod(&sipGILState,&sipPyMethods[38],sipPySelf,NULL,sipName_addChild);

    if (!sipMeth)
    {
        rviz::DisplayGroup::addChild(a0,a1);
        return;
    }

    extern void sipVH_librviz_sip_7(sip_gilstate_t, sipVirtErrorHandlerFunc, sipSimpleWrapper *, PyObject *, rviz::Property*,int);

    sipVH_librviz_sip_7(sipGILState, sipModuleAPI_librviz_sip_QtCore->em_virterrorhandlers[0], sipPySelf, sipMeth, a0, a1);
}

rviz::Property* siprviz_DisplayGroup::takeChildAt(int a0)
{
    sip_gilstate_t sipGILState;
    PyObject *sipMeth;

    sipMeth = sipIsPyMethod(&sipGILState,&sipPyMethods[39],sipPySelf,NULL,sipName_takeChildAt);

    if (!sipMeth)
        return rviz::DisplayGroup::takeChildAt(a0);

    extern rviz::Property* sipVH_librviz_sip_8(sip_gilstate_t, sipVirtErrorHandlerFunc, sipSimpleWrapper *, PyObject *, int);

    return sipVH_librviz_sip_8(sipGILState, sipModuleAPI_librviz_sip_QtCore->em_virterrorhandlers[0], sipPySelf, sipMeth, a0);
}

rviz::Property* siprviz_DisplayGroup::childAtUnchecked(int a0) const
{
    sip_gilstate_t sipGILState;
    PyObject *sipMeth;

    sipMeth = sipIsPyMethod(&sipGILState,const_cast<char *>(&sipPyMethods[40]),sipPySelf,NULL,sipName_childAtUnchecked);

    if (!sipMeth)
        return rviz::DisplayGroup::childAtUnchecked(a0);

    extern rviz::Property* sipVH_librviz_sip_8(sip_gilstate_t, sipVirtErrorHandlerFunc, sipSimpleWrapper *, PyObject *, int);

    return sipVH_librviz_sip_8(sipGILState, sipModuleAPI_librviz_sip_QtCore->em_virterrorhandlers[0], sipPySelf, sipMeth, a0);
}

int siprviz_DisplayGroup::numChildren() const
{
    sip_gilstate_t sipGILState;
    PyObject *sipMeth;

    sipMeth = sipIsPyMethod(&sipGILState,const_cast<char *>(&sipPyMethods[41]),sipPySelf,NULL,sipName_numChildren);

    if (!sipMeth)
        return rviz::DisplayGroup::numChildren();

    typedef int (*sipVH_QtCore_6)(sip_gilstate_t, sipVirtErrorHandlerFunc, sipSimpleWrapper *, PyObject *);

    return ((sipVH_QtCore_6)(sipModuleAPI_librviz_sip_QtCore->em_virthandlers[6]))(sipGILState, sipModuleAPI_librviz_sip_QtCore->em_virterrorhandlers[0], sipPySelf, sipMeth);
}

QObject* siprviz_DisplayGroup::sipProtect_sender() const
{
    return QObject::sender();
}

int siprviz_DisplayGroup::sipProtect_receivers(const char*a0) const
{
    return QObject::receivers(a0);
}

void siprviz_DisplayGroup::sipProtectVirt_timerEvent(bool sipSelfWasArg,QTimerEvent*a0)
{
    (sipSelfWasArg ? QObject::timerEvent(a0) : timerEvent(a0));
}

void siprviz_DisplayGroup::sipProtectVirt_childEvent(bool sipSelfWasArg,QChildEvent*a0)
{
    (sipSelfWasArg ? QObject::childEvent(a0) : childEvent(a0));
}

void siprviz_DisplayGroup::sipProtectVirt_customEvent(bool sipSelfWasArg,QEvent*a0)
{
    (sipSelfWasArg ? QObject::customEvent(a0) : customEvent(a0));
}

void siprviz_DisplayGroup::sipProtectVirt_connectNotify(bool sipSelfWasArg,const QMetaMethod& a0)
{
    (sipSelfWasArg ? QObject::connectNotify(a0) : connectNotify(a0));
}

void siprviz_DisplayGroup::sipProtectVirt_disconnectNotify(bool sipSelfWasArg,const QMetaMethod& a0)
{
    (sipSelfWasArg ? QObject::disconnectNotify(a0) : disconnectNotify(a0));
}

int siprviz_DisplayGroup::sipProtect_senderSignalIndex() const
{
    return QObject::senderSignalIndex();
}

bool siprviz_DisplayGroup::sipProtect_isSignalConnected(const QMetaMethod& a0) const
{
    return QObject::isSignalConnected(a0);
}


extern "C" {static PyObject *meth_rviz_DisplayGroup_sender(PyObject *, PyObject *, PyObject *);}
static PyObject *meth_rviz_DisplayGroup_sender(PyObject *sipSelf, PyObject *sipArgs, PyObject *sipKwds)
{
    PyObject *sipParseErr = NULL;

    {
        const siprviz_DisplayGroup *sipCpp;

        if (sipParseKwdArgs(&sipParseErr, sipArgs, sipKwds, NULL, NULL, "B", &sipSelf, sipType_rviz_DisplayGroup, &sipCpp))
        {
            QObject*sipRes = 0;

#line 550 "/usr/share/sip/PyQt5/QtCore/qobject.sip"
        // sender() must be called without the GIL to avoid possible deadlocks between
        // the GIL and Qt's internal thread data mutex.
        
        Py_BEGIN_ALLOW_THREADS
        
        #if defined(SIP_PROTECTED_IS_PUBLIC)
        sipRes = sipCpp->sender();
        #else
        sipRes = sipCpp->sipProtect_sender();
        #endif
        
        Py_END_ALLOW_THREADS
        
        if (!sipRes)
        {
            typedef QObject *(*qtcore_qobject_sender_t)();
        
            static qtcore_qobject_sender_t qtcore_qobject_sender = 0;
        
            if (!qtcore_qobject_sender)
                qtcore_qobject_sender = (qtcore_qobject_sender_t)sipImportSymbol("qtcore_qobject_sender");
        
            if (qtcore_qobject_sender)
                sipRes = qtcore_qobject_sender();
        }
#line 986 "/home/lassegoncz/catkin_ws/devel/bin/sip/rviz_sip/siplibrviz_siprvizDisplayGroup.cpp"

            return sipConvertFromType(sipRes,sipType_QObject,NULL);
        }
    }

    /* Raise an exception if the arguments couldn't be parsed. */
    sipNoMethod(sipParseErr, sipName_DisplayGroup, sipName_sender, NULL);

    return NULL;
}


extern "C" {static PyObject *meth_rviz_DisplayGroup_receivers(PyObject *, PyObject *, PyObject *);}
static PyObject *meth_rviz_DisplayGroup_receivers(PyObject *sipSelf, PyObject *sipArgs, PyObject *sipKwds)
{
    PyObject *sipParseErr = NULL;

    {
        PyObject * a0;
        const siprviz_DisplayGroup *sipCpp;

        if (sipParseKwdArgs(&sipParseErr, sipArgs, sipKwds, NULL, NULL, "BP0", &sipSelf, sipType_rviz_DisplayGroup, &sipCpp, &a0))
        {
            int sipRes = 0;
            sipErrorState sipError = sipErrorNone;

#line 579 "/usr/share/sip/PyQt5/QtCore/qobject.sip"
        // We need to handle the signal object.  Import the helper if it hasn't already
        // been done.
        typedef sipErrorState (*pyqt5_get_signal_signature_t)(PyObject *, const QObject *, const QByteArray &);
        
        static pyqt5_get_signal_signature_t pyqt5_get_signal_signature = 0;
        
        if (!pyqt5_get_signal_signature)
            pyqt5_get_signal_signature = (pyqt5_get_signal_signature_t)sipImportSymbol("pyqt5_get_signal_signature");
        
        if (pyqt5_get_signal_signature)
        {
            QByteArray signal_signature;
            
        #if defined(SIP_PROTECTED_IS_PUBLIC)
            if ((sipError = pyqt5_get_signal_signature(a0, sipCpp, signal_signature)) == sipErrorNone)
            {
                sipRes = sipCpp->receivers(signal_signature.constData());
            }
        #else
            if ((sipError = pyqt5_get_signal_signature(a0, static_cast<const QObject *>(sipCpp), signal_signature)) == sipErrorNone)
            {
                sipRes = sipCpp->sipProtect_receivers(signal_signature.constData());
            }
        #endif
            else if (sipError == sipErrorContinue)
            {
                sipError = sipBadCallableArg(0, a0);
            }
        }
#line 1043 "/home/lassegoncz/catkin_ws/devel/bin/sip/rviz_sip/siplibrviz_siprvizDisplayGroup.cpp"

            if (sipError == sipErrorFail)
                return 0;

            if (sipError == sipErrorNone)
            {
            return SIPLong_FromLong(sipRes);
            }

            sipAddException(sipError, &sipParseErr);
        }
    }

    /* Raise an exception if the arguments couldn't be parsed. */
    sipNoMethod(sipParseErr, sipName_DisplayGroup, sipName_receivers, NULL);

    return NULL;
}


extern "C" {static PyObject *meth_rviz_DisplayGroup_timerEvent(PyObject *, PyObject *, PyObject *);}
static PyObject *meth_rviz_DisplayGroup_timerEvent(PyObject *sipSelf, PyObject *sipArgs, PyObject *sipKwds)
{
    PyObject *sipParseErr = NULL;
    bool sipSelfWasArg = (!sipSelf || sipIsDerived((sipSimpleWrapper *)sipSelf));

    {
        QTimerEvent* a0;
        siprviz_DisplayGroup *sipCpp;

        if (sipParseKwdArgs(&sipParseErr, sipArgs, sipKwds, NULL, NULL, "BJ8", &sipSelf, sipType_rviz_DisplayGroup, &sipCpp, sipType_QTimerEvent, &a0))
        {
            sipCpp->sipProtectVirt_timerEvent(sipSelfWasArg,a0);

            Py_INCREF(Py_None);
            return Py_None;
        }
    }

    /* Raise an exception if the arguments couldn't be parsed. */
    sipNoMethod(sipParseErr, sipName_DisplayGroup, sipName_timerEvent, NULL);

    return NULL;
}


extern "C" {static PyObject *meth_rviz_DisplayGroup_childEvent(PyObject *, PyObject *, PyObject *);}
static PyObject *meth_rviz_DisplayGroup_childEvent(PyObject *sipSelf, PyObject *sipArgs, PyObject *sipKwds)
{
    PyObject *sipParseErr = NULL;
    bool sipSelfWasArg = (!sipSelf || sipIsDerived((sipSimpleWrapper *)sipSelf));

    {
        QChildEvent* a0;
        siprviz_DisplayGroup *sipCpp;

        if (sipParseKwdArgs(&sipParseErr, sipArgs, sipKwds, NULL, NULL, "BJ8", &sipSelf, sipType_rviz_DisplayGroup, &sipCpp, sipType_QChildEvent, &a0))
        {
            sipCpp->sipProtectVirt_childEvent(sipSelfWasArg,a0);

            Py_INCREF(Py_None);
            return Py_None;
        }
    }

    /* Raise an exception if the arguments couldn't be parsed. */
    sipNoMethod(sipParseErr, sipName_DisplayGroup, sipName_childEvent, NULL);

    return NULL;
}


extern "C" {static PyObject *meth_rviz_DisplayGroup_customEvent(PyObject *, PyObject *, PyObject *);}
static PyObject *meth_rviz_DisplayGroup_customEvent(PyObject *sipSelf, PyObject *sipArgs, PyObject *sipKwds)
{
    PyObject *sipParseErr = NULL;
    bool sipSelfWasArg = (!sipSelf || sipIsDerived((sipSimpleWrapper *)sipSelf));

    {
        QEvent* a0;
        siprviz_DisplayGroup *sipCpp;

        if (sipParseKwdArgs(&sipParseErr, sipArgs, sipKwds, NULL, NULL, "BJ8", &sipSelf, sipType_rviz_DisplayGroup, &sipCpp, sipType_QEvent, &a0))
        {
            sipCpp->sipProtectVirt_customEvent(sipSelfWasArg,a0);

            Py_INCREF(Py_None);
            return Py_None;
        }
    }

    /* Raise an exception if the arguments couldn't be parsed. */
    sipNoMethod(sipParseErr, sipName_DisplayGroup, sipName_customEvent, NULL);

    return NULL;
}


extern "C" {static PyObject *meth_rviz_DisplayGroup_connectNotify(PyObject *, PyObject *, PyObject *);}
static PyObject *meth_rviz_DisplayGroup_connectNotify(PyObject *sipSelf, PyObject *sipArgs, PyObject *sipKwds)
{
    PyObject *sipParseErr = NULL;
    bool sipSelfWasArg = (!sipSelf || sipIsDerived((sipSimpleWrapper *)sipSelf));

    {
        const QMetaMethod* a0;
        siprviz_DisplayGroup *sipCpp;

        if (sipParseKwdArgs(&sipParseErr, sipArgs, sipKwds, NULL, NULL, "BJ9", &sipSelf, sipType_rviz_DisplayGroup, &sipCpp, sipType_QMetaMethod, &a0))
        {
            sipCpp->sipProtectVirt_connectNotify(sipSelfWasArg,*a0);

            Py_INCREF(Py_None);
            return Py_None;
        }
    }

    /* Raise an exception if the arguments couldn't be parsed. */
    sipNoMethod(sipParseErr, sipName_DisplayGroup, sipName_connectNotify, NULL);

    return NULL;
}


extern "C" {static PyObject *meth_rviz_DisplayGroup_disconnectNotify(PyObject *, PyObject *, PyObject *);}
static PyObject *meth_rviz_DisplayGroup_disconnectNotify(PyObject *sipSelf, PyObject *sipArgs, PyObject *sipKwds)
{
    PyObject *sipParseErr = NULL;
    bool sipSelfWasArg = (!sipSelf || sipIsDerived((sipSimpleWrapper *)sipSelf));

    {
        const QMetaMethod* a0;
        siprviz_DisplayGroup *sipCpp;

        if (sipParseKwdArgs(&sipParseErr, sipArgs, sipKwds, NULL, NULL, "BJ9", &sipSelf, sipType_rviz_DisplayGroup, &sipCpp, sipType_QMetaMethod, &a0))
        {
            sipCpp->sipProtectVirt_disconnectNotify(sipSelfWasArg,*a0);

            Py_INCREF(Py_None);
            return Py_None;
        }
    }

    /* Raise an exception if the arguments couldn't be parsed. */
    sipNoMethod(sipParseErr, sipName_DisplayGroup, sipName_disconnectNotify, NULL);

    return NULL;
}


extern "C" {static PyObject *meth_rviz_DisplayGroup_senderSignalIndex(PyObject *, PyObject *, PyObject *);}
static PyObject *meth_rviz_DisplayGroup_senderSignalIndex(PyObject *sipSelf, PyObject *sipArgs, PyObject *sipKwds)
{
    PyObject *sipParseErr = NULL;

    {
        const siprviz_DisplayGroup *sipCpp;

        if (sipParseKwdArgs(&sipParseErr, sipArgs, sipKwds, NULL, NULL, "B", &sipSelf, sipType_rviz_DisplayGroup, &sipCpp))
        {
            int sipRes;

            sipRes = sipCpp->sipProtect_senderSignalIndex();

            return SIPLong_FromLong(sipRes);
        }
    }

    /* Raise an exception if the arguments couldn't be parsed. */
    sipNoMethod(sipParseErr, sipName_DisplayGroup, sipName_senderSignalIndex, NULL);

    return NULL;
}


extern "C" {static PyObject *meth_rviz_DisplayGroup_isSignalConnected(PyObject *, PyObject *, PyObject *);}
static PyObject *meth_rviz_DisplayGroup_isSignalConnected(PyObject *sipSelf, PyObject *sipArgs, PyObject *sipKwds)
{
    PyObject *sipParseErr = NULL;

    {
        const QMetaMethod* a0;
        const siprviz_DisplayGroup *sipCpp;

        if (sipParseKwdArgs(&sipParseErr, sipArgs, sipKwds, NULL, NULL, "BJ9", &sipSelf, sipType_rviz_DisplayGroup, &sipCpp, sipType_QMetaMethod, &a0))
        {
            bool sipRes;

            sipRes = sipCpp->sipProtect_isSignalConnected(*a0);

            return PyBool_FromLong(sipRes);
        }
    }

    /* Raise an exception if the arguments couldn't be parsed. */
    sipNoMethod(sipParseErr, sipName_DisplayGroup, sipName_isSignalConnected, NULL);

    return NULL;
}


extern "C" {static PyObject *meth_rviz_DisplayGroup_createDisplay(PyObject *, PyObject *);}
static PyObject *meth_rviz_DisplayGroup_createDisplay(PyObject *sipSelf, PyObject *sipArgs)
{
    PyObject *sipParseErr = NULL;

    {
        const QString* a0;
        int a0State = 0;
        rviz::DisplayGroup *sipCpp;

        if (sipParseArgs(&sipParseErr, sipArgs, "BJ1", &sipSelf, sipType_rviz_DisplayGroup, &sipCpp, sipType_QString,&a0, &a0State))
        {
            rviz::Display*sipRes;

            sipRes = sipCpp->createDisplay(*a0);
            sipReleaseType(const_cast<QString *>(a0),sipType_QString,a0State);

            return sipConvertFromType(sipRes,sipType_rviz_Display,NULL);
        }
    }

    /* Raise an exception if the arguments couldn't be parsed. */
    sipNoMethod(sipParseErr, sipName_DisplayGroup, sipName_createDisplay, NULL);

    return NULL;
}


extern "C" {static PyObject *meth_rviz_DisplayGroup_numChildren(PyObject *, PyObject *);}
static PyObject *meth_rviz_DisplayGroup_numChildren(PyObject *sipSelf, PyObject *sipArgs)
{
    PyObject *sipParseErr = NULL;
    bool sipSelfWasArg = (!sipSelf || sipIsDerived((sipSimpleWrapper *)sipSelf));

    {
        const rviz::DisplayGroup *sipCpp;

        if (sipParseArgs(&sipParseErr, sipArgs, "B", &sipSelf, sipType_rviz_DisplayGroup, &sipCpp))
        {
            int sipRes;

            sipRes = (sipSelfWasArg ? sipCpp->rviz::DisplayGroup::numChildren() : sipCpp->numChildren());

            return SIPLong_FromLong(sipRes);
        }
    }

    /* Raise an exception if the arguments couldn't be parsed. */
    sipNoMethod(sipParseErr, sipName_DisplayGroup, sipName_numChildren, NULL);

    return NULL;
}


extern "C" {static PyObject *meth_rviz_DisplayGroup_childAtUnchecked(PyObject *, PyObject *);}
static PyObject *meth_rviz_DisplayGroup_childAtUnchecked(PyObject *sipSelf, PyObject *sipArgs)
{
    PyObject *sipParseErr = NULL;
    bool sipSelfWasArg = (!sipSelf || sipIsDerived((sipSimpleWrapper *)sipSelf));

    {
        int a0;
        const rviz::DisplayGroup *sipCpp;

        if (sipParseArgs(&sipParseErr, sipArgs, "Bi", &sipSelf, sipType_rviz_DisplayGroup, &sipCpp, &a0))
        {
            rviz::Property*sipRes;

            sipRes = (sipSelfWasArg ? sipCpp->rviz::DisplayGroup::childAtUnchecked(a0) : sipCpp->childAtUnchecked(a0));

            return sipConvertFromType(sipRes,sipType_rviz_Property,NULL);
        }
    }

    /* Raise an exception if the arguments couldn't be parsed. */
    sipNoMethod(sipParseErr, sipName_DisplayGroup, sipName_childAtUnchecked, NULL);

    return NULL;
}


extern "C" {static PyObject *meth_rviz_DisplayGroup_takeChildAt(PyObject *, PyObject *);}
static PyObject *meth_rviz_DisplayGroup_takeChildAt(PyObject *sipSelf, PyObject *sipArgs)
{
    PyObject *sipParseErr = NULL;
    bool sipSelfWasArg = (!sipSelf || sipIsDerived((sipSimpleWrapper *)sipSelf));

    {
        int a0;
        rviz::DisplayGroup *sipCpp;

        if (sipParseArgs(&sipParseErr, sipArgs, "Bi", &sipSelf, sipType_rviz_DisplayGroup, &sipCpp, &a0))
        {
            rviz::Property*sipRes;

            sipRes = (sipSelfWasArg ? sipCpp->rviz::DisplayGroup::takeChildAt(a0) : sipCpp->takeChildAt(a0));

            return sipConvertFromType(sipRes,sipType_rviz_Property,NULL);
        }
    }

    /* Raise an exception if the arguments couldn't be parsed. */
    sipNoMethod(sipParseErr, sipName_DisplayGroup, sipName_takeChildAt, NULL);

    return NULL;
}


extern "C" {static PyObject *meth_rviz_DisplayGroup_addChild(PyObject *, PyObject *);}
static PyObject *meth_rviz_DisplayGroup_addChild(PyObject *sipSelf, PyObject *sipArgs)
{
    PyObject *sipParseErr = NULL;
    bool sipSelfWasArg = (!sipSelf || sipIsDerived((sipSimpleWrapper *)sipSelf));

    {
        rviz::Property* a0;
        int a1 = -1;
        rviz::DisplayGroup *sipCpp;

        if (sipParseArgs(&sipParseErr, sipArgs, "BJ8|i", &sipSelf, sipType_rviz_DisplayGroup, &sipCpp, sipType_rviz_Property, &a0, &a1))
        {
            (sipSelfWasArg ? sipCpp->rviz::DisplayGroup::addChild(a0,a1) : sipCpp->addChild(a0,a1));

            Py_INCREF(Py_None);
            return Py_None;
        }
    }

    /* Raise an exception if the arguments couldn't be parsed. */
    sipNoMethod(sipParseErr, sipName_DisplayGroup, sipName_addChild, NULL);

    return NULL;
}


extern "C" {static PyObject *meth_rviz_DisplayGroup_getViewData(PyObject *, PyObject *);}
static PyObject *meth_rviz_DisplayGroup_getViewData(PyObject *sipSelf, PyObject *sipArgs)
{
    PyObject *sipParseErr = NULL;
    bool sipSelfWasArg = (!sipSelf || sipIsDerived((sipSimpleWrapper *)sipSelf));

    {
        int a0;
        int a1;
        const rviz::DisplayGroup *sipCpp;

        if (sipParseArgs(&sipParseErr, sipArgs, "Bii", &sipSelf, sipType_rviz_DisplayGroup, &sipCpp, &a0, &a1))
        {
            QVariant*sipRes;

            sipRes = new QVariant((sipSelfWasArg ? sipCpp->rviz::DisplayGroup::getViewData(a0,a1) : sipCpp->getViewData(a0,a1)));

            return sipConvertFromNewType(sipRes,sipType_QVariant,NULL);
        }
    }

    /* Raise an exception if the arguments couldn't be parsed. */
    sipNoMethod(sipParseErr, sipName_DisplayGroup, sipName_getViewData, NULL);

    return NULL;
}


extern "C" {static PyObject *meth_rviz_DisplayGroup_getViewFlags(PyObject *, PyObject *);}
static PyObject *meth_rviz_DisplayGroup_getViewFlags(PyObject *sipSelf, PyObject *sipArgs)
{
    PyObject *sipParseErr = NULL;
    bool sipSelfWasArg = (!sipSelf || sipIsDerived((sipSimpleWrapper *)sipSelf));

    {
        int a0;
        const rviz::DisplayGroup *sipCpp;

        if (sipParseArgs(&sipParseErr, sipArgs, "Bi", &sipSelf, sipType_rviz_DisplayGroup, &sipCpp, &a0))
        {
            Qt::ItemFlags*sipRes;

            sipRes = new Qt::ItemFlags((sipSelfWasArg ? sipCpp->rviz::DisplayGroup::getViewFlags(a0) : sipCpp->getViewFlags(a0)));

            return sipConvertFromNewType(sipRes,sipType_Qt_ItemFlags,NULL);
        }
    }

    /* Raise an exception if the arguments couldn't be parsed. */
    sipNoMethod(sipParseErr, sipName_DisplayGroup, sipName_getViewFlags, NULL);

    return NULL;
}


extern "C" {static PyObject *meth_rviz_DisplayGroup_load(PyObject *, PyObject *);}
static PyObject *meth_rviz_DisplayGroup_load(PyObject *sipSelf, PyObject *sipArgs)
{
    PyObject *sipParseErr = NULL;
    bool sipSelfWasArg = (!sipSelf || sipIsDerived((sipSimpleWrapper *)sipSelf));

    {
        const rviz::Config* a0;
        rviz::DisplayGroup *sipCpp;

        if (sipParseArgs(&sipParseErr, sipArgs, "BJ9", &sipSelf, sipType_rviz_DisplayGroup, &sipCpp, sipType_rviz_Config, &a0))
        {
            (sipSelfWasArg ? sipCpp->rviz::DisplayGroup::load(*a0) : sipCpp->load(*a0));

            Py_INCREF(Py_None);
            return Py_None;
        }
    }

    /* Raise an exception if the arguments couldn't be parsed. */
    sipNoMethod(sipParseErr, sipName_DisplayGroup, sipName_load, NULL);

    return NULL;
}


extern "C" {static PyObject *meth_rviz_DisplayGroup_save(PyObject *, PyObject *);}
static PyObject *meth_rviz_DisplayGroup_save(PyObject *sipSelf, PyObject *sipArgs)
{
    PyObject *sipParseErr = NULL;
    bool sipSelfWasArg = (!sipSelf || sipIsDerived((sipSimpleWrapper *)sipSelf));

    {
        rviz::Config* a0;
        const rviz::DisplayGroup *sipCpp;

        if (sipParseArgs(&sipParseErr, sipArgs, "BJ9", &sipSelf, sipType_rviz_DisplayGroup, &sipCpp, sipType_rviz_Config, &a0))
        {
            (sipSelfWasArg ? sipCpp->rviz::DisplayGroup::save(*a0) : sipCpp->save(*a0));

            Py_INCREF(Py_None);
            return Py_None;
        }
    }

    /* Raise an exception if the arguments couldn't be parsed. */
    sipNoMethod(sipParseErr, sipName_DisplayGroup, sipName_save, NULL);

    return NULL;
}


extern "C" {static PyObject *meth_rviz_DisplayGroup_addDisplay(PyObject *, PyObject *);}
static PyObject *meth_rviz_DisplayGroup_addDisplay(PyObject *sipSelf, PyObject *sipArgs)
{
    PyObject *sipParseErr = NULL;
    bool sipSelfWasArg = (!sipSelf || sipIsDerived((sipSimpleWrapper *)sipSelf));

    {
        rviz::Display* a0;
        rviz::DisplayGroup *sipCpp;

        if (sipParseArgs(&sipParseErr, sipArgs, "BJ8", &sipSelf, sipType_rviz_DisplayGroup, &sipCpp, sipType_rviz_Display, &a0))
        {
            (sipSelfWasArg ? sipCpp->rviz::DisplayGroup::addDisplay(a0) : sipCpp->addDisplay(a0));

            Py_INCREF(Py_None);
            return Py_None;
        }
    }

    /* Raise an exception if the arguments couldn't be parsed. */
    sipNoMethod(sipParseErr, sipName_DisplayGroup, sipName_addDisplay, NULL);

    return NULL;
}


extern "C" {static PyObject *meth_rviz_DisplayGroup_takeDisplay(PyObject *, PyObject *);}
static PyObject *meth_rviz_DisplayGroup_takeDisplay(PyObject *sipSelf, PyObject *sipArgs)
{
    PyObject *sipParseErr = NULL;
    bool sipSelfWasArg = (!sipSelf || sipIsDerived((sipSimpleWrapper *)sipSelf));

    {
        rviz::Display* a0;
        rviz::DisplayGroup *sipCpp;

        if (sipParseArgs(&sipParseErr, sipArgs, "BJ8", &sipSelf, sipType_rviz_DisplayGroup, &sipCpp, sipType_rviz_Display, &a0))
        {
            rviz::Display*sipRes;

            sipRes = (sipSelfWasArg ? sipCpp->rviz::DisplayGroup::takeDisplay(a0) : sipCpp->takeDisplay(a0));

            return sipConvertFromType(sipRes,sipType_rviz_Display,NULL);
        }
    }

    /* Raise an exception if the arguments couldn't be parsed. */
    sipNoMethod(sipParseErr, sipName_DisplayGroup, sipName_takeDisplay, NULL);

    return NULL;
}


extern "C" {static PyObject *meth_rviz_DisplayGroup_removeAllDisplays(PyObject *, PyObject *);}
static PyObject *meth_rviz_DisplayGroup_removeAllDisplays(PyObject *sipSelf, PyObject *sipArgs)
{
    PyObject *sipParseErr = NULL;
    bool sipSelfWasArg = (!sipSelf || sipIsDerived((sipSimpleWrapper *)sipSelf));

    {
        rviz::DisplayGroup *sipCpp;

        if (sipParseArgs(&sipParseErr, sipArgs, "B", &sipSelf, sipType_rviz_DisplayGroup, &sipCpp))
        {
            (sipSelfWasArg ? sipCpp->rviz::DisplayGroup::removeAllDisplays() : sipCpp->removeAllDisplays());

            Py_INCREF(Py_None);
            return Py_None;
        }
    }

    /* Raise an exception if the arguments couldn't be parsed. */
    sipNoMethod(sipParseErr, sipName_DisplayGroup, sipName_removeAllDisplays, NULL);

    return NULL;
}


extern "C" {static PyObject *meth_rviz_DisplayGroup_numDisplays(PyObject *, PyObject *);}
static PyObject *meth_rviz_DisplayGroup_numDisplays(PyObject *sipSelf, PyObject *sipArgs)
{
    PyObject *sipParseErr = NULL;
    bool sipSelfWasArg = (!sipSelf || sipIsDerived((sipSimpleWrapper *)sipSelf));

    {
        const rviz::DisplayGroup *sipCpp;

        if (sipParseArgs(&sipParseErr, sipArgs, "B", &sipSelf, sipType_rviz_DisplayGroup, &sipCpp))
        {
            int sipRes;

            sipRes = (sipSelfWasArg ? sipCpp->rviz::DisplayGroup::numDisplays() : sipCpp->numDisplays());

            return SIPLong_FromLong(sipRes);
        }
    }

    /* Raise an exception if the arguments couldn't be parsed. */
    sipNoMethod(sipParseErr, sipName_DisplayGroup, sipName_numDisplays, NULL);

    return NULL;
}


extern "C" {static PyObject *meth_rviz_DisplayGroup_getDisplayAt(PyObject *, PyObject *);}
static PyObject *meth_rviz_DisplayGroup_getDisplayAt(PyObject *sipSelf, PyObject *sipArgs)
{
    PyObject *sipParseErr = NULL;
    bool sipSelfWasArg = (!sipSelf || sipIsDerived((sipSimpleWrapper *)sipSelf));

    {
        int a0;
        const rviz::DisplayGroup *sipCpp;

        if (sipParseArgs(&sipParseErr, sipArgs, "Bi", &sipSelf, sipType_rviz_DisplayGroup, &sipCpp, &a0))
        {
            rviz::Display*sipRes;

            sipRes = (sipSelfWasArg ? sipCpp->rviz::DisplayGroup::getDisplayAt(a0) : sipCpp->getDisplayAt(a0));

            return sipConvertFromType(sipRes,sipType_rviz_Display,NULL);
        }
    }

    /* Raise an exception if the arguments couldn't be parsed. */
    sipNoMethod(sipParseErr, sipName_DisplayGroup, sipName_getDisplayAt, NULL);

    return NULL;
}


extern "C" {static PyObject *meth_rviz_DisplayGroup_getGroupAt(PyObject *, PyObject *);}
static PyObject *meth_rviz_DisplayGroup_getGroupAt(PyObject *sipSelf, PyObject *sipArgs)
{
    PyObject *sipParseErr = NULL;
    bool sipSelfWasArg = (!sipSelf || sipIsDerived((sipSimpleWrapper *)sipSelf));

    {
        int a0;
        const rviz::DisplayGroup *sipCpp;

        if (sipParseArgs(&sipParseErr, sipArgs, "Bi", &sipSelf, sipType_rviz_DisplayGroup, &sipCpp, &a0))
        {
            rviz::DisplayGroup*sipRes;

            sipRes = (sipSelfWasArg ? sipCpp->rviz::DisplayGroup::getGroupAt(a0) : sipCpp->getGroupAt(a0));

            return sipConvertFromType(sipRes,sipType_rviz_DisplayGroup,NULL);
        }
    }

    /* Raise an exception if the arguments couldn't be parsed. */
    sipNoMethod(sipParseErr, sipName_DisplayGroup, sipName_getGroupAt, NULL);

    return NULL;
}


extern "C" {static PyObject *meth_rviz_DisplayGroup_update(PyObject *, PyObject *);}
static PyObject *meth_rviz_DisplayGroup_update(PyObject *sipSelf, PyObject *sipArgs)
{
    PyObject *sipParseErr = NULL;
    bool sipSelfWasArg = (!sipSelf || sipIsDerived((sipSimpleWrapper *)sipSelf));

    {
        float a0;
        float a1;
        rviz::DisplayGroup *sipCpp;

        if (sipParseArgs(&sipParseErr, sipArgs, "Bff", &sipSelf, sipType_rviz_DisplayGroup, &sipCpp, &a0, &a1))
        {
            (sipSelfWasArg ? sipCpp->rviz::DisplayGroup::update(a0,a1) : sipCpp->update(a0,a1));

            Py_INCREF(Py_None);
            return Py_None;
        }
    }

    /* Raise an exception if the arguments couldn't be parsed. */
    sipNoMethod(sipParseErr, sipName_DisplayGroup, sipName_update, NULL);

    return NULL;
}


extern "C" {static PyObject *meth_rviz_DisplayGroup_reset(PyObject *, PyObject *);}
static PyObject *meth_rviz_DisplayGroup_reset(PyObject *sipSelf, PyObject *sipArgs)
{
    PyObject *sipParseErr = NULL;
    bool sipSelfWasArg = (!sipSelf || sipIsDerived((sipSimpleWrapper *)sipSelf));

    {
        rviz::DisplayGroup *sipCpp;

        if (sipParseArgs(&sipParseErr, sipArgs, "B", &sipSelf, sipType_rviz_DisplayGroup, &sipCpp))
        {
            (sipSelfWasArg ? sipCpp->rviz::DisplayGroup::reset() : sipCpp->reset());

            Py_INCREF(Py_None);
            return Py_None;
        }
    }

    /* Raise an exception if the arguments couldn't be parsed. */
    sipNoMethod(sipParseErr, sipName_DisplayGroup, sipName_reset, NULL);

    return NULL;
}


/* Cast a pointer to a type somewhere in its superclass hierarchy. */
extern "C" {static void *cast_rviz_DisplayGroup(void *, const sipTypeDef *);}
static void *cast_rviz_DisplayGroup(void *ptr, const sipTypeDef *targetType)
{
    void *res;

    if (targetType == sipType_rviz_DisplayGroup)
        return ptr;

    if ((res = ((const sipClassTypeDef *)sipType_rviz_Display)->ctd_cast((rviz::Display *)(rviz::DisplayGroup *)ptr,targetType)) != NULL)
        return res;

    return NULL;
}


/* Call the instance's destructor. */
extern "C" {static void release_rviz_DisplayGroup(void *, int);}
static void release_rviz_DisplayGroup(void *sipCppV,int)
{
    rviz::DisplayGroup *sipCpp = reinterpret_cast<rviz::DisplayGroup *>(sipCppV);

    if (QThread::currentThread() == sipCpp->thread())
        delete sipCpp;
    else
        sipCpp->deleteLater();
}


extern "C" {static void dealloc_rviz_DisplayGroup(sipSimpleWrapper *);}
static void dealloc_rviz_DisplayGroup(sipSimpleWrapper *sipSelf)
{
    if (sipIsDerived(sipSelf))
        reinterpret_cast<siprviz_DisplayGroup *>(sipGetAddress(sipSelf))->sipPySelf = NULL;

    if (sipIsPyOwned(sipSelf))
    {
        release_rviz_DisplayGroup(sipGetAddress(sipSelf),sipSelf->flags);
    }
}


extern "C" {static void *init_type_rviz_DisplayGroup(sipSimpleWrapper *, PyObject *, PyObject *, PyObject **, PyObject **, PyObject **);}
static void *init_type_rviz_DisplayGroup(sipSimpleWrapper *sipSelf, PyObject *sipArgs, PyObject *sipKwds, PyObject **sipUnused, PyObject **, PyObject **sipParseErr)
{
    siprviz_DisplayGroup *sipCpp = 0;

    {
        if (sipParseKwdArgs(sipParseErr, sipArgs, sipKwds, NULL, sipUnused, ""))
        {
            sipCpp = new siprviz_DisplayGroup();

            sipCpp->sipPySelf = sipSelf;

            return sipCpp;
        }
    }

    return NULL;
}


/* Define this type's super-types. */
static sipEncodedTypeDef supers_rviz_DisplayGroup[] = {{5, 255, 1}};


static PyMethodDef methods_rviz_DisplayGroup[] = {
    {SIP_MLNAME_CAST(sipName_addChild), meth_rviz_DisplayGroup_addChild, METH_VARARGS, NULL},
    {SIP_MLNAME_CAST(sipName_addDisplay), meth_rviz_DisplayGroup_addDisplay, METH_VARARGS, NULL},
    {SIP_MLNAME_CAST(sipName_childAtUnchecked), meth_rviz_DisplayGroup_childAtUnchecked, METH_VARARGS, NULL},
    {SIP_MLNAME_CAST(sipName_childEvent), (PyCFunction)meth_rviz_DisplayGroup_childEvent, METH_VARARGS|METH_KEYWORDS, NULL},
    {SIP_MLNAME_CAST(sipName_connectNotify), (PyCFunction)meth_rviz_DisplayGroup_connectNotify, METH_VARARGS|METH_KEYWORDS, NULL},
    {SIP_MLNAME_CAST(sipName_createDisplay), meth_rviz_DisplayGroup_createDisplay, METH_VARARGS, NULL},
    {SIP_MLNAME_CAST(sipName_customEvent), (PyCFunction)meth_rviz_DisplayGroup_customEvent, METH_VARARGS|METH_KEYWORDS, NULL},
    {SIP_MLNAME_CAST(sipName_disconnectNotify), (PyCFunction)meth_rviz_DisplayGroup_disconnectNotify, METH_VARARGS|METH_KEYWORDS, NULL},
    {SIP_MLNAME_CAST(sipName_getDisplayAt), meth_rviz_DisplayGroup_getDisplayAt, METH_VARARGS, NULL},
    {SIP_MLNAME_CAST(sipName_getGroupAt), meth_rviz_DisplayGroup_getGroupAt, METH_VARARGS, NULL},
    {SIP_MLNAME_CAST(sipName_getViewData), meth_rviz_DisplayGroup_getViewData, METH_VARARGS, NULL},
    {SIP_MLNAME_CAST(sipName_getViewFlags), meth_rviz_DisplayGroup_getViewFlags, METH_VARARGS, NULL},
    {SIP_MLNAME_CAST(sipName_isSignalConnected), (PyCFunction)meth_rviz_DisplayGroup_isSignalConnected, METH_VARARGS|METH_KEYWORDS, NULL},
    {SIP_MLNAME_CAST(sipName_load), meth_rviz_DisplayGroup_load, METH_VARARGS, NULL},
    {SIP_MLNAME_CAST(sipName_numChildren), meth_rviz_DisplayGroup_numChildren, METH_VARARGS, NULL},
    {SIP_MLNAME_CAST(sipName_numDisplays), meth_rviz_DisplayGroup_numDisplays, METH_VARARGS, NULL},
    {SIP_MLNAME_CAST(sipName_receivers), (PyCFunction)meth_rviz_DisplayGroup_receivers, METH_VARARGS|METH_KEYWORDS, NULL},
    {SIP_MLNAME_CAST(sipName_removeAllDisplays), meth_rviz_DisplayGroup_removeAllDisplays, METH_VARARGS, NULL},
    {SIP_MLNAME_CAST(sipName_reset), meth_rviz_DisplayGroup_reset, METH_VARARGS, NULL},
    {SIP_MLNAME_CAST(sipName_save), meth_rviz_DisplayGroup_save, METH_VARARGS, NULL},
    {SIP_MLNAME_CAST(sipName_sender), (PyCFunction)meth_rviz_DisplayGroup_sender, METH_VARARGS|METH_KEYWORDS, NULL},
    {SIP_MLNAME_CAST(sipName_senderSignalIndex), (PyCFunction)meth_rviz_DisplayGroup_senderSignalIndex, METH_VARARGS|METH_KEYWORDS, NULL},
    {SIP_MLNAME_CAST(sipName_takeChildAt), meth_rviz_DisplayGroup_takeChildAt, METH_VARARGS, NULL},
    {SIP_MLNAME_CAST(sipName_takeDisplay), meth_rviz_DisplayGroup_takeDisplay, METH_VARARGS, NULL},
    {SIP_MLNAME_CAST(sipName_timerEvent), (PyCFunction)meth_rviz_DisplayGroup_timerEvent, METH_VARARGS|METH_KEYWORDS, NULL},
    {SIP_MLNAME_CAST(sipName_update), meth_rviz_DisplayGroup_update, METH_VARARGS, NULL}
};


pyqt5ClassTypeDef sipTypeDef_librviz_sip_rviz_DisplayGroup = {
{
    {
        -1,
        0,
        0,
        SIP_TYPE_SCC|SIP_TYPE_SUPER_INIT|SIP_TYPE_CLASS,
        sipNameNr_rviz__DisplayGroup,
        {0}
    },
    {
        sipNameNr_DisplayGroup,
        {0, 255, 0},
        26, methods_rviz_DisplayGroup,
        0, 0,
        0, 0,
        {0, 0, 0, 0, 0, 0, 0, 0, 0, 0},
    },
    0,
    -1,
    -1,
    supers_rviz_DisplayGroup,
    0,
    init_type_rviz_DisplayGroup,
    0,
    0,
#if PY_MAJOR_VERSION >= 3
    0,
    0,
#else
    0,
    0,
    0,
    0,
#endif
    dealloc_rviz_DisplayGroup,
    0,
    0,
    0,
    release_rviz_DisplayGroup,
    cast_rviz_DisplayGroup,
    0,
    0,
    0,
    0,
    0,
    0
},
    &rviz::DisplayGroup::staticMetaObject,
    0,
    0,
    0
};
