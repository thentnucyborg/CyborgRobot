/*
 * Interface wrapper code.
 *
 * Generated by SIP 4.17
 */

#include "sipAPIlibrviz_sip.h"

#line 7 "visualization_frame.sip"
#define ROS_PACKAGE_NAME "rviz"
#include <rviz/visualization_frame.h>
#line 13 "/home/lassegoncz/catkin_ws/devel/bin/sip/rviz_sip/siplibrviz_siprvizVisualizationFrame.cpp"

#line 28 "/usr/share/sip/PyQt5/QtWidgets/qwidget.sip"
#include <qwidget.h>
#line 17 "/home/lassegoncz/catkin_ws/devel/bin/sip/rviz_sip/siplibrviz_siprvizVisualizationFrame.cpp"
#line 7 "config.sip"
#define ROS_PACKAGE_NAME "rviz"
#include <rviz/config.h>
#line 21 "/home/lassegoncz/catkin_ws/devel/bin/sip/rviz_sip/siplibrviz_siprvizVisualizationFrame.cpp"
#line 27 "/usr/share/sip/PyQt5/QtCore/qstring.sip"
#include <qstring.h>
#line 24 "/home/lassegoncz/catkin_ws/devel/bin/sip/rviz_sip/siplibrviz_siprvizVisualizationFrame.cpp"
#line 7 "panel_dock_widget.sip"
#include <rviz/panel_dock_widget.h>
#line 27 "/home/lassegoncz/catkin_ws/devel/bin/sip/rviz_sip/siplibrviz_siprvizVisualizationFrame.cpp"
#line 26 "/usr/share/sip/PyQt5/QtCore/qnamespace.sip"
#include <qnamespace.h>
#line 30 "/home/lassegoncz/catkin_ws/devel/bin/sip/rviz_sip/siplibrviz_siprvizVisualizationFrame.cpp"
#line 7 "visualization_manager.sip"
#define ROS_PACKAGE_NAME "rviz"
#include <rviz/visualization_manager.h>
#line 34 "/home/lassegoncz/catkin_ws/devel/bin/sip/rviz_sip/siplibrviz_siprvizVisualizationFrame.cpp"
#line 144 "/usr/share/sip/PyQt5/QtCore/qpycore_qlist.sip"
#include <qlist.h>
#line 37 "/home/lassegoncz/catkin_ws/devel/bin/sip/rviz_sip/siplibrviz_siprvizVisualizationFrame.cpp"
#line 26 "/usr/share/sip/PyQt5/QtWidgets/qdockwidget.sip"
#include <qdockwidget.h>
#line 40 "/home/lassegoncz/catkin_ws/devel/bin/sip/rviz_sip/siplibrviz_siprvizVisualizationFrame.cpp"
#line 26 "/usr/share/sip/PyQt5/QtCore/qnamespace.sip"
#include <qnamespace.h>
#line 43 "/home/lassegoncz/catkin_ws/devel/bin/sip/rviz_sip/siplibrviz_siprvizVisualizationFrame.cpp"
#line 26 "/usr/share/sip/PyQt5/QtWidgets/qtabwidget.sip"
#include <qtabwidget.h>
#line 46 "/home/lassegoncz/catkin_ws/devel/bin/sip/rviz_sip/siplibrviz_siprvizVisualizationFrame.cpp"
#line 26 "/usr/share/sip/PyQt5/QtWidgets/qtoolbar.sip"
#include <qtoolbar.h>
#line 49 "/home/lassegoncz/catkin_ws/devel/bin/sip/rviz_sip/siplibrviz_siprvizVisualizationFrame.cpp"
#line 26 "/usr/share/sip/PyQt5/QtWidgets/qmainwindow.sip"
#include <qmainwindow.h>
#line 52 "/home/lassegoncz/catkin_ws/devel/bin/sip/rviz_sip/siplibrviz_siprvizVisualizationFrame.cpp"
#line 26 "/usr/share/sip/PyQt5/QtCore/qpoint.sip"
#include <qpoint.h>
#line 55 "/home/lassegoncz/catkin_ws/devel/bin/sip/rviz_sip/siplibrviz_siprvizVisualizationFrame.cpp"
#line 26 "/usr/share/sip/PyQt5/QtCore/qcoreevent.sip"
#include <qcoreevent.h>
#line 58 "/home/lassegoncz/catkin_ws/devel/bin/sip/rviz_sip/siplibrviz_siprvizVisualizationFrame.cpp"
#line 460 "/usr/share/sip/PyQt5/QtGui/qevent.sip"
#include <qevent.h>
#line 61 "/home/lassegoncz/catkin_ws/devel/bin/sip/rviz_sip/siplibrviz_siprvizVisualizationFrame.cpp"
#line 26 "/usr/share/sip/PyQt5/QtCore/qsize.sip"
#include <qsize.h>
#line 64 "/home/lassegoncz/catkin_ws/devel/bin/sip/rviz_sip/siplibrviz_siprvizVisualizationFrame.cpp"
#line 26 "/usr/share/sip/PyQt5/QtWidgets/qmenu.sip"
#include <qmenu.h>
#line 67 "/home/lassegoncz/catkin_ws/devel/bin/sip/rviz_sip/siplibrviz_siprvizVisualizationFrame.cpp"
#line 32 "/usr/share/sip/PyQt5/QtCore/qbytearray.sip"
#include <qbytearray.h>
#line 70 "/home/lassegoncz/catkin_ws/devel/bin/sip/rviz_sip/siplibrviz_siprvizVisualizationFrame.cpp"
#line 26 "/usr/share/sip/PyQt5/QtWidgets/qstatusbar.sip"
#include <qstatusbar.h>
#line 73 "/home/lassegoncz/catkin_ws/devel/bin/sip/rviz_sip/siplibrviz_siprvizVisualizationFrame.cpp"
#line 26 "/usr/share/sip/PyQt5/QtWidgets/qmenubar.sip"
#include <qmenubar.h>
#line 76 "/home/lassegoncz/catkin_ws/devel/bin/sip/rviz_sip/siplibrviz_siprvizVisualizationFrame.cpp"
#line 26 "/usr/share/sip/PyQt5/QtGui/qicon.sip"
#include <qicon.h>
#line 79 "/home/lassegoncz/catkin_ws/devel/bin/sip/rviz_sip/siplibrviz_siprvizVisualizationFrame.cpp"
#line 26 "/usr/share/sip/PyQt5/QtGui/qpainter.sip"
#include <qpainter.h>
#line 82 "/home/lassegoncz/catkin_ws/devel/bin/sip/rviz_sip/siplibrviz_siprvizVisualizationFrame.cpp"
#line 26 "/usr/share/sip/PyQt5/QtGui/qwindow.sip"
#include <qwindow.h>
#line 85 "/home/lassegoncz/catkin_ws/devel/bin/sip/rviz_sip/siplibrviz_siprvizVisualizationFrame.cpp"
#line 26 "/usr/share/sip/PyQt5/QtCore/qnamespace.sip"
#include <qnamespace.h>
#line 88 "/home/lassegoncz/catkin_ws/devel/bin/sip/rviz_sip/siplibrviz_siprvizVisualizationFrame.cpp"
#line 26 "/usr/share/sip/PyQt5/QtGui/qpixmap.sip"
#include <qpixmap.h>
#line 91 "/home/lassegoncz/catkin_ws/devel/bin/sip/rviz_sip/siplibrviz_siprvizVisualizationFrame.cpp"
#line 26 "/usr/share/sip/PyQt5/QtCore/qrect.sip"
#include <qrect.h>
#line 94 "/home/lassegoncz/catkin_ws/devel/bin/sip/rviz_sip/siplibrviz_siprvizVisualizationFrame.cpp"
#line 26 "/usr/share/sip/PyQt5/QtCore/qnamespace.sip"
#include <qnamespace.h>
#line 97 "/home/lassegoncz/catkin_ws/devel/bin/sip/rviz_sip/siplibrviz_siprvizVisualizationFrame.cpp"
#line 26 "/usr/share/sip/PyQt5/QtCore/qmargins.sip"
#include <qmargins.h>
#line 100 "/home/lassegoncz/catkin_ws/devel/bin/sip/rviz_sip/siplibrviz_siprvizVisualizationFrame.cpp"
#line 26 "/usr/share/sip/PyQt5/QtCore/qnamespace.sip"
#include <qnamespace.h>
#line 103 "/home/lassegoncz/catkin_ws/devel/bin/sip/rviz_sip/siplibrviz_siprvizVisualizationFrame.cpp"
#line 26 "/usr/share/sip/PyQt5/QtWidgets/qgraphicseffect.sip"
#include <qgraphicseffect.h>
#line 106 "/home/lassegoncz/catkin_ws/devel/bin/sip/rviz_sip/siplibrviz_siprvizVisualizationFrame.cpp"
#line 26 "/usr/share/sip/PyQt5/QtWidgets/qgraphicsproxywidget.sip"
#include <qgraphicsproxywidget.h>
#line 109 "/home/lassegoncz/catkin_ws/devel/bin/sip/rviz_sip/siplibrviz_siprvizVisualizationFrame.cpp"
#line 192 "/usr/share/sip/PyQt5/QtCore/qglobal.sip"
#include <QtGlobal>
#line 112 "/home/lassegoncz/catkin_ws/devel/bin/sip/rviz_sip/siplibrviz_siprvizVisualizationFrame.cpp"
#line 26 "/usr/share/sip/PyQt5/QtCore/qlocale.sip"
#include <qlocale.h>
#line 115 "/home/lassegoncz/catkin_ws/devel/bin/sip/rviz_sip/siplibrviz_siprvizVisualizationFrame.cpp"
#line 26 "/usr/share/sip/PyQt5/QtGui/qpaintdevice.sip"
#include <qpaintdevice.h>
#line 118 "/home/lassegoncz/catkin_ws/devel/bin/sip/rviz_sip/siplibrviz_siprvizVisualizationFrame.cpp"
#line 26 "/usr/share/sip/PyQt5/QtGui/qregion.sip"
#include <qregion.h>
#line 121 "/home/lassegoncz/catkin_ws/devel/bin/sip/rviz_sip/siplibrviz_siprvizVisualizationFrame.cpp"
#line 28 "/usr/share/sip/PyQt5/QtWidgets/qwidget.sip"
#include <qwidget.h>
#line 124 "/home/lassegoncz/catkin_ws/devel/bin/sip/rviz_sip/siplibrviz_siprvizVisualizationFrame.cpp"
#line 26 "/usr/share/sip/PyQt5/QtGui/qfontinfo.sip"
#include <qfontinfo.h>
#line 127 "/home/lassegoncz/catkin_ws/devel/bin/sip/rviz_sip/siplibrviz_siprvizVisualizationFrame.cpp"
#line 26 "/usr/share/sip/PyQt5/QtGui/qfontmetrics.sip"
#include <qfontmetrics.h>
#line 130 "/home/lassegoncz/catkin_ws/devel/bin/sip/rviz_sip/siplibrviz_siprvizVisualizationFrame.cpp"
#line 26 "/usr/share/sip/PyQt5/QtGui/qfont.sip"
#include <qfont.h>
#line 133 "/home/lassegoncz/catkin_ws/devel/bin/sip/rviz_sip/siplibrviz_siprvizVisualizationFrame.cpp"
#line 26 "/usr/share/sip/PyQt5/QtCore/qvariant.sip"
#include <qvariant.h>
#line 136 "/home/lassegoncz/catkin_ws/devel/bin/sip/rviz_sip/siplibrviz_siprvizVisualizationFrame.cpp"
#line 487 "/usr/share/sip/PyQt5/QtGui/qevent.sip"
#include <qevent.h>
#line 139 "/home/lassegoncz/catkin_ws/devel/bin/sip/rviz_sip/siplibrviz_siprvizVisualizationFrame.cpp"
#line 449 "/usr/share/sip/PyQt5/QtGui/qevent.sip"
#include <qevent.h>
#line 142 "/home/lassegoncz/catkin_ws/devel/bin/sip/rviz_sip/siplibrviz_siprvizVisualizationFrame.cpp"
#line 438 "/usr/share/sip/PyQt5/QtGui/qevent.sip"
#include <qevent.h>
#line 145 "/home/lassegoncz/catkin_ws/devel/bin/sip/rviz_sip/siplibrviz_siprvizVisualizationFrame.cpp"
#line 542 "/usr/share/sip/PyQt5/QtGui/qevent.sip"
#include <qevent.h>
#line 148 "/home/lassegoncz/catkin_ws/devel/bin/sip/rviz_sip/siplibrviz_siprvizVisualizationFrame.cpp"
#line 591 "/usr/share/sip/PyQt5/QtGui/qevent.sip"
#include <qevent.h>
#line 151 "/home/lassegoncz/catkin_ws/devel/bin/sip/rviz_sip/siplibrviz_siprvizVisualizationFrame.cpp"
#line 564 "/usr/share/sip/PyQt5/QtGui/qevent.sip"
#include <qevent.h>
#line 154 "/home/lassegoncz/catkin_ws/devel/bin/sip/rviz_sip/siplibrviz_siprvizVisualizationFrame.cpp"
#line 580 "/usr/share/sip/PyQt5/QtGui/qevent.sip"
#include <qevent.h>
#line 157 "/home/lassegoncz/catkin_ws/devel/bin/sip/rviz_sip/siplibrviz_siprvizVisualizationFrame.cpp"
#line 643 "/usr/share/sip/PyQt5/QtGui/qevent.sip"
#include <qevent.h>
#line 160 "/home/lassegoncz/catkin_ws/devel/bin/sip/rviz_sip/siplibrviz_siprvizVisualizationFrame.cpp"
#line 283 "/usr/share/sip/PyQt5/QtGui/qevent.sip"
#include <qevent.h>
#line 163 "/home/lassegoncz/catkin_ws/devel/bin/sip/rviz_sip/siplibrviz_siprvizVisualizationFrame.cpp"
#line 416 "/usr/share/sip/PyQt5/QtGui/qevent.sip"
#include <qevent.h>
#line 166 "/home/lassegoncz/catkin_ws/devel/bin/sip/rviz_sip/siplibrviz_siprvizVisualizationFrame.cpp"
#line 403 "/usr/share/sip/PyQt5/QtGui/qevent.sip"
#include <qevent.h>
#line 169 "/home/lassegoncz/catkin_ws/devel/bin/sip/rviz_sip/siplibrviz_siprvizVisualizationFrame.cpp"
#line 390 "/usr/share/sip/PyQt5/QtGui/qevent.sip"
#include <qevent.h>
#line 172 "/home/lassegoncz/catkin_ws/devel/bin/sip/rviz_sip/siplibrviz_siprvizVisualizationFrame.cpp"
#line 376 "/usr/share/sip/PyQt5/QtGui/qevent.sip"
#include <qevent.h>
#line 175 "/home/lassegoncz/catkin_ws/devel/bin/sip/rviz_sip/siplibrviz_siprvizVisualizationFrame.cpp"
#line 362 "/usr/share/sip/PyQt5/QtGui/qevent.sip"
#include <qevent.h>
#line 178 "/home/lassegoncz/catkin_ws/devel/bin/sip/rviz_sip/siplibrviz_siprvizVisualizationFrame.cpp"
#line 341 "/usr/share/sip/PyQt5/QtGui/qevent.sip"
#include <qevent.h>
#line 181 "/home/lassegoncz/catkin_ws/devel/bin/sip/rviz_sip/siplibrviz_siprvizVisualizationFrame.cpp"
#line 249 "/usr/share/sip/PyQt5/QtGui/qevent.sip"
#include <qevent.h>
#line 184 "/home/lassegoncz/catkin_ws/devel/bin/sip/rviz_sip/siplibrviz_siprvizVisualizationFrame.cpp"
#line 204 "/usr/share/sip/PyQt5/QtGui/qevent.sip"
#include <qevent.h>
#line 187 "/home/lassegoncz/catkin_ws/devel/bin/sip/rviz_sip/siplibrviz_siprvizVisualizationFrame.cpp"
#line 52 "/usr/share/sip/PyQt5/QtGui/qpaintengine.sip"
#include <qpaintengine.h>
#line 190 "/home/lassegoncz/catkin_ws/devel/bin/sip/rviz_sip/siplibrviz_siprvizVisualizationFrame.cpp"
#line 144 "/usr/share/sip/PyQt5/QtCore/qpycore_qlist.sip"
#include <qlist.h>
#line 193 "/home/lassegoncz/catkin_ws/devel/bin/sip/rviz_sip/siplibrviz_siprvizVisualizationFrame.cpp"
#line 26 "/usr/share/sip/PyQt5/QtWidgets/qaction.sip"
#include <qaction.h>
#line 196 "/home/lassegoncz/catkin_ws/devel/bin/sip/rviz_sip/siplibrviz_siprvizVisualizationFrame.cpp"
#line 26 "/usr/share/sip/PyQt5/QtWidgets/qlayout.sip"
#include <qlayout.h>
#line 199 "/home/lassegoncz/catkin_ws/devel/bin/sip/rviz_sip/siplibrviz_siprvizVisualizationFrame.cpp"
#line 26 "/usr/share/sip/PyQt5/QtWidgets/qsizepolicy.sip"
#include <qsizepolicy.h>
#line 202 "/home/lassegoncz/catkin_ws/devel/bin/sip/rviz_sip/siplibrviz_siprvizVisualizationFrame.cpp"
#line 26 "/usr/share/sip/PyQt5/QtCore/qnamespace.sip"
#include <qnamespace.h>
#line 205 "/home/lassegoncz/catkin_ws/devel/bin/sip/rviz_sip/siplibrviz_siprvizVisualizationFrame.cpp"
#line 26 "/usr/share/sip/PyQt5/QtGui/qkeysequence.sip"
#include <qkeysequence.h>
#line 208 "/home/lassegoncz/catkin_ws/devel/bin/sip/rviz_sip/siplibrviz_siprvizVisualizationFrame.cpp"
#line 26 "/usr/share/sip/PyQt5/QtGui/qcursor.sip"
#include <qcursor.h>
#line 211 "/home/lassegoncz/catkin_ws/devel/bin/sip/rviz_sip/siplibrviz_siprvizVisualizationFrame.cpp"
#line 26 "/usr/share/sip/PyQt5/QtGui/qbitmap.sip"
#include <qbitmap.h>
#line 214 "/home/lassegoncz/catkin_ws/devel/bin/sip/rviz_sip/siplibrviz_siprvizVisualizationFrame.cpp"
#line 26 "/usr/share/sip/PyQt5/QtGui/qpalette.sip"
#include <qpalette.h>
#line 217 "/home/lassegoncz/catkin_ws/devel/bin/sip/rviz_sip/siplibrviz_siprvizVisualizationFrame.cpp"
#line 26 "/usr/share/sip/PyQt5/QtWidgets/qstyle.sip"
#include <qstyle.h>
#line 220 "/home/lassegoncz/catkin_ws/devel/bin/sip/rviz_sip/siplibrviz_siprvizVisualizationFrame.cpp"
#line 26 "/usr/share/sip/PyQt5/QtCore/qmetaobject.sip"
#include <qmetaobject.h>
#line 223 "/home/lassegoncz/catkin_ws/devel/bin/sip/rviz_sip/siplibrviz_siprvizVisualizationFrame.cpp"
#line 244 "/usr/share/sip/PyQt5/QtCore/qcoreevent.sip"
#include <qcoreevent.h>
#line 226 "/home/lassegoncz/catkin_ws/devel/bin/sip/rviz_sip/siplibrviz_siprvizVisualizationFrame.cpp"
#line 232 "/usr/share/sip/PyQt5/QtCore/qcoreevent.sip"
#include <qcoreevent.h>
#line 229 "/home/lassegoncz/catkin_ws/devel/bin/sip/rviz_sip/siplibrviz_siprvizVisualizationFrame.cpp"
#line 28 "/usr/share/sip/PyQt5/QtCore/qobject.sip"
#include <qobject.h>
#line 232 "/home/lassegoncz/catkin_ws/devel/bin/sip/rviz_sip/siplibrviz_siprvizVisualizationFrame.cpp"
#line 36 "/usr/share/sip/PyQt5/QtCore/qpycore_qlist.sip"
#include <qlist.h>
#line 235 "/home/lassegoncz/catkin_ws/devel/bin/sip/rviz_sip/siplibrviz_siprvizVisualizationFrame.cpp"
#line 144 "/usr/share/sip/PyQt5/QtCore/qpycore_qlist.sip"
#include <qlist.h>
#line 238 "/home/lassegoncz/catkin_ws/devel/bin/sip/rviz_sip/siplibrviz_siprvizVisualizationFrame.cpp"
#line 26 "/usr/share/sip/PyQt5/QtCore/qthread.sip"
#include <qthread.h>
#line 241 "/home/lassegoncz/catkin_ws/devel/bin/sip/rviz_sip/siplibrviz_siprvizVisualizationFrame.cpp"
#line 26 "/usr/share/sip/PyQt5/QtCore/qnamespace.sip"
#include <qnamespace.h>
#line 244 "/home/lassegoncz/catkin_ws/devel/bin/sip/rviz_sip/siplibrviz_siprvizVisualizationFrame.cpp"
#line 26 "/usr/share/sip/PyQt5/QtCore/qregexp.sip"
#include <qregexp.h>
#line 247 "/home/lassegoncz/catkin_ws/devel/bin/sip/rviz_sip/siplibrviz_siprvizVisualizationFrame.cpp"
#line 26 "/usr/share/sip/PyQt5/QtCore/qregularexpression.sip"
#include <qregularexpression.h>
#line 250 "/home/lassegoncz/catkin_ws/devel/bin/sip/rviz_sip/siplibrviz_siprvizVisualizationFrame.cpp"
#line 26 "/usr/share/sip/PyQt5/QtCore/qobjectdefs.sip"
#include <qobjectdefs.h>
#line 253 "/home/lassegoncz/catkin_ws/devel/bin/sip/rviz_sip/siplibrviz_siprvizVisualizationFrame.cpp"


class siprviz_VisualizationFrame : public rviz::VisualizationFrame
{
public:
    siprviz_VisualizationFrame(QWidget*);
    virtual ~siprviz_VisualizationFrame();

    int qt_metacall(QMetaObject::Call,int,void **);
    void *qt_metacast(const char *);
    const QMetaObject *metaObject() const;

    /*
     * There is a public method for every protected method visible from
     * this class.
     */
    QObject* sipProtect_sender() const;
    int sipProtect_receivers(const char*) const;
    void sipProtectVirt_timerEvent(bool,QTimerEvent*);
    void sipProtectVirt_childEvent(bool,QChildEvent*);
    void sipProtectVirt_customEvent(bool,QEvent*);
    void sipProtectVirt_connectNotify(bool,const QMetaMethod&);
    void sipProtectVirt_disconnectNotify(bool,const QMetaMethod&);
    int sipProtect_senderSignalIndex() const;
    bool sipProtect_isSignalConnected(const QMetaMethod&) const;
    void sipProtectVirt_mousePressEvent(bool,QMouseEvent*);
    void sipProtectVirt_mouseReleaseEvent(bool,QMouseEvent*);
    void sipProtectVirt_mouseDoubleClickEvent(bool,QMouseEvent*);
    void sipProtectVirt_mouseMoveEvent(bool,QMouseEvent*);
    void sipProtectVirt_wheelEvent(bool,QWheelEvent*);
    void sipProtectVirt_keyPressEvent(bool,QKeyEvent*);
    void sipProtectVirt_keyReleaseEvent(bool,QKeyEvent*);
    void sipProtectVirt_focusInEvent(bool,QFocusEvent*);
    void sipProtectVirt_focusOutEvent(bool,QFocusEvent*);
    void sipProtectVirt_enterEvent(bool,QEvent*);
    void sipProtectVirt_leaveEvent(bool,QEvent*);
    void sipProtectVirt_paintEvent(bool,QPaintEvent*);
    void sipProtectVirt_moveEvent(bool,QMoveEvent*);
    void sipProtectVirt_resizeEvent(bool,QResizeEvent*);
    void sipProtectVirt_closeEvent(bool,QCloseEvent*);
    void sipProtectVirt_tabletEvent(bool,QTabletEvent*);
    void sipProtectVirt_actionEvent(bool,QActionEvent*);
    void sipProtectVirt_dragEnterEvent(bool,QDragEnterEvent*);
    void sipProtectVirt_dragMoveEvent(bool,QDragMoveEvent*);
    void sipProtectVirt_dragLeaveEvent(bool,QDragLeaveEvent*);
    void sipProtectVirt_dropEvent(bool,QDropEvent*);
    void sipProtectVirt_showEvent(bool,QShowEvent*);
    void sipProtectVirt_hideEvent(bool,QHideEvent*);
    void sipProtectVirt_changeEvent(bool,QEvent*);
    int sipProtectVirt_metric(bool,QPaintDevice::PaintDeviceMetric) const;
    void sipProtectVirt_inputMethodEvent(bool,QInputMethodEvent*);
    void sipProtect_updateMicroFocus();
    void sipProtect_create(WId,bool,bool);
    void sipProtect_destroy(bool,bool);
    bool sipProtectVirt_focusNextPrevChild(bool,bool);
    bool sipProtect_focusNextChild();
    bool sipProtect_focusPreviousChild();
    bool sipProtectVirt_nativeEvent(bool,const QByteArray&,void*,long*);
    QPainter* sipProtectVirt_sharedPainter(bool) const;
    void sipProtectVirt_initPainter(bool,QPainter*) const;
    void sipProtectVirt_contextMenuEvent(bool,QContextMenuEvent*);
    bool sipProtectVirt_event(bool,QEvent*);

    /*
     * There is a protected method for every virtual method visible from
     * this class.
     */
protected:
    void disconnectNotify(const QMetaMethod&);
    void connectNotify(const QMetaMethod&);
    void customEvent(QEvent*);
    void childEvent(QChildEvent*);
    void timerEvent(QTimerEvent*);
    bool eventFilter(QObject*,QEvent*);
    void initPainter(QPainter*) const;
    QPainter* sharedPainter() const;
    bool nativeEvent(const QByteArray&,void*,long*);
    bool hasHeightForWidth() const;
    bool focusNextPrevChild(bool);
    QVariant inputMethodQuery(Qt::InputMethodQuery) const;
    void inputMethodEvent(QInputMethodEvent*);
    int metric(QPaintDevice::PaintDeviceMetric) const;
    void changeEvent(QEvent*);
    void hideEvent(QHideEvent*);
    void showEvent(QShowEvent*);
    void dropEvent(QDropEvent*);
    void dragLeaveEvent(QDragLeaveEvent*);
    void dragMoveEvent(QDragMoveEvent*);
    void dragEnterEvent(QDragEnterEvent*);
    void actionEvent(QActionEvent*);
    void tabletEvent(QTabletEvent*);
    void closeEvent(QCloseEvent*);
    void resizeEvent(QResizeEvent*);
    void moveEvent(QMoveEvent*);
    void paintEvent(QPaintEvent*);
    void leaveEvent(QEvent*);
    void enterEvent(QEvent*);
    void focusOutEvent(QFocusEvent*);
    void focusInEvent(QFocusEvent*);
    void keyReleaseEvent(QKeyEvent*);
    void keyPressEvent(QKeyEvent*);
    void wheelEvent(QWheelEvent*);
    void mouseMoveEvent(QMouseEvent*);
    void mouseDoubleClickEvent(QMouseEvent*);
    void mouseReleaseEvent(QMouseEvent*);
    void mousePressEvent(QMouseEvent*);
    QPaintEngine* paintEngine() const;
    int heightForWidth(int) const;
    QSize minimumSizeHint() const;
    QSize sizeHint() const;
    void setVisible(bool);
    int devType() const;
    bool event(QEvent*);
    void contextMenuEvent(QContextMenuEvent*);
    QMenu* createPopupMenu();
    void save(rviz::Config);
    void load(const rviz::Config&);
    rviz::PanelDockWidget* addPane(const QString&,QWidget*,Qt::DockWidgetArea,bool);
    QWidget* getParentWindow();

public:
    sipSimpleWrapper *sipPySelf;

private:
    siprviz_VisualizationFrame(const siprviz_VisualizationFrame &);
    siprviz_VisualizationFrame &operator = (const siprviz_VisualizationFrame &);

    char sipPyMethods[51];
};

siprviz_VisualizationFrame::siprviz_VisualizationFrame(QWidget*a0): rviz::VisualizationFrame(a0), sipPySelf(0)
{
    memset(sipPyMethods, 0, sizeof (sipPyMethods));
}

siprviz_VisualizationFrame::~siprviz_VisualizationFrame()
{
    sipCommonDtor(sipPySelf);
}

const QMetaObject *siprviz_VisualizationFrame::metaObject() const
{
    return QObject::d_ptr->metaObject ? QObject::d_ptr->dynamicMetaObject() : sip_librviz_sip_qt_metaobject(sipPySelf,sipType_rviz_VisualizationFrame);
}

int siprviz_VisualizationFrame::qt_metacall(QMetaObject::Call _c,int _id,void **_a)
{
    _id = rviz::VisualizationFrame::qt_metacall(_c,_id,_a);

    if (_id >= 0)
        _id = sip_librviz_sip_qt_metacall(sipPySelf,sipType_rviz_VisualizationFrame,_c,_id,_a);

    return _id;
}

void *siprviz_VisualizationFrame::qt_metacast(const char *_clname)
{
    void *sipCpp;

    return (sip_librviz_sip_qt_metacast(sipPySelf, sipType_rviz_VisualizationFrame, _clname, &sipCpp) ? sipCpp : rviz::VisualizationFrame::qt_metacast(_clname));
}

void siprviz_VisualizationFrame::disconnectNotify(const QMetaMethod& a0)
{
    sip_gilstate_t sipGILState;
    PyObject *sipMeth;

    sipMeth = sipIsPyMethod(&sipGILState,&sipPyMethods[0],sipPySelf,NULL,sipName_disconnectNotify);

    if (!sipMeth)
    {
        rviz::VisualizationFrame::disconnectNotify(a0);
        return;
    }

    typedef void (*sipVH_QtCore_46)(sip_gilstate_t, sipVirtErrorHandlerFunc, sipSimpleWrapper *, PyObject *, const QMetaMethod&);

    ((sipVH_QtCore_46)(sipModuleAPI_librviz_sip_QtCore->em_virthandlers[46]))(sipGILState, sipModuleAPI_librviz_sip_QtCore->em_virterrorhandlers[0], sipPySelf, sipMeth, a0);
}

void siprviz_VisualizationFrame::connectNotify(const QMetaMethod& a0)
{
    sip_gilstate_t sipGILState;
    PyObject *sipMeth;

    sipMeth = sipIsPyMethod(&sipGILState,&sipPyMethods[1],sipPySelf,NULL,sipName_connectNotify);

    if (!sipMeth)
    {
        rviz::VisualizationFrame::connectNotify(a0);
        return;
    }

    typedef void (*sipVH_QtCore_46)(sip_gilstate_t, sipVirtErrorHandlerFunc, sipSimpleWrapper *, PyObject *, const QMetaMethod&);

    ((sipVH_QtCore_46)(sipModuleAPI_librviz_sip_QtCore->em_virthandlers[46]))(sipGILState, sipModuleAPI_librviz_sip_QtCore->em_virterrorhandlers[0], sipPySelf, sipMeth, a0);
}

void siprviz_VisualizationFrame::customEvent(QEvent*a0)
{
    sip_gilstate_t sipGILState;
    PyObject *sipMeth;

    sipMeth = sipIsPyMethod(&sipGILState,&sipPyMethods[2],sipPySelf,NULL,sipName_customEvent);

    if (!sipMeth)
    {
        rviz::VisualizationFrame::customEvent(a0);
        return;
    }

    typedef void (*sipVH_QtCore_25)(sip_gilstate_t, sipVirtErrorHandlerFunc, sipSimpleWrapper *, PyObject *, QEvent*);

    ((sipVH_QtCore_25)(sipModuleAPI_librviz_sip_QtCore->em_virthandlers[25]))(sipGILState, sipModuleAPI_librviz_sip_QtCore->em_virterrorhandlers[0], sipPySelf, sipMeth, a0);
}

void siprviz_VisualizationFrame::childEvent(QChildEvent*a0)
{
    sip_gilstate_t sipGILState;
    PyObject *sipMeth;

    sipMeth = sipIsPyMethod(&sipGILState,&sipPyMethods[3],sipPySelf,NULL,sipName_childEvent);

    if (!sipMeth)
    {
        rviz::VisualizationFrame::childEvent(a0);
        return;
    }

    typedef void (*sipVH_QtCore_47)(sip_gilstate_t, sipVirtErrorHandlerFunc, sipSimpleWrapper *, PyObject *, QChildEvent*);

    ((sipVH_QtCore_47)(sipModuleAPI_librviz_sip_QtCore->em_virthandlers[47]))(sipGILState, sipModuleAPI_librviz_sip_QtCore->em_virterrorhandlers[0], sipPySelf, sipMeth, a0);
}

void siprviz_VisualizationFrame::timerEvent(QTimerEvent*a0)
{
    sip_gilstate_t sipGILState;
    PyObject *sipMeth;

    sipMeth = sipIsPyMethod(&sipGILState,&sipPyMethods[4],sipPySelf,NULL,sipName_timerEvent);

    if (!sipMeth)
    {
        rviz::VisualizationFrame::timerEvent(a0);
        return;
    }

    typedef void (*sipVH_QtCore_9)(sip_gilstate_t, sipVirtErrorHandlerFunc, sipSimpleWrapper *, PyObject *, QTimerEvent*);

    ((sipVH_QtCore_9)(sipModuleAPI_librviz_sip_QtCore->em_virthandlers[9]))(sipGILState, sipModuleAPI_librviz_sip_QtCore->em_virterrorhandlers[0], sipPySelf, sipMeth, a0);
}

bool siprviz_VisualizationFrame::eventFilter(QObject*a0,QEvent*a1)
{
    sip_gilstate_t sipGILState;
    PyObject *sipMeth;

    sipMeth = sipIsPyMethod(&sipGILState,&sipPyMethods[5],sipPySelf,NULL,sipName_eventFilter);

    if (!sipMeth)
        return rviz::VisualizationFrame::eventFilter(a0,a1);

    typedef bool (*sipVH_QtCore_26)(sip_gilstate_t, sipVirtErrorHandlerFunc, sipSimpleWrapper *, PyObject *, QObject*,QEvent*);

    return ((sipVH_QtCore_26)(sipModuleAPI_librviz_sip_QtCore->em_virthandlers[26]))(sipGILState, sipModuleAPI_librviz_sip_QtCore->em_virterrorhandlers[0], sipPySelf, sipMeth, a0, a1);
}

void siprviz_VisualizationFrame::initPainter(QPainter*a0) const
{
    sip_gilstate_t sipGILState;
    PyObject *sipMeth;

    sipMeth = sipIsPyMethod(&sipGILState,const_cast<char *>(&sipPyMethods[6]),sipPySelf,NULL,sipName_initPainter);

    if (!sipMeth)
    {
        rviz::VisualizationFrame::initPainter(a0);
        return;
    }

    typedef void (*sipVH_QtWidgets_3)(sip_gilstate_t, sipVirtErrorHandlerFunc, sipSimpleWrapper *, PyObject *, QPainter*);

    ((sipVH_QtWidgets_3)(sipModuleAPI_librviz_sip_QtWidgets->em_virthandlers[3]))(sipGILState, sipModuleAPI_librviz_sip_QtCore->em_virterrorhandlers[0], sipPySelf, sipMeth, a0);
}

QPainter* siprviz_VisualizationFrame::sharedPainter() const
{
    sip_gilstate_t sipGILState;
    PyObject *sipMeth;

    sipMeth = sipIsPyMethod(&sipGILState,const_cast<char *>(&sipPyMethods[7]),sipPySelf,NULL,sipName_sharedPainter);

    if (!sipMeth)
        return rviz::VisualizationFrame::sharedPainter();

    typedef QPainter* (*sipVH_QtWidgets_4)(sip_gilstate_t, sipVirtErrorHandlerFunc, sipSimpleWrapper *, PyObject *);

    return ((sipVH_QtWidgets_4)(sipModuleAPI_librviz_sip_QtWidgets->em_virthandlers[4]))(sipGILState, sipModuleAPI_librviz_sip_QtCore->em_virterrorhandlers[0], sipPySelf, sipMeth);
}

bool siprviz_VisualizationFrame::nativeEvent(const QByteArray& a0,void*a1,long*a2)
{
    sip_gilstate_t sipGILState;
    PyObject *sipMeth;

    sipMeth = sipIsPyMethod(&sipGILState,&sipPyMethods[8],sipPySelf,NULL,sipName_nativeEvent);

    if (!sipMeth)
        return rviz::VisualizationFrame::nativeEvent(a0,a1,a2);

    typedef bool (*sipVH_QtCore_58)(sip_gilstate_t, sipVirtErrorHandlerFunc, sipSimpleWrapper *, PyObject *, const QByteArray&,void*,long*);

    return ((sipVH_QtCore_58)(sipModuleAPI_librviz_sip_QtCore->em_virthandlers[58]))(sipGILState, sipModuleAPI_librviz_sip_QtCore->em_virterrorhandlers[0], sipPySelf, sipMeth, a0, a1, a2);
}

bool siprviz_VisualizationFrame::hasHeightForWidth() const
{
    sip_gilstate_t sipGILState;
    PyObject *sipMeth;

    sipMeth = sipIsPyMethod(&sipGILState,const_cast<char *>(&sipPyMethods[9]),sipPySelf,NULL,sipName_hasHeightForWidth);

    if (!sipMeth)
        return rviz::VisualizationFrame::hasHeightForWidth();

    typedef bool (*sipVH_QtCore_7)(sip_gilstate_t, sipVirtErrorHandlerFunc, sipSimpleWrapper *, PyObject *);

    return ((sipVH_QtCore_7)(sipModuleAPI_librviz_sip_QtCore->em_virthandlers[7]))(sipGILState, sipModuleAPI_librviz_sip_QtCore->em_virterrorhandlers[0], sipPySelf, sipMeth);
}

bool siprviz_VisualizationFrame::focusNextPrevChild(bool a0)
{
    sip_gilstate_t sipGILState;
    PyObject *sipMeth;

    sipMeth = sipIsPyMethod(&sipGILState,&sipPyMethods[10],sipPySelf,NULL,sipName_focusNextPrevChild);

    if (!sipMeth)
        return rviz::VisualizationFrame::focusNextPrevChild(a0);

    typedef bool (*sipVH_QtWidgets_5)(sip_gilstate_t, sipVirtErrorHandlerFunc, sipSimpleWrapper *, PyObject *, bool);

    return ((sipVH_QtWidgets_5)(sipModuleAPI_librviz_sip_QtWidgets->em_virthandlers[5]))(sipGILState, sipModuleAPI_librviz_sip_QtCore->em_virterrorhandlers[0], sipPySelf, sipMeth, a0);
}

QVariant siprviz_VisualizationFrame::inputMethodQuery(Qt::InputMethodQuery a0) const
{
    sip_gilstate_t sipGILState;
    PyObject *sipMeth;

    sipMeth = sipIsPyMethod(&sipGILState,const_cast<char *>(&sipPyMethods[11]),sipPySelf,NULL,sipName_inputMethodQuery);

    if (!sipMeth)
        return rviz::VisualizationFrame::inputMethodQuery(a0);

    typedef QVariant (*sipVH_QtWidgets_6)(sip_gilstate_t, sipVirtErrorHandlerFunc, sipSimpleWrapper *, PyObject *, Qt::InputMethodQuery);

    return ((sipVH_QtWidgets_6)(sipModuleAPI_librviz_sip_QtWidgets->em_virthandlers[6]))(sipGILState, sipModuleAPI_librviz_sip_QtCore->em_virterrorhandlers[0], sipPySelf, sipMeth, a0);
}

void siprviz_VisualizationFrame::inputMethodEvent(QInputMethodEvent*a0)
{
    sip_gilstate_t sipGILState;
    PyObject *sipMeth;

    sipMeth = sipIsPyMethod(&sipGILState,&sipPyMethods[12],sipPySelf,NULL,sipName_inputMethodEvent);

    if (!sipMeth)
    {
        rviz::VisualizationFrame::inputMethodEvent(a0);
        return;
    }

    typedef void (*sipVH_QtWidgets_7)(sip_gilstate_t, sipVirtErrorHandlerFunc, sipSimpleWrapper *, PyObject *, QInputMethodEvent*);

    ((sipVH_QtWidgets_7)(sipModuleAPI_librviz_sip_QtWidgets->em_virthandlers[7]))(sipGILState, sipModuleAPI_librviz_sip_QtCore->em_virterrorhandlers[0], sipPySelf, sipMeth, a0);
}

int siprviz_VisualizationFrame::metric(QPaintDevice::PaintDeviceMetric a0) const
{
    sip_gilstate_t sipGILState;
    PyObject *sipMeth;

    sipMeth = sipIsPyMethod(&sipGILState,const_cast<char *>(&sipPyMethods[13]),sipPySelf,NULL,sipName_metric);

    if (!sipMeth)
        return rviz::VisualizationFrame::metric(a0);

    typedef int (*sipVH_QtGui_28)(sip_gilstate_t, sipVirtErrorHandlerFunc, sipSimpleWrapper *, PyObject *, QPaintDevice::PaintDeviceMetric);

    return ((sipVH_QtGui_28)(sipModuleAPI_librviz_sip_QtGui->em_virthandlers[28]))(sipGILState, sipModuleAPI_librviz_sip_QtCore->em_virterrorhandlers[0], sipPySelf, sipMeth, a0);
}

void siprviz_VisualizationFrame::changeEvent(QEvent*a0)
{
    sip_gilstate_t sipGILState;
    PyObject *sipMeth;

    sipMeth = sipIsPyMethod(&sipGILState,&sipPyMethods[14],sipPySelf,NULL,sipName_changeEvent);

    if (!sipMeth)
    {
        rviz::VisualizationFrame::changeEvent(a0);
        return;
    }

    typedef void (*sipVH_QtCore_25)(sip_gilstate_t, sipVirtErrorHandlerFunc, sipSimpleWrapper *, PyObject *, QEvent*);

    ((sipVH_QtCore_25)(sipModuleAPI_librviz_sip_QtCore->em_virthandlers[25]))(sipGILState, sipModuleAPI_librviz_sip_QtCore->em_virterrorhandlers[0], sipPySelf, sipMeth, a0);
}

void siprviz_VisualizationFrame::hideEvent(QHideEvent*a0)
{
    sip_gilstate_t sipGILState;
    PyObject *sipMeth;

    sipMeth = sipIsPyMethod(&sipGILState,&sipPyMethods[15],sipPySelf,NULL,sipName_hideEvent);

    if (!sipMeth)
    {
        rviz::VisualizationFrame::hideEvent(a0);
        return;
    }

    typedef void (*sipVH_QtGui_5)(sip_gilstate_t, sipVirtErrorHandlerFunc, sipSimpleWrapper *, PyObject *, QHideEvent*);

    ((sipVH_QtGui_5)(sipModuleAPI_librviz_sip_QtGui->em_virthandlers[5]))(sipGILState, sipModuleAPI_librviz_sip_QtCore->em_virterrorhandlers[0], sipPySelf, sipMeth, a0);
}

void siprviz_VisualizationFrame::showEvent(QShowEvent*a0)
{
    sip_gilstate_t sipGILState;
    PyObject *sipMeth;

    sipMeth = sipIsPyMethod(&sipGILState,&sipPyMethods[16],sipPySelf,NULL,sipName_showEvent);

    if (!sipMeth)
    {
        rviz::VisualizationFrame::showEvent(a0);
        return;
    }

    typedef void (*sipVH_QtGui_6)(sip_gilstate_t, sipVirtErrorHandlerFunc, sipSimpleWrapper *, PyObject *, QShowEvent*);

    ((sipVH_QtGui_6)(sipModuleAPI_librviz_sip_QtGui->em_virthandlers[6]))(sipGILState, sipModuleAPI_librviz_sip_QtCore->em_virterrorhandlers[0], sipPySelf, sipMeth, a0);
}

void siprviz_VisualizationFrame::dropEvent(QDropEvent*a0)
{
    sip_gilstate_t sipGILState;
    PyObject *sipMeth;

    sipMeth = sipIsPyMethod(&sipGILState,&sipPyMethods[17],sipPySelf,NULL,sipName_dropEvent);

    if (!sipMeth)
    {
        rviz::VisualizationFrame::dropEvent(a0);
        return;
    }

    typedef void (*sipVH_QtWidgets_8)(sip_gilstate_t, sipVirtErrorHandlerFunc, sipSimpleWrapper *, PyObject *, QDropEvent*);

    ((sipVH_QtWidgets_8)(sipModuleAPI_librviz_sip_QtWidgets->em_virthandlers[8]))(sipGILState, sipModuleAPI_librviz_sip_QtCore->em_virterrorhandlers[0], sipPySelf, sipMeth, a0);
}

void siprviz_VisualizationFrame::dragLeaveEvent(QDragLeaveEvent*a0)
{
    sip_gilstate_t sipGILState;
    PyObject *sipMeth;

    sipMeth = sipIsPyMethod(&sipGILState,&sipPyMethods[18],sipPySelf,NULL,sipName_dragLeaveEvent);

    if (!sipMeth)
    {
        rviz::VisualizationFrame::dragLeaveEvent(a0);
        return;
    }

    typedef void (*sipVH_QtWidgets_9)(sip_gilstate_t, sipVirtErrorHandlerFunc, sipSimpleWrapper *, PyObject *, QDragLeaveEvent*);

    ((sipVH_QtWidgets_9)(sipModuleAPI_librviz_sip_QtWidgets->em_virthandlers[9]))(sipGILState, sipModuleAPI_librviz_sip_QtCore->em_virterrorhandlers[0], sipPySelf, sipMeth, a0);
}

void siprviz_VisualizationFrame::dragMoveEvent(QDragMoveEvent*a0)
{
    sip_gilstate_t sipGILState;
    PyObject *sipMeth;

    sipMeth = sipIsPyMethod(&sipGILState,&sipPyMethods[19],sipPySelf,NULL,sipName_dragMoveEvent);

    if (!sipMeth)
    {
        rviz::VisualizationFrame::dragMoveEvent(a0);
        return;
    }

    typedef void (*sipVH_QtWidgets_10)(sip_gilstate_t, sipVirtErrorHandlerFunc, sipSimpleWrapper *, PyObject *, QDragMoveEvent*);

    ((sipVH_QtWidgets_10)(sipModuleAPI_librviz_sip_QtWidgets->em_virthandlers[10]))(sipGILState, sipModuleAPI_librviz_sip_QtCore->em_virterrorhandlers[0], sipPySelf, sipMeth, a0);
}

void siprviz_VisualizationFrame::dragEnterEvent(QDragEnterEvent*a0)
{
    sip_gilstate_t sipGILState;
    PyObject *sipMeth;

    sipMeth = sipIsPyMethod(&sipGILState,&sipPyMethods[20],sipPySelf,NULL,sipName_dragEnterEvent);

    if (!sipMeth)
    {
        rviz::VisualizationFrame::dragEnterEvent(a0);
        return;
    }

    typedef void (*sipVH_QtWidgets_11)(sip_gilstate_t, sipVirtErrorHandlerFunc, sipSimpleWrapper *, PyObject *, QDragEnterEvent*);

    ((sipVH_QtWidgets_11)(sipModuleAPI_librviz_sip_QtWidgets->em_virthandlers[11]))(sipGILState, sipModuleAPI_librviz_sip_QtCore->em_virterrorhandlers[0], sipPySelf, sipMeth, a0);
}

void siprviz_VisualizationFrame::actionEvent(QActionEvent*a0)
{
    sip_gilstate_t sipGILState;
    PyObject *sipMeth;

    sipMeth = sipIsPyMethod(&sipGILState,&sipPyMethods[21],sipPySelf,NULL,sipName_actionEvent);

    if (!sipMeth)
    {
        rviz::VisualizationFrame::actionEvent(a0);
        return;
    }

    typedef void (*sipVH_QtWidgets_12)(sip_gilstate_t, sipVirtErrorHandlerFunc, sipSimpleWrapper *, PyObject *, QActionEvent*);

    ((sipVH_QtWidgets_12)(sipModuleAPI_librviz_sip_QtWidgets->em_virthandlers[12]))(sipGILState, sipModuleAPI_librviz_sip_QtCore->em_virterrorhandlers[0], sipPySelf, sipMeth, a0);
}

void siprviz_VisualizationFrame::tabletEvent(QTabletEvent*a0)
{
    sip_gilstate_t sipGILState;
    PyObject *sipMeth;

    sipMeth = sipIsPyMethod(&sipGILState,&sipPyMethods[22],sipPySelf,NULL,sipName_tabletEvent);

    if (!sipMeth)
    {
        rviz::VisualizationFrame::tabletEvent(a0);
        return;
    }

    typedef void (*sipVH_QtGui_0)(sip_gilstate_t, sipVirtErrorHandlerFunc, sipSimpleWrapper *, PyObject *, QTabletEvent*);

    ((sipVH_QtGui_0)(sipModuleAPI_librviz_sip_QtGui->em_virthandlers[0]))(sipGILState, sipModuleAPI_librviz_sip_QtCore->em_virterrorhandlers[0], sipPySelf, sipMeth, a0);
}

void siprviz_VisualizationFrame::closeEvent(QCloseEvent*a0)
{
    sip_gilstate_t sipGILState;
    PyObject *sipMeth;

    sipMeth = sipIsPyMethod(&sipGILState,&sipPyMethods[23],sipPySelf,NULL,sipName_closeEvent);

    if (!sipMeth)
    {
        rviz::VisualizationFrame::closeEvent(a0);
        return;
    }

    typedef void (*sipVH_QtWidgets_14)(sip_gilstate_t, sipVirtErrorHandlerFunc, sipSimpleWrapper *, PyObject *, QCloseEvent*);

    ((sipVH_QtWidgets_14)(sipModuleAPI_librviz_sip_QtWidgets->em_virthandlers[14]))(sipGILState, sipModuleAPI_librviz_sip_QtCore->em_virterrorhandlers[0], sipPySelf, sipMeth, a0);
}

void siprviz_VisualizationFrame::resizeEvent(QResizeEvent*a0)
{
    sip_gilstate_t sipGILState;
    PyObject *sipMeth;

    sipMeth = sipIsPyMethod(&sipGILState,&sipPyMethods[24],sipPySelf,NULL,sipName_resizeEvent);

    if (!sipMeth)
    {
        rviz::VisualizationFrame::resizeEvent(a0);
        return;
    }

    typedef void (*sipVH_QtGui_9)(sip_gilstate_t, sipVirtErrorHandlerFunc, sipSimpleWrapper *, PyObject *, QResizeEvent*);

    ((sipVH_QtGui_9)(sipModuleAPI_librviz_sip_QtGui->em_virthandlers[9]))(sipGILState, sipModuleAPI_librviz_sip_QtCore->em_virterrorhandlers[0], sipPySelf, sipMeth, a0);
}

void siprviz_VisualizationFrame::moveEvent(QMoveEvent*a0)
{
    sip_gilstate_t sipGILState;
    PyObject *sipMeth;

    sipMeth = sipIsPyMethod(&sipGILState,&sipPyMethods[25],sipPySelf,NULL,sipName_moveEvent);

    if (!sipMeth)
    {
        rviz::VisualizationFrame::moveEvent(a0);
        return;
    }

    typedef void (*sipVH_QtGui_8)(sip_gilstate_t, sipVirtErrorHandlerFunc, sipSimpleWrapper *, PyObject *, QMoveEvent*);

    ((sipVH_QtGui_8)(sipModuleAPI_librviz_sip_QtGui->em_virthandlers[8]))(sipGILState, sipModuleAPI_librviz_sip_QtCore->em_virterrorhandlers[0], sipPySelf, sipMeth, a0);
}

void siprviz_VisualizationFrame::paintEvent(QPaintEvent*a0)
{
    sip_gilstate_t sipGILState;
    PyObject *sipMeth;

    sipMeth = sipIsPyMethod(&sipGILState,&sipPyMethods[26],sipPySelf,NULL,sipName_paintEvent);

    if (!sipMeth)
    {
        rviz::VisualizationFrame::paintEvent(a0);
        return;
    }

    typedef void (*sipVH_QtGui_52)(sip_gilstate_t, sipVirtErrorHandlerFunc, sipSimpleWrapper *, PyObject *, QPaintEvent*);

    ((sipVH_QtGui_52)(sipModuleAPI_librviz_sip_QtGui->em_virthandlers[52]))(sipGILState, sipModuleAPI_librviz_sip_QtCore->em_virterrorhandlers[0], sipPySelf, sipMeth, a0);
}

void siprviz_VisualizationFrame::leaveEvent(QEvent*a0)
{
    sip_gilstate_t sipGILState;
    PyObject *sipMeth;

    sipMeth = sipIsPyMethod(&sipGILState,&sipPyMethods[27],sipPySelf,NULL,sipName_leaveEvent);

    if (!sipMeth)
    {
        rviz::VisualizationFrame::leaveEvent(a0);
        return;
    }

    typedef void (*sipVH_QtCore_25)(sip_gilstate_t, sipVirtErrorHandlerFunc, sipSimpleWrapper *, PyObject *, QEvent*);

    ((sipVH_QtCore_25)(sipModuleAPI_librviz_sip_QtCore->em_virthandlers[25]))(sipGILState, sipModuleAPI_librviz_sip_QtCore->em_virterrorhandlers[0], sipPySelf, sipMeth, a0);
}

void siprviz_VisualizationFrame::enterEvent(QEvent*a0)
{
    sip_gilstate_t sipGILState;
    PyObject *sipMeth;

    sipMeth = sipIsPyMethod(&sipGILState,&sipPyMethods[28],sipPySelf,NULL,sipName_enterEvent);

    if (!sipMeth)
    {
        rviz::VisualizationFrame::enterEvent(a0);
        return;
    }

    typedef void (*sipVH_QtCore_25)(sip_gilstate_t, sipVirtErrorHandlerFunc, sipSimpleWrapper *, PyObject *, QEvent*);

    ((sipVH_QtCore_25)(sipModuleAPI_librviz_sip_QtCore->em_virthandlers[25]))(sipGILState, sipModuleAPI_librviz_sip_QtCore->em_virterrorhandlers[0], sipPySelf, sipMeth, a0);
}

void siprviz_VisualizationFrame::focusOutEvent(QFocusEvent*a0)
{
    sip_gilstate_t sipGILState;
    PyObject *sipMeth;

    sipMeth = sipIsPyMethod(&sipGILState,&sipPyMethods[29],sipPySelf,NULL,sipName_focusOutEvent);

    if (!sipMeth)
    {
        rviz::VisualizationFrame::focusOutEvent(a0);
        return;
    }

    typedef void (*sipVH_QtGui_7)(sip_gilstate_t, sipVirtErrorHandlerFunc, sipSimpleWrapper *, PyObject *, QFocusEvent*);

    ((sipVH_QtGui_7)(sipModuleAPI_librviz_sip_QtGui->em_virthandlers[7]))(sipGILState, sipModuleAPI_librviz_sip_QtCore->em_virterrorhandlers[0], sipPySelf, sipMeth, a0);
}

void siprviz_VisualizationFrame::focusInEvent(QFocusEvent*a0)
{
    sip_gilstate_t sipGILState;
    PyObject *sipMeth;

    sipMeth = sipIsPyMethod(&sipGILState,&sipPyMethods[30],sipPySelf,NULL,sipName_focusInEvent);

    if (!sipMeth)
    {
        rviz::VisualizationFrame::focusInEvent(a0);
        return;
    }

    typedef void (*sipVH_QtGui_7)(sip_gilstate_t, sipVirtErrorHandlerFunc, sipSimpleWrapper *, PyObject *, QFocusEvent*);

    ((sipVH_QtGui_7)(sipModuleAPI_librviz_sip_QtGui->em_virthandlers[7]))(sipGILState, sipModuleAPI_librviz_sip_QtCore->em_virterrorhandlers[0], sipPySelf, sipMeth, a0);
}

void siprviz_VisualizationFrame::keyReleaseEvent(QKeyEvent*a0)
{
    sip_gilstate_t sipGILState;
    PyObject *sipMeth;

    sipMeth = sipIsPyMethod(&sipGILState,&sipPyMethods[31],sipPySelf,NULL,sipName_keyReleaseEvent);

    if (!sipMeth)
    {
        rviz::VisualizationFrame::keyReleaseEvent(a0);
        return;
    }

    typedef void (*sipVH_QtGui_4)(sip_gilstate_t, sipVirtErrorHandlerFunc, sipSimpleWrapper *, PyObject *, QKeyEvent*);

    ((sipVH_QtGui_4)(sipModuleAPI_librviz_sip_QtGui->em_virthandlers[4]))(sipGILState, sipModuleAPI_librviz_sip_QtCore->em_virterrorhandlers[0], sipPySelf, sipMeth, a0);
}

void siprviz_VisualizationFrame::keyPressEvent(QKeyEvent*a0)
{
    sip_gilstate_t sipGILState;
    PyObject *sipMeth;

    sipMeth = sipIsPyMethod(&sipGILState,&sipPyMethods[32],sipPySelf,NULL,sipName_keyPressEvent);

    if (!sipMeth)
    {
        rviz::VisualizationFrame::keyPressEvent(a0);
        return;
    }

    typedef void (*sipVH_QtGui_4)(sip_gilstate_t, sipVirtErrorHandlerFunc, sipSimpleWrapper *, PyObject *, QKeyEvent*);

    ((sipVH_QtGui_4)(sipModuleAPI_librviz_sip_QtGui->em_virthandlers[4]))(sipGILState, sipModuleAPI_librviz_sip_QtCore->em_virterrorhandlers[0], sipPySelf, sipMeth, a0);
}

void siprviz_VisualizationFrame::wheelEvent(QWheelEvent*a0)
{
    sip_gilstate_t sipGILState;
    PyObject *sipMeth;

    sipMeth = sipIsPyMethod(&sipGILState,&sipPyMethods[33],sipPySelf,NULL,sipName_wheelEvent);

    if (!sipMeth)
    {
        rviz::VisualizationFrame::wheelEvent(a0);
        return;
    }

    typedef void (*sipVH_QtGui_2)(sip_gilstate_t, sipVirtErrorHandlerFunc, sipSimpleWrapper *, PyObject *, QWheelEvent*);

    ((sipVH_QtGui_2)(sipModuleAPI_librviz_sip_QtGui->em_virthandlers[2]))(sipGILState, sipModuleAPI_librviz_sip_QtCore->em_virterrorhandlers[0], sipPySelf, sipMeth, a0);
}

void siprviz_VisualizationFrame::mouseMoveEvent(QMouseEvent*a0)
{
    sip_gilstate_t sipGILState;
    PyObject *sipMeth;

    sipMeth = sipIsPyMethod(&sipGILState,&sipPyMethods[34],sipPySelf,NULL,sipName_mouseMoveEvent);

    if (!sipMeth)
    {
        rviz::VisualizationFrame::mouseMoveEvent(a0);
        return;
    }

    typedef void (*sipVH_QtGui_3)(sip_gilstate_t, sipVirtErrorHandlerFunc, sipSimpleWrapper *, PyObject *, QMouseEvent*);

    ((sipVH_QtGui_3)(sipModuleAPI_librviz_sip_QtGui->em_virthandlers[3]))(sipGILState, sipModuleAPI_librviz_sip_QtCore->em_virterrorhandlers[0], sipPySelf, sipMeth, a0);
}

void siprviz_VisualizationFrame::mouseDoubleClickEvent(QMouseEvent*a0)
{
    sip_gilstate_t sipGILState;
    PyObject *sipMeth;

    sipMeth = sipIsPyMethod(&sipGILState,&sipPyMethods[35],sipPySelf,NULL,sipName_mouseDoubleClickEvent);

    if (!sipMeth)
    {
        rviz::VisualizationFrame::mouseDoubleClickEvent(a0);
        return;
    }

    typedef void (*sipVH_QtGui_3)(sip_gilstate_t, sipVirtErrorHandlerFunc, sipSimpleWrapper *, PyObject *, QMouseEvent*);

    ((sipVH_QtGui_3)(sipModuleAPI_librviz_sip_QtGui->em_virthandlers[3]))(sipGILState, sipModuleAPI_librviz_sip_QtCore->em_virterrorhandlers[0], sipPySelf, sipMeth, a0);
}

void siprviz_VisualizationFrame::mouseReleaseEvent(QMouseEvent*a0)
{
    sip_gilstate_t sipGILState;
    PyObject *sipMeth;

    sipMeth = sipIsPyMethod(&sipGILState,&sipPyMethods[36],sipPySelf,NULL,sipName_mouseReleaseEvent);

    if (!sipMeth)
    {
        rviz::VisualizationFrame::mouseReleaseEvent(a0);
        return;
    }

    typedef void (*sipVH_QtGui_3)(sip_gilstate_t, sipVirtErrorHandlerFunc, sipSimpleWrapper *, PyObject *, QMouseEvent*);

    ((sipVH_QtGui_3)(sipModuleAPI_librviz_sip_QtGui->em_virthandlers[3]))(sipGILState, sipModuleAPI_librviz_sip_QtCore->em_virterrorhandlers[0], sipPySelf, sipMeth, a0);
}

void siprviz_VisualizationFrame::mousePressEvent(QMouseEvent*a0)
{
    sip_gilstate_t sipGILState;
    PyObject *sipMeth;

    sipMeth = sipIsPyMethod(&sipGILState,&sipPyMethods[37],sipPySelf,NULL,sipName_mousePressEvent);

    if (!sipMeth)
    {
        rviz::VisualizationFrame::mousePressEvent(a0);
        return;
    }

    typedef void (*sipVH_QtGui_3)(sip_gilstate_t, sipVirtErrorHandlerFunc, sipSimpleWrapper *, PyObject *, QMouseEvent*);

    ((sipVH_QtGui_3)(sipModuleAPI_librviz_sip_QtGui->em_virthandlers[3]))(sipGILState, sipModuleAPI_librviz_sip_QtCore->em_virterrorhandlers[0], sipPySelf, sipMeth, a0);
}

QPaintEngine* siprviz_VisualizationFrame::paintEngine() const
{
    sip_gilstate_t sipGILState;
    PyObject *sipMeth;

    sipMeth = sipIsPyMethod(&sipGILState,const_cast<char *>(&sipPyMethods[38]),sipPySelf,NULL,sipName_paintEngine);

    if (!sipMeth)
        return rviz::VisualizationFrame::paintEngine();

    typedef QPaintEngine* (*sipVH_QtGui_29)(sip_gilstate_t, sipVirtErrorHandlerFunc, sipSimpleWrapper *, PyObject *);

    return ((sipVH_QtGui_29)(sipModuleAPI_librviz_sip_QtGui->em_virthandlers[29]))(sipGILState, sipModuleAPI_librviz_sip_QtCore->em_virterrorhandlers[0], sipPySelf, sipMeth);
}

int siprviz_VisualizationFrame::heightForWidth(int a0) const
{
    sip_gilstate_t sipGILState;
    PyObject *sipMeth;

    sipMeth = sipIsPyMethod(&sipGILState,const_cast<char *>(&sipPyMethods[39]),sipPySelf,NULL,sipName_heightForWidth);

    if (!sipMeth)
        return rviz::VisualizationFrame::heightForWidth(a0);

    typedef int (*sipVH_QtCore_61)(sip_gilstate_t, sipVirtErrorHandlerFunc, sipSimpleWrapper *, PyObject *, int);

    return ((sipVH_QtCore_61)(sipModuleAPI_librviz_sip_QtCore->em_virthandlers[61]))(sipGILState, sipModuleAPI_librviz_sip_QtCore->em_virterrorhandlers[0], sipPySelf, sipMeth, a0);
}

QSize siprviz_VisualizationFrame::minimumSizeHint() const
{
    sip_gilstate_t sipGILState;
    PyObject *sipMeth;

    sipMeth = sipIsPyMethod(&sipGILState,const_cast<char *>(&sipPyMethods[40]),sipPySelf,NULL,sipName_minimumSizeHint);

    if (!sipMeth)
        return rviz::VisualizationFrame::minimumSizeHint();

    typedef QSize (*sipVH_QtGui_12)(sip_gilstate_t, sipVirtErrorHandlerFunc, sipSimpleWrapper *, PyObject *);

    return ((sipVH_QtGui_12)(sipModuleAPI_librviz_sip_QtGui->em_virthandlers[12]))(sipGILState, sipModuleAPI_librviz_sip_QtCore->em_virterrorhandlers[0], sipPySelf, sipMeth);
}

QSize siprviz_VisualizationFrame::sizeHint() const
{
    sip_gilstate_t sipGILState;
    PyObject *sipMeth;

    sipMeth = sipIsPyMethod(&sipGILState,const_cast<char *>(&sipPyMethods[41]),sipPySelf,NULL,sipName_sizeHint);

    if (!sipMeth)
        return rviz::VisualizationFrame::sizeHint();

    typedef QSize (*sipVH_QtGui_12)(sip_gilstate_t, sipVirtErrorHandlerFunc, sipSimpleWrapper *, PyObject *);

    return ((sipVH_QtGui_12)(sipModuleAPI_librviz_sip_QtGui->em_virthandlers[12]))(sipGILState, sipModuleAPI_librviz_sip_QtCore->em_virterrorhandlers[0], sipPySelf, sipMeth);
}

void siprviz_VisualizationFrame::setVisible(bool a0)
{
    sip_gilstate_t sipGILState;
    PyObject *sipMeth;

    sipMeth = sipIsPyMethod(&sipGILState,&sipPyMethods[42],sipPySelf,NULL,sipName_setVisible);

    if (!sipMeth)
    {
        rviz::VisualizationFrame::setVisible(a0);
        return;
    }

    typedef void (*sipVH_QtWidgets_0)(sip_gilstate_t, sipVirtErrorHandlerFunc, sipSimpleWrapper *, PyObject *, bool);

    ((sipVH_QtWidgets_0)(sipModuleAPI_librviz_sip_QtWidgets->em_virthandlers[0]))(sipGILState, sipModuleAPI_librviz_sip_QtCore->em_virterrorhandlers[0], sipPySelf, sipMeth, a0);
}

int siprviz_VisualizationFrame::devType() const
{
    sip_gilstate_t sipGILState;
    PyObject *sipMeth;

    sipMeth = sipIsPyMethod(&sipGILState,const_cast<char *>(&sipPyMethods[43]),sipPySelf,NULL,sipName_devType);

    if (!sipMeth)
        return rviz::VisualizationFrame::devType();

    typedef int (*sipVH_QtCore_6)(sip_gilstate_t, sipVirtErrorHandlerFunc, sipSimpleWrapper *, PyObject *);

    return ((sipVH_QtCore_6)(sipModuleAPI_librviz_sip_QtCore->em_virthandlers[6]))(sipGILState, sipModuleAPI_librviz_sip_QtCore->em_virterrorhandlers[0], sipPySelf, sipMeth);
}

bool siprviz_VisualizationFrame::event(QEvent*a0)
{
    sip_gilstate_t sipGILState;
    PyObject *sipMeth;

    sipMeth = sipIsPyMethod(&sipGILState,&sipPyMethods[44],sipPySelf,NULL,sipName_event);

    if (!sipMeth)
        return rviz::VisualizationFrame::event(a0);

    typedef bool (*sipVH_QtCore_5)(sip_gilstate_t, sipVirtErrorHandlerFunc, sipSimpleWrapper *, PyObject *, QEvent*);

    return ((sipVH_QtCore_5)(sipModuleAPI_librviz_sip_QtCore->em_virthandlers[5]))(sipGILState, sipModuleAPI_librviz_sip_QtCore->em_virterrorhandlers[0], sipPySelf, sipMeth, a0);
}

void siprviz_VisualizationFrame::contextMenuEvent(QContextMenuEvent*a0)
{
    sip_gilstate_t sipGILState;
    PyObject *sipMeth;

    sipMeth = sipIsPyMethod(&sipGILState,&sipPyMethods[45],sipPySelf,NULL,sipName_contextMenuEvent);

    if (!sipMeth)
    {
        rviz::VisualizationFrame::contextMenuEvent(a0);
        return;
    }

    typedef void (*sipVH_QtWidgets_13)(sip_gilstate_t, sipVirtErrorHandlerFunc, sipSimpleWrapper *, PyObject *, QContextMenuEvent*);

    ((sipVH_QtWidgets_13)(sipModuleAPI_librviz_sip_QtWidgets->em_virthandlers[13]))(sipGILState, sipModuleAPI_librviz_sip_QtCore->em_virterrorhandlers[0], sipPySelf, sipMeth, a0);
}

QMenu* siprviz_VisualizationFrame::createPopupMenu()
{
    sip_gilstate_t sipGILState;
    PyObject *sipMeth;

    sipMeth = sipIsPyMethod(&sipGILState,&sipPyMethods[46],sipPySelf,NULL,sipName_createPopupMenu);

    if (!sipMeth)
        return rviz::VisualizationFrame::createPopupMenu();

    typedef QMenu* (*sipVH_QtWidgets_86)(sip_gilstate_t, sipVirtErrorHandlerFunc, sipSimpleWrapper *, PyObject *);

    return ((sipVH_QtWidgets_86)(sipModuleAPI_librviz_sip_QtWidgets->em_virthandlers[86]))(sipGILState, sipModuleAPI_librviz_sip_QtCore->em_virterrorhandlers[0], sipPySelf, sipMeth);
}

void siprviz_VisualizationFrame::save(rviz::Config a0)
{
    sip_gilstate_t sipGILState;
    PyObject *sipMeth;

    sipMeth = sipIsPyMethod(&sipGILState,&sipPyMethods[47],sipPySelf,NULL,sipName_save);

    if (!sipMeth)
    {
        rviz::VisualizationFrame::save(a0);
        return;
    }

    extern void sipVH_librviz_sip_0(sip_gilstate_t, sipVirtErrorHandlerFunc, sipSimpleWrapper *, PyObject *, rviz::Config);

    sipVH_librviz_sip_0(sipGILState, sipModuleAPI_librviz_sip_QtCore->em_virterrorhandlers[0], sipPySelf, sipMeth, a0);
}

void siprviz_VisualizationFrame::load(const rviz::Config& a0)
{
    sip_gilstate_t sipGILState;
    PyObject *sipMeth;

    sipMeth = sipIsPyMethod(&sipGILState,&sipPyMethods[48],sipPySelf,NULL,sipName_load);

    if (!sipMeth)
    {
        rviz::VisualizationFrame::load(a0);
        return;
    }

    extern void sipVH_librviz_sip_1(sip_gilstate_t, sipVirtErrorHandlerFunc, sipSimpleWrapper *, PyObject *, const rviz::Config&);

    sipVH_librviz_sip_1(sipGILState, sipModuleAPI_librviz_sip_QtCore->em_virterrorhandlers[0], sipPySelf, sipMeth, a0);
}

rviz::PanelDockWidget* siprviz_VisualizationFrame::addPane(const QString& a0,QWidget*a1,Qt::DockWidgetArea a2,bool a3)
{
    sip_gilstate_t sipGILState;
    PyObject *sipMeth;

    sipMeth = sipIsPyMethod(&sipGILState,&sipPyMethods[49],sipPySelf,NULL,sipName_addPane);

    if (!sipMeth)
        return rviz::VisualizationFrame::addPane(a0,a1,a2,a3);

    extern rviz::PanelDockWidget* sipVH_librviz_sip_19(sip_gilstate_t, sipVirtErrorHandlerFunc, sipSimpleWrapper *, PyObject *, const QString&,QWidget*,Qt::DockWidgetArea,bool);

    return sipVH_librviz_sip_19(sipGILState, sipModuleAPI_librviz_sip_QtCore->em_virterrorhandlers[0], sipPySelf, sipMeth, a0, a1, a2, a3);
}

QWidget* siprviz_VisualizationFrame::getParentWindow()
{
    sip_gilstate_t sipGILState;
    PyObject *sipMeth;

    sipMeth = sipIsPyMethod(&sipGILState,&sipPyMethods[50],sipPySelf,NULL,sipName_getParentWindow);

    if (!sipMeth)
        return rviz::VisualizationFrame::getParentWindow();

    typedef QWidget* (*sipVH_QtWidgets_79)(sip_gilstate_t, sipVirtErrorHandlerFunc, sipSimpleWrapper *, PyObject *);

    return ((sipVH_QtWidgets_79)(sipModuleAPI_librviz_sip_QtWidgets->em_virthandlers[79]))(sipGILState, sipModuleAPI_librviz_sip_QtCore->em_virterrorhandlers[0], sipPySelf, sipMeth);
}

QObject* siprviz_VisualizationFrame::sipProtect_sender() const
{
    return QObject::sender();
}

int siprviz_VisualizationFrame::sipProtect_receivers(const char*a0) const
{
    return QObject::receivers(a0);
}

void siprviz_VisualizationFrame::sipProtectVirt_timerEvent(bool sipSelfWasArg,QTimerEvent*a0)
{
    (sipSelfWasArg ? QObject::timerEvent(a0) : timerEvent(a0));
}

void siprviz_VisualizationFrame::sipProtectVirt_childEvent(bool sipSelfWasArg,QChildEvent*a0)
{
    (sipSelfWasArg ? QObject::childEvent(a0) : childEvent(a0));
}

void siprviz_VisualizationFrame::sipProtectVirt_customEvent(bool sipSelfWasArg,QEvent*a0)
{
    (sipSelfWasArg ? QObject::customEvent(a0) : customEvent(a0));
}

void siprviz_VisualizationFrame::sipProtectVirt_connectNotify(bool sipSelfWasArg,const QMetaMethod& a0)
{
    (sipSelfWasArg ? QObject::connectNotify(a0) : connectNotify(a0));
}

void siprviz_VisualizationFrame::sipProtectVirt_disconnectNotify(bool sipSelfWasArg,const QMetaMethod& a0)
{
    (sipSelfWasArg ? QObject::disconnectNotify(a0) : disconnectNotify(a0));
}

int siprviz_VisualizationFrame::sipProtect_senderSignalIndex() const
{
    return QObject::senderSignalIndex();
}

bool siprviz_VisualizationFrame::sipProtect_isSignalConnected(const QMetaMethod& a0) const
{
    return QObject::isSignalConnected(a0);
}

void siprviz_VisualizationFrame::sipProtectVirt_mousePressEvent(bool sipSelfWasArg,QMouseEvent*a0)
{
    (sipSelfWasArg ? QWidget::mousePressEvent(a0) : mousePressEvent(a0));
}

void siprviz_VisualizationFrame::sipProtectVirt_mouseReleaseEvent(bool sipSelfWasArg,QMouseEvent*a0)
{
    (sipSelfWasArg ? QWidget::mouseReleaseEvent(a0) : mouseReleaseEvent(a0));
}

void siprviz_VisualizationFrame::sipProtectVirt_mouseDoubleClickEvent(bool sipSelfWasArg,QMouseEvent*a0)
{
    (sipSelfWasArg ? QWidget::mouseDoubleClickEvent(a0) : mouseDoubleClickEvent(a0));
}

void siprviz_VisualizationFrame::sipProtectVirt_mouseMoveEvent(bool sipSelfWasArg,QMouseEvent*a0)
{
    (sipSelfWasArg ? QWidget::mouseMoveEvent(a0) : mouseMoveEvent(a0));
}

void siprviz_VisualizationFrame::sipProtectVirt_wheelEvent(bool sipSelfWasArg,QWheelEvent*a0)
{
    (sipSelfWasArg ? QWidget::wheelEvent(a0) : wheelEvent(a0));
}

void siprviz_VisualizationFrame::sipProtectVirt_keyPressEvent(bool sipSelfWasArg,QKeyEvent*a0)
{
    (sipSelfWasArg ? QWidget::keyPressEvent(a0) : keyPressEvent(a0));
}

void siprviz_VisualizationFrame::sipProtectVirt_keyReleaseEvent(bool sipSelfWasArg,QKeyEvent*a0)
{
    (sipSelfWasArg ? QWidget::keyReleaseEvent(a0) : keyReleaseEvent(a0));
}

void siprviz_VisualizationFrame::sipProtectVirt_focusInEvent(bool sipSelfWasArg,QFocusEvent*a0)
{
    (sipSelfWasArg ? QWidget::focusInEvent(a0) : focusInEvent(a0));
}

void siprviz_VisualizationFrame::sipProtectVirt_focusOutEvent(bool sipSelfWasArg,QFocusEvent*a0)
{
    (sipSelfWasArg ? QWidget::focusOutEvent(a0) : focusOutEvent(a0));
}

void siprviz_VisualizationFrame::sipProtectVirt_enterEvent(bool sipSelfWasArg,QEvent*a0)
{
    (sipSelfWasArg ? QWidget::enterEvent(a0) : enterEvent(a0));
}

void siprviz_VisualizationFrame::sipProtectVirt_leaveEvent(bool sipSelfWasArg,QEvent*a0)
{
    (sipSelfWasArg ? QWidget::leaveEvent(a0) : leaveEvent(a0));
}

void siprviz_VisualizationFrame::sipProtectVirt_paintEvent(bool sipSelfWasArg,QPaintEvent*a0)
{
    (sipSelfWasArg ? QWidget::paintEvent(a0) : paintEvent(a0));
}

void siprviz_VisualizationFrame::sipProtectVirt_moveEvent(bool sipSelfWasArg,QMoveEvent*a0)
{
    (sipSelfWasArg ? QWidget::moveEvent(a0) : moveEvent(a0));
}

void siprviz_VisualizationFrame::sipProtectVirt_resizeEvent(bool sipSelfWasArg,QResizeEvent*a0)
{
    (sipSelfWasArg ? QWidget::resizeEvent(a0) : resizeEvent(a0));
}

void siprviz_VisualizationFrame::sipProtectVirt_closeEvent(bool sipSelfWasArg,QCloseEvent*a0)
{
    (sipSelfWasArg ? QWidget::closeEvent(a0) : closeEvent(a0));
}

void siprviz_VisualizationFrame::sipProtectVirt_tabletEvent(bool sipSelfWasArg,QTabletEvent*a0)
{
    (sipSelfWasArg ? QWidget::tabletEvent(a0) : tabletEvent(a0));
}

void siprviz_VisualizationFrame::sipProtectVirt_actionEvent(bool sipSelfWasArg,QActionEvent*a0)
{
    (sipSelfWasArg ? QWidget::actionEvent(a0) : actionEvent(a0));
}

void siprviz_VisualizationFrame::sipProtectVirt_dragEnterEvent(bool sipSelfWasArg,QDragEnterEvent*a0)
{
    (sipSelfWasArg ? QWidget::dragEnterEvent(a0) : dragEnterEvent(a0));
}

void siprviz_VisualizationFrame::sipProtectVirt_dragMoveEvent(bool sipSelfWasArg,QDragMoveEvent*a0)
{
    (sipSelfWasArg ? QWidget::dragMoveEvent(a0) : dragMoveEvent(a0));
}

void siprviz_VisualizationFrame::sipProtectVirt_dragLeaveEvent(bool sipSelfWasArg,QDragLeaveEvent*a0)
{
    (sipSelfWasArg ? QWidget::dragLeaveEvent(a0) : dragLeaveEvent(a0));
}

void siprviz_VisualizationFrame::sipProtectVirt_dropEvent(bool sipSelfWasArg,QDropEvent*a0)
{
    (sipSelfWasArg ? QWidget::dropEvent(a0) : dropEvent(a0));
}

void siprviz_VisualizationFrame::sipProtectVirt_showEvent(bool sipSelfWasArg,QShowEvent*a0)
{
    (sipSelfWasArg ? QWidget::showEvent(a0) : showEvent(a0));
}

void siprviz_VisualizationFrame::sipProtectVirt_hideEvent(bool sipSelfWasArg,QHideEvent*a0)
{
    (sipSelfWasArg ? QWidget::hideEvent(a0) : hideEvent(a0));
}

void siprviz_VisualizationFrame::sipProtectVirt_changeEvent(bool sipSelfWasArg,QEvent*a0)
{
    (sipSelfWasArg ? QWidget::changeEvent(a0) : changeEvent(a0));
}

int siprviz_VisualizationFrame::sipProtectVirt_metric(bool sipSelfWasArg,QPaintDevice::PaintDeviceMetric a0) const
{
    return (sipSelfWasArg ? QWidget::metric(a0) : metric(a0));
}

void siprviz_VisualizationFrame::sipProtectVirt_inputMethodEvent(bool sipSelfWasArg,QInputMethodEvent*a0)
{
    (sipSelfWasArg ? QWidget::inputMethodEvent(a0) : inputMethodEvent(a0));
}

void siprviz_VisualizationFrame::sipProtect_updateMicroFocus()
{
    QWidget::updateMicroFocus();
}

void siprviz_VisualizationFrame::sipProtect_create(WId a0,bool a1,bool a2)
{
    QWidget::create(a0,a1,a2);
}

void siprviz_VisualizationFrame::sipProtect_destroy(bool a0,bool a1)
{
    QWidget::destroy(a0,a1);
}

bool siprviz_VisualizationFrame::sipProtectVirt_focusNextPrevChild(bool sipSelfWasArg,bool a0)
{
    return (sipSelfWasArg ? QWidget::focusNextPrevChild(a0) : focusNextPrevChild(a0));
}

bool siprviz_VisualizationFrame::sipProtect_focusNextChild()
{
    return QWidget::focusNextChild();
}

bool siprviz_VisualizationFrame::sipProtect_focusPreviousChild()
{
    return QWidget::focusPreviousChild();
}

bool siprviz_VisualizationFrame::sipProtectVirt_nativeEvent(bool sipSelfWasArg,const QByteArray& a0,void*a1,long*a2)
{
    return (sipSelfWasArg ? QWidget::nativeEvent(a0,a1,a2) : nativeEvent(a0,a1,a2));
}

QPainter* siprviz_VisualizationFrame::sipProtectVirt_sharedPainter(bool sipSelfWasArg) const
{
    return (sipSelfWasArg ? QWidget::sharedPainter() : sharedPainter());
}

void siprviz_VisualizationFrame::sipProtectVirt_initPainter(bool sipSelfWasArg,QPainter*a0) const
{
    (sipSelfWasArg ? QWidget::initPainter(a0) : initPainter(a0));
}

void siprviz_VisualizationFrame::sipProtectVirt_contextMenuEvent(bool sipSelfWasArg,QContextMenuEvent*a0)
{
    (sipSelfWasArg ? QMainWindow::contextMenuEvent(a0) : contextMenuEvent(a0));
}

bool siprviz_VisualizationFrame::sipProtectVirt_event(bool sipSelfWasArg,QEvent*a0)
{
    return (sipSelfWasArg ? QMainWindow::event(a0) : event(a0));
}


extern "C" {static PyObject *meth_rviz_VisualizationFrame_sender(PyObject *, PyObject *, PyObject *);}
static PyObject *meth_rviz_VisualizationFrame_sender(PyObject *sipSelf, PyObject *sipArgs, PyObject *sipKwds)
{
    PyObject *sipParseErr = NULL;

    {
        const siprviz_VisualizationFrame *sipCpp;

        if (sipParseKwdArgs(&sipParseErr, sipArgs, sipKwds, NULL, NULL, "B", &sipSelf, sipType_rviz_VisualizationFrame, &sipCpp))
        {
            QObject*sipRes = 0;

#line 550 "/usr/share/sip/PyQt5/QtCore/qobject.sip"
        // sender() must be called without the GIL to avoid possible deadlocks between
        // the GIL and Qt's internal thread data mutex.
        
        Py_BEGIN_ALLOW_THREADS
        
        #if defined(SIP_PROTECTED_IS_PUBLIC)
        sipRes = sipCpp->sender();
        #else
        sipRes = sipCpp->sipProtect_sender();
        #endif
        
        Py_END_ALLOW_THREADS
        
        if (!sipRes)
        {
            typedef QObject *(*qtcore_qobject_sender_t)();
        
            static qtcore_qobject_sender_t qtcore_qobject_sender = 0;
        
            if (!qtcore_qobject_sender)
                qtcore_qobject_sender = (qtcore_qobject_sender_t)sipImportSymbol("qtcore_qobject_sender");
        
            if (qtcore_qobject_sender)
                sipRes = qtcore_qobject_sender();
        }
#line 1555 "/home/lassegoncz/catkin_ws/devel/bin/sip/rviz_sip/siplibrviz_siprvizVisualizationFrame.cpp"

            return sipConvertFromType(sipRes,sipType_QObject,NULL);
        }
    }

    /* Raise an exception if the arguments couldn't be parsed. */
    sipNoMethod(sipParseErr, sipName_VisualizationFrame, sipName_sender, NULL);

    return NULL;
}


extern "C" {static PyObject *meth_rviz_VisualizationFrame_receivers(PyObject *, PyObject *, PyObject *);}
static PyObject *meth_rviz_VisualizationFrame_receivers(PyObject *sipSelf, PyObject *sipArgs, PyObject *sipKwds)
{
    PyObject *sipParseErr = NULL;

    {
        PyObject * a0;
        const siprviz_VisualizationFrame *sipCpp;

        if (sipParseKwdArgs(&sipParseErr, sipArgs, sipKwds, NULL, NULL, "BP0", &sipSelf, sipType_rviz_VisualizationFrame, &sipCpp, &a0))
        {
            int sipRes = 0;
            sipErrorState sipError = sipErrorNone;

#line 579 "/usr/share/sip/PyQt5/QtCore/qobject.sip"
        // We need to handle the signal object.  Import the helper if it hasn't already
        // been done.
        typedef sipErrorState (*pyqt5_get_signal_signature_t)(PyObject *, const QObject *, const QByteArray &);
        
        static pyqt5_get_signal_signature_t pyqt5_get_signal_signature = 0;
        
        if (!pyqt5_get_signal_signature)
            pyqt5_get_signal_signature = (pyqt5_get_signal_signature_t)sipImportSymbol("pyqt5_get_signal_signature");
        
        if (pyqt5_get_signal_signature)
        {
            QByteArray signal_signature;
            
        #if defined(SIP_PROTECTED_IS_PUBLIC)
            if ((sipError = pyqt5_get_signal_signature(a0, sipCpp, signal_signature)) == sipErrorNone)
            {
                sipRes = sipCpp->receivers(signal_signature.constData());
            }
        #else
            if ((sipError = pyqt5_get_signal_signature(a0, static_cast<const QObject *>(sipCpp), signal_signature)) == sipErrorNone)
            {
                sipRes = sipCpp->sipProtect_receivers(signal_signature.constData());
            }
        #endif
            else if (sipError == sipErrorContinue)
            {
                sipError = sipBadCallableArg(0, a0);
            }
        }
#line 1612 "/home/lassegoncz/catkin_ws/devel/bin/sip/rviz_sip/siplibrviz_siprvizVisualizationFrame.cpp"

            if (sipError == sipErrorFail)
                return 0;

            if (sipError == sipErrorNone)
            {
            return SIPLong_FromLong(sipRes);
            }

            sipAddException(sipError, &sipParseErr);
        }
    }

    /* Raise an exception if the arguments couldn't be parsed. */
    sipNoMethod(sipParseErr, sipName_VisualizationFrame, sipName_receivers, NULL);

    return NULL;
}


extern "C" {static PyObject *meth_rviz_VisualizationFrame_timerEvent(PyObject *, PyObject *, PyObject *);}
static PyObject *meth_rviz_VisualizationFrame_timerEvent(PyObject *sipSelf, PyObject *sipArgs, PyObject *sipKwds)
{
    PyObject *sipParseErr = NULL;
    bool sipSelfWasArg = (!sipSelf || sipIsDerived((sipSimpleWrapper *)sipSelf));

    {
        QTimerEvent* a0;
        siprviz_VisualizationFrame *sipCpp;

        if (sipParseKwdArgs(&sipParseErr, sipArgs, sipKwds, NULL, NULL, "BJ8", &sipSelf, sipType_rviz_VisualizationFrame, &sipCpp, sipType_QTimerEvent, &a0))
        {
            sipCpp->sipProtectVirt_timerEvent(sipSelfWasArg,a0);

            Py_INCREF(Py_None);
            return Py_None;
        }
    }

    /* Raise an exception if the arguments couldn't be parsed. */
    sipNoMethod(sipParseErr, sipName_VisualizationFrame, sipName_timerEvent, NULL);

    return NULL;
}


extern "C" {static PyObject *meth_rviz_VisualizationFrame_childEvent(PyObject *, PyObject *, PyObject *);}
static PyObject *meth_rviz_VisualizationFrame_childEvent(PyObject *sipSelf, PyObject *sipArgs, PyObject *sipKwds)
{
    PyObject *sipParseErr = NULL;
    bool sipSelfWasArg = (!sipSelf || sipIsDerived((sipSimpleWrapper *)sipSelf));

    {
        QChildEvent* a0;
        siprviz_VisualizationFrame *sipCpp;

        if (sipParseKwdArgs(&sipParseErr, sipArgs, sipKwds, NULL, NULL, "BJ8", &sipSelf, sipType_rviz_VisualizationFrame, &sipCpp, sipType_QChildEvent, &a0))
        {
            sipCpp->sipProtectVirt_childEvent(sipSelfWasArg,a0);

            Py_INCREF(Py_None);
            return Py_None;
        }
    }

    /* Raise an exception if the arguments couldn't be parsed. */
    sipNoMethod(sipParseErr, sipName_VisualizationFrame, sipName_childEvent, NULL);

    return NULL;
}


extern "C" {static PyObject *meth_rviz_VisualizationFrame_customEvent(PyObject *, PyObject *, PyObject *);}
static PyObject *meth_rviz_VisualizationFrame_customEvent(PyObject *sipSelf, PyObject *sipArgs, PyObject *sipKwds)
{
    PyObject *sipParseErr = NULL;
    bool sipSelfWasArg = (!sipSelf || sipIsDerived((sipSimpleWrapper *)sipSelf));

    {
        QEvent* a0;
        siprviz_VisualizationFrame *sipCpp;

        if (sipParseKwdArgs(&sipParseErr, sipArgs, sipKwds, NULL, NULL, "BJ8", &sipSelf, sipType_rviz_VisualizationFrame, &sipCpp, sipType_QEvent, &a0))
        {
            sipCpp->sipProtectVirt_customEvent(sipSelfWasArg,a0);

            Py_INCREF(Py_None);
            return Py_None;
        }
    }

    /* Raise an exception if the arguments couldn't be parsed. */
    sipNoMethod(sipParseErr, sipName_VisualizationFrame, sipName_customEvent, NULL);

    return NULL;
}


extern "C" {static PyObject *meth_rviz_VisualizationFrame_connectNotify(PyObject *, PyObject *, PyObject *);}
static PyObject *meth_rviz_VisualizationFrame_connectNotify(PyObject *sipSelf, PyObject *sipArgs, PyObject *sipKwds)
{
    PyObject *sipParseErr = NULL;
    bool sipSelfWasArg = (!sipSelf || sipIsDerived((sipSimpleWrapper *)sipSelf));

    {
        const QMetaMethod* a0;
        siprviz_VisualizationFrame *sipCpp;

        if (sipParseKwdArgs(&sipParseErr, sipArgs, sipKwds, NULL, NULL, "BJ9", &sipSelf, sipType_rviz_VisualizationFrame, &sipCpp, sipType_QMetaMethod, &a0))
        {
            sipCpp->sipProtectVirt_connectNotify(sipSelfWasArg,*a0);

            Py_INCREF(Py_None);
            return Py_None;
        }
    }

    /* Raise an exception if the arguments couldn't be parsed. */
    sipNoMethod(sipParseErr, sipName_VisualizationFrame, sipName_connectNotify, NULL);

    return NULL;
}


extern "C" {static PyObject *meth_rviz_VisualizationFrame_disconnectNotify(PyObject *, PyObject *, PyObject *);}
static PyObject *meth_rviz_VisualizationFrame_disconnectNotify(PyObject *sipSelf, PyObject *sipArgs, PyObject *sipKwds)
{
    PyObject *sipParseErr = NULL;
    bool sipSelfWasArg = (!sipSelf || sipIsDerived((sipSimpleWrapper *)sipSelf));

    {
        const QMetaMethod* a0;
        siprviz_VisualizationFrame *sipCpp;

        if (sipParseKwdArgs(&sipParseErr, sipArgs, sipKwds, NULL, NULL, "BJ9", &sipSelf, sipType_rviz_VisualizationFrame, &sipCpp, sipType_QMetaMethod, &a0))
        {
            sipCpp->sipProtectVirt_disconnectNotify(sipSelfWasArg,*a0);

            Py_INCREF(Py_None);
            return Py_None;
        }
    }

    /* Raise an exception if the arguments couldn't be parsed. */
    sipNoMethod(sipParseErr, sipName_VisualizationFrame, sipName_disconnectNotify, NULL);

    return NULL;
}


extern "C" {static PyObject *meth_rviz_VisualizationFrame_senderSignalIndex(PyObject *, PyObject *, PyObject *);}
static PyObject *meth_rviz_VisualizationFrame_senderSignalIndex(PyObject *sipSelf, PyObject *sipArgs, PyObject *sipKwds)
{
    PyObject *sipParseErr = NULL;

    {
        const siprviz_VisualizationFrame *sipCpp;

        if (sipParseKwdArgs(&sipParseErr, sipArgs, sipKwds, NULL, NULL, "B", &sipSelf, sipType_rviz_VisualizationFrame, &sipCpp))
        {
            int sipRes;

            sipRes = sipCpp->sipProtect_senderSignalIndex();

            return SIPLong_FromLong(sipRes);
        }
    }

    /* Raise an exception if the arguments couldn't be parsed. */
    sipNoMethod(sipParseErr, sipName_VisualizationFrame, sipName_senderSignalIndex, NULL);

    return NULL;
}


extern "C" {static PyObject *meth_rviz_VisualizationFrame_isSignalConnected(PyObject *, PyObject *, PyObject *);}
static PyObject *meth_rviz_VisualizationFrame_isSignalConnected(PyObject *sipSelf, PyObject *sipArgs, PyObject *sipKwds)
{
    PyObject *sipParseErr = NULL;

    {
        const QMetaMethod* a0;
        const siprviz_VisualizationFrame *sipCpp;

        if (sipParseKwdArgs(&sipParseErr, sipArgs, sipKwds, NULL, NULL, "BJ9", &sipSelf, sipType_rviz_VisualizationFrame, &sipCpp, sipType_QMetaMethod, &a0))
        {
            bool sipRes;

            sipRes = sipCpp->sipProtect_isSignalConnected(*a0);

            return PyBool_FromLong(sipRes);
        }
    }

    /* Raise an exception if the arguments couldn't be parsed. */
    sipNoMethod(sipParseErr, sipName_VisualizationFrame, sipName_isSignalConnected, NULL);

    return NULL;
}


extern "C" {static PyObject *meth_rviz_VisualizationFrame_mousePressEvent(PyObject *, PyObject *, PyObject *);}
static PyObject *meth_rviz_VisualizationFrame_mousePressEvent(PyObject *sipSelf, PyObject *sipArgs, PyObject *sipKwds)
{
    PyObject *sipParseErr = NULL;
    bool sipSelfWasArg = (!sipSelf || sipIsDerived((sipSimpleWrapper *)sipSelf));

    {
        QMouseEvent* a0;
        siprviz_VisualizationFrame *sipCpp;

        if (sipParseKwdArgs(&sipParseErr, sipArgs, sipKwds, NULL, NULL, "BJ8", &sipSelf, sipType_rviz_VisualizationFrame, &sipCpp, sipType_QMouseEvent, &a0))
        {
            sipCpp->sipProtectVirt_mousePressEvent(sipSelfWasArg,a0);

            Py_INCREF(Py_None);
            return Py_None;
        }
    }

    /* Raise an exception if the arguments couldn't be parsed. */
    sipNoMethod(sipParseErr, sipName_VisualizationFrame, sipName_mousePressEvent, NULL);

    return NULL;
}


extern "C" {static PyObject *meth_rviz_VisualizationFrame_mouseReleaseEvent(PyObject *, PyObject *, PyObject *);}
static PyObject *meth_rviz_VisualizationFrame_mouseReleaseEvent(PyObject *sipSelf, PyObject *sipArgs, PyObject *sipKwds)
{
    PyObject *sipParseErr = NULL;
    bool sipSelfWasArg = (!sipSelf || sipIsDerived((sipSimpleWrapper *)sipSelf));

    {
        QMouseEvent* a0;
        siprviz_VisualizationFrame *sipCpp;

        if (sipParseKwdArgs(&sipParseErr, sipArgs, sipKwds, NULL, NULL, "BJ8", &sipSelf, sipType_rviz_VisualizationFrame, &sipCpp, sipType_QMouseEvent, &a0))
        {
            sipCpp->sipProtectVirt_mouseReleaseEvent(sipSelfWasArg,a0);

            Py_INCREF(Py_None);
            return Py_None;
        }
    }

    /* Raise an exception if the arguments couldn't be parsed. */
    sipNoMethod(sipParseErr, sipName_VisualizationFrame, sipName_mouseReleaseEvent, NULL);

    return NULL;
}


extern "C" {static PyObject *meth_rviz_VisualizationFrame_mouseDoubleClickEvent(PyObject *, PyObject *, PyObject *);}
static PyObject *meth_rviz_VisualizationFrame_mouseDoubleClickEvent(PyObject *sipSelf, PyObject *sipArgs, PyObject *sipKwds)
{
    PyObject *sipParseErr = NULL;
    bool sipSelfWasArg = (!sipSelf || sipIsDerived((sipSimpleWrapper *)sipSelf));

    {
        QMouseEvent* a0;
        siprviz_VisualizationFrame *sipCpp;

        if (sipParseKwdArgs(&sipParseErr, sipArgs, sipKwds, NULL, NULL, "BJ8", &sipSelf, sipType_rviz_VisualizationFrame, &sipCpp, sipType_QMouseEvent, &a0))
        {
            sipCpp->sipProtectVirt_mouseDoubleClickEvent(sipSelfWasArg,a0);

            Py_INCREF(Py_None);
            return Py_None;
        }
    }

    /* Raise an exception if the arguments couldn't be parsed. */
    sipNoMethod(sipParseErr, sipName_VisualizationFrame, sipName_mouseDoubleClickEvent, NULL);

    return NULL;
}


extern "C" {static PyObject *meth_rviz_VisualizationFrame_mouseMoveEvent(PyObject *, PyObject *, PyObject *);}
static PyObject *meth_rviz_VisualizationFrame_mouseMoveEvent(PyObject *sipSelf, PyObject *sipArgs, PyObject *sipKwds)
{
    PyObject *sipParseErr = NULL;
    bool sipSelfWasArg = (!sipSelf || sipIsDerived((sipSimpleWrapper *)sipSelf));

    {
        QMouseEvent* a0;
        siprviz_VisualizationFrame *sipCpp;

        if (sipParseKwdArgs(&sipParseErr, sipArgs, sipKwds, NULL, NULL, "BJ8", &sipSelf, sipType_rviz_VisualizationFrame, &sipCpp, sipType_QMouseEvent, &a0))
        {
            sipCpp->sipProtectVirt_mouseMoveEvent(sipSelfWasArg,a0);

            Py_INCREF(Py_None);
            return Py_None;
        }
    }

    /* Raise an exception if the arguments couldn't be parsed. */
    sipNoMethod(sipParseErr, sipName_VisualizationFrame, sipName_mouseMoveEvent, NULL);

    return NULL;
}


extern "C" {static PyObject *meth_rviz_VisualizationFrame_wheelEvent(PyObject *, PyObject *, PyObject *);}
static PyObject *meth_rviz_VisualizationFrame_wheelEvent(PyObject *sipSelf, PyObject *sipArgs, PyObject *sipKwds)
{
    PyObject *sipParseErr = NULL;
    bool sipSelfWasArg = (!sipSelf || sipIsDerived((sipSimpleWrapper *)sipSelf));

    {
        QWheelEvent* a0;
        siprviz_VisualizationFrame *sipCpp;

        if (sipParseKwdArgs(&sipParseErr, sipArgs, sipKwds, NULL, NULL, "BJ8", &sipSelf, sipType_rviz_VisualizationFrame, &sipCpp, sipType_QWheelEvent, &a0))
        {
            sipCpp->sipProtectVirt_wheelEvent(sipSelfWasArg,a0);

            Py_INCREF(Py_None);
            return Py_None;
        }
    }

    /* Raise an exception if the arguments couldn't be parsed. */
    sipNoMethod(sipParseErr, sipName_VisualizationFrame, sipName_wheelEvent, NULL);

    return NULL;
}


extern "C" {static PyObject *meth_rviz_VisualizationFrame_keyPressEvent(PyObject *, PyObject *, PyObject *);}
static PyObject *meth_rviz_VisualizationFrame_keyPressEvent(PyObject *sipSelf, PyObject *sipArgs, PyObject *sipKwds)
{
    PyObject *sipParseErr = NULL;
    bool sipSelfWasArg = (!sipSelf || sipIsDerived((sipSimpleWrapper *)sipSelf));

    {
        QKeyEvent* a0;
        siprviz_VisualizationFrame *sipCpp;

        if (sipParseKwdArgs(&sipParseErr, sipArgs, sipKwds, NULL, NULL, "BJ8", &sipSelf, sipType_rviz_VisualizationFrame, &sipCpp, sipType_QKeyEvent, &a0))
        {
            sipCpp->sipProtectVirt_keyPressEvent(sipSelfWasArg,a0);

            Py_INCREF(Py_None);
            return Py_None;
        }
    }

    /* Raise an exception if the arguments couldn't be parsed. */
    sipNoMethod(sipParseErr, sipName_VisualizationFrame, sipName_keyPressEvent, NULL);

    return NULL;
}


extern "C" {static PyObject *meth_rviz_VisualizationFrame_keyReleaseEvent(PyObject *, PyObject *, PyObject *);}
static PyObject *meth_rviz_VisualizationFrame_keyReleaseEvent(PyObject *sipSelf, PyObject *sipArgs, PyObject *sipKwds)
{
    PyObject *sipParseErr = NULL;
    bool sipSelfWasArg = (!sipSelf || sipIsDerived((sipSimpleWrapper *)sipSelf));

    {
        QKeyEvent* a0;
        siprviz_VisualizationFrame *sipCpp;

        if (sipParseKwdArgs(&sipParseErr, sipArgs, sipKwds, NULL, NULL, "BJ8", &sipSelf, sipType_rviz_VisualizationFrame, &sipCpp, sipType_QKeyEvent, &a0))
        {
            sipCpp->sipProtectVirt_keyReleaseEvent(sipSelfWasArg,a0);

            Py_INCREF(Py_None);
            return Py_None;
        }
    }

    /* Raise an exception if the arguments couldn't be parsed. */
    sipNoMethod(sipParseErr, sipName_VisualizationFrame, sipName_keyReleaseEvent, NULL);

    return NULL;
}


extern "C" {static PyObject *meth_rviz_VisualizationFrame_focusInEvent(PyObject *, PyObject *, PyObject *);}
static PyObject *meth_rviz_VisualizationFrame_focusInEvent(PyObject *sipSelf, PyObject *sipArgs, PyObject *sipKwds)
{
    PyObject *sipParseErr = NULL;
    bool sipSelfWasArg = (!sipSelf || sipIsDerived((sipSimpleWrapper *)sipSelf));

    {
        QFocusEvent* a0;
        siprviz_VisualizationFrame *sipCpp;

        if (sipParseKwdArgs(&sipParseErr, sipArgs, sipKwds, NULL, NULL, "BJ8", &sipSelf, sipType_rviz_VisualizationFrame, &sipCpp, sipType_QFocusEvent, &a0))
        {
            sipCpp->sipProtectVirt_focusInEvent(sipSelfWasArg,a0);

            Py_INCREF(Py_None);
            return Py_None;
        }
    }

    /* Raise an exception if the arguments couldn't be parsed. */
    sipNoMethod(sipParseErr, sipName_VisualizationFrame, sipName_focusInEvent, NULL);

    return NULL;
}


extern "C" {static PyObject *meth_rviz_VisualizationFrame_focusOutEvent(PyObject *, PyObject *, PyObject *);}
static PyObject *meth_rviz_VisualizationFrame_focusOutEvent(PyObject *sipSelf, PyObject *sipArgs, PyObject *sipKwds)
{
    PyObject *sipParseErr = NULL;
    bool sipSelfWasArg = (!sipSelf || sipIsDerived((sipSimpleWrapper *)sipSelf));

    {
        QFocusEvent* a0;
        siprviz_VisualizationFrame *sipCpp;

        if (sipParseKwdArgs(&sipParseErr, sipArgs, sipKwds, NULL, NULL, "BJ8", &sipSelf, sipType_rviz_VisualizationFrame, &sipCpp, sipType_QFocusEvent, &a0))
        {
            sipCpp->sipProtectVirt_focusOutEvent(sipSelfWasArg,a0);

            Py_INCREF(Py_None);
            return Py_None;
        }
    }

    /* Raise an exception if the arguments couldn't be parsed. */
    sipNoMethod(sipParseErr, sipName_VisualizationFrame, sipName_focusOutEvent, NULL);

    return NULL;
}


extern "C" {static PyObject *meth_rviz_VisualizationFrame_enterEvent(PyObject *, PyObject *, PyObject *);}
static PyObject *meth_rviz_VisualizationFrame_enterEvent(PyObject *sipSelf, PyObject *sipArgs, PyObject *sipKwds)
{
    PyObject *sipParseErr = NULL;
    bool sipSelfWasArg = (!sipSelf || sipIsDerived((sipSimpleWrapper *)sipSelf));

    {
        QEvent* a0;
        siprviz_VisualizationFrame *sipCpp;

        if (sipParseKwdArgs(&sipParseErr, sipArgs, sipKwds, NULL, NULL, "BJ8", &sipSelf, sipType_rviz_VisualizationFrame, &sipCpp, sipType_QEvent, &a0))
        {
            sipCpp->sipProtectVirt_enterEvent(sipSelfWasArg,a0);

            Py_INCREF(Py_None);
            return Py_None;
        }
    }

    /* Raise an exception if the arguments couldn't be parsed. */
    sipNoMethod(sipParseErr, sipName_VisualizationFrame, sipName_enterEvent, NULL);

    return NULL;
}


extern "C" {static PyObject *meth_rviz_VisualizationFrame_leaveEvent(PyObject *, PyObject *, PyObject *);}
static PyObject *meth_rviz_VisualizationFrame_leaveEvent(PyObject *sipSelf, PyObject *sipArgs, PyObject *sipKwds)
{
    PyObject *sipParseErr = NULL;
    bool sipSelfWasArg = (!sipSelf || sipIsDerived((sipSimpleWrapper *)sipSelf));

    {
        QEvent* a0;
        siprviz_VisualizationFrame *sipCpp;

        if (sipParseKwdArgs(&sipParseErr, sipArgs, sipKwds, NULL, NULL, "BJ8", &sipSelf, sipType_rviz_VisualizationFrame, &sipCpp, sipType_QEvent, &a0))
        {
            sipCpp->sipProtectVirt_leaveEvent(sipSelfWasArg,a0);

            Py_INCREF(Py_None);
            return Py_None;
        }
    }

    /* Raise an exception if the arguments couldn't be parsed. */
    sipNoMethod(sipParseErr, sipName_VisualizationFrame, sipName_leaveEvent, NULL);

    return NULL;
}


extern "C" {static PyObject *meth_rviz_VisualizationFrame_paintEvent(PyObject *, PyObject *, PyObject *);}
static PyObject *meth_rviz_VisualizationFrame_paintEvent(PyObject *sipSelf, PyObject *sipArgs, PyObject *sipKwds)
{
    PyObject *sipParseErr = NULL;
    bool sipSelfWasArg = (!sipSelf || sipIsDerived((sipSimpleWrapper *)sipSelf));

    {
        QPaintEvent* a0;
        siprviz_VisualizationFrame *sipCpp;

        if (sipParseKwdArgs(&sipParseErr, sipArgs, sipKwds, NULL, NULL, "BJ8", &sipSelf, sipType_rviz_VisualizationFrame, &sipCpp, sipType_QPaintEvent, &a0))
        {
            sipCpp->sipProtectVirt_paintEvent(sipSelfWasArg,a0);

            Py_INCREF(Py_None);
            return Py_None;
        }
    }

    /* Raise an exception if the arguments couldn't be parsed. */
    sipNoMethod(sipParseErr, sipName_VisualizationFrame, sipName_paintEvent, NULL);

    return NULL;
}


extern "C" {static PyObject *meth_rviz_VisualizationFrame_moveEvent(PyObject *, PyObject *, PyObject *);}
static PyObject *meth_rviz_VisualizationFrame_moveEvent(PyObject *sipSelf, PyObject *sipArgs, PyObject *sipKwds)
{
    PyObject *sipParseErr = NULL;
    bool sipSelfWasArg = (!sipSelf || sipIsDerived((sipSimpleWrapper *)sipSelf));

    {
        QMoveEvent* a0;
        siprviz_VisualizationFrame *sipCpp;

        if (sipParseKwdArgs(&sipParseErr, sipArgs, sipKwds, NULL, NULL, "BJ8", &sipSelf, sipType_rviz_VisualizationFrame, &sipCpp, sipType_QMoveEvent, &a0))
        {
            sipCpp->sipProtectVirt_moveEvent(sipSelfWasArg,a0);

            Py_INCREF(Py_None);
            return Py_None;
        }
    }

    /* Raise an exception if the arguments couldn't be parsed. */
    sipNoMethod(sipParseErr, sipName_VisualizationFrame, sipName_moveEvent, NULL);

    return NULL;
}


extern "C" {static PyObject *meth_rviz_VisualizationFrame_resizeEvent(PyObject *, PyObject *, PyObject *);}
static PyObject *meth_rviz_VisualizationFrame_resizeEvent(PyObject *sipSelf, PyObject *sipArgs, PyObject *sipKwds)
{
    PyObject *sipParseErr = NULL;
    bool sipSelfWasArg = (!sipSelf || sipIsDerived((sipSimpleWrapper *)sipSelf));

    {
        QResizeEvent* a0;
        siprviz_VisualizationFrame *sipCpp;

        if (sipParseKwdArgs(&sipParseErr, sipArgs, sipKwds, NULL, NULL, "BJ8", &sipSelf, sipType_rviz_VisualizationFrame, &sipCpp, sipType_QResizeEvent, &a0))
        {
            sipCpp->sipProtectVirt_resizeEvent(sipSelfWasArg,a0);

            Py_INCREF(Py_None);
            return Py_None;
        }
    }

    /* Raise an exception if the arguments couldn't be parsed. */
    sipNoMethod(sipParseErr, sipName_VisualizationFrame, sipName_resizeEvent, NULL);

    return NULL;
}


extern "C" {static PyObject *meth_rviz_VisualizationFrame_closeEvent(PyObject *, PyObject *, PyObject *);}
static PyObject *meth_rviz_VisualizationFrame_closeEvent(PyObject *sipSelf, PyObject *sipArgs, PyObject *sipKwds)
{
    PyObject *sipParseErr = NULL;
    bool sipSelfWasArg = (!sipSelf || sipIsDerived((sipSimpleWrapper *)sipSelf));

    {
        QCloseEvent* a0;
        siprviz_VisualizationFrame *sipCpp;

        if (sipParseKwdArgs(&sipParseErr, sipArgs, sipKwds, NULL, NULL, "BJ8", &sipSelf, sipType_rviz_VisualizationFrame, &sipCpp, sipType_QCloseEvent, &a0))
        {
            sipCpp->sipProtectVirt_closeEvent(sipSelfWasArg,a0);

            Py_INCREF(Py_None);
            return Py_None;
        }
    }

    /* Raise an exception if the arguments couldn't be parsed. */
    sipNoMethod(sipParseErr, sipName_VisualizationFrame, sipName_closeEvent, NULL);

    return NULL;
}


extern "C" {static PyObject *meth_rviz_VisualizationFrame_tabletEvent(PyObject *, PyObject *, PyObject *);}
static PyObject *meth_rviz_VisualizationFrame_tabletEvent(PyObject *sipSelf, PyObject *sipArgs, PyObject *sipKwds)
{
    PyObject *sipParseErr = NULL;
    bool sipSelfWasArg = (!sipSelf || sipIsDerived((sipSimpleWrapper *)sipSelf));

    {
        QTabletEvent* a0;
        siprviz_VisualizationFrame *sipCpp;

        if (sipParseKwdArgs(&sipParseErr, sipArgs, sipKwds, NULL, NULL, "BJ8", &sipSelf, sipType_rviz_VisualizationFrame, &sipCpp, sipType_QTabletEvent, &a0))
        {
            sipCpp->sipProtectVirt_tabletEvent(sipSelfWasArg,a0);

            Py_INCREF(Py_None);
            return Py_None;
        }
    }

    /* Raise an exception if the arguments couldn't be parsed. */
    sipNoMethod(sipParseErr, sipName_VisualizationFrame, sipName_tabletEvent, NULL);

    return NULL;
}


extern "C" {static PyObject *meth_rviz_VisualizationFrame_actionEvent(PyObject *, PyObject *, PyObject *);}
static PyObject *meth_rviz_VisualizationFrame_actionEvent(PyObject *sipSelf, PyObject *sipArgs, PyObject *sipKwds)
{
    PyObject *sipParseErr = NULL;
    bool sipSelfWasArg = (!sipSelf || sipIsDerived((sipSimpleWrapper *)sipSelf));

    {
        QActionEvent* a0;
        siprviz_VisualizationFrame *sipCpp;

        if (sipParseKwdArgs(&sipParseErr, sipArgs, sipKwds, NULL, NULL, "BJ8", &sipSelf, sipType_rviz_VisualizationFrame, &sipCpp, sipType_QActionEvent, &a0))
        {
            sipCpp->sipProtectVirt_actionEvent(sipSelfWasArg,a0);

            Py_INCREF(Py_None);
            return Py_None;
        }
    }

    /* Raise an exception if the arguments couldn't be parsed. */
    sipNoMethod(sipParseErr, sipName_VisualizationFrame, sipName_actionEvent, NULL);

    return NULL;
}


extern "C" {static PyObject *meth_rviz_VisualizationFrame_dragEnterEvent(PyObject *, PyObject *, PyObject *);}
static PyObject *meth_rviz_VisualizationFrame_dragEnterEvent(PyObject *sipSelf, PyObject *sipArgs, PyObject *sipKwds)
{
    PyObject *sipParseErr = NULL;
    bool sipSelfWasArg = (!sipSelf || sipIsDerived((sipSimpleWrapper *)sipSelf));

    {
        QDragEnterEvent* a0;
        siprviz_VisualizationFrame *sipCpp;

        if (sipParseKwdArgs(&sipParseErr, sipArgs, sipKwds, NULL, NULL, "BJ8", &sipSelf, sipType_rviz_VisualizationFrame, &sipCpp, sipType_QDragEnterEvent, &a0))
        {
            sipCpp->sipProtectVirt_dragEnterEvent(sipSelfWasArg,a0);

            Py_INCREF(Py_None);
            return Py_None;
        }
    }

    /* Raise an exception if the arguments couldn't be parsed. */
    sipNoMethod(sipParseErr, sipName_VisualizationFrame, sipName_dragEnterEvent, NULL);

    return NULL;
}


extern "C" {static PyObject *meth_rviz_VisualizationFrame_dragMoveEvent(PyObject *, PyObject *, PyObject *);}
static PyObject *meth_rviz_VisualizationFrame_dragMoveEvent(PyObject *sipSelf, PyObject *sipArgs, PyObject *sipKwds)
{
    PyObject *sipParseErr = NULL;
    bool sipSelfWasArg = (!sipSelf || sipIsDerived((sipSimpleWrapper *)sipSelf));

    {
        QDragMoveEvent* a0;
        siprviz_VisualizationFrame *sipCpp;

        if (sipParseKwdArgs(&sipParseErr, sipArgs, sipKwds, NULL, NULL, "BJ8", &sipSelf, sipType_rviz_VisualizationFrame, &sipCpp, sipType_QDragMoveEvent, &a0))
        {
            sipCpp->sipProtectVirt_dragMoveEvent(sipSelfWasArg,a0);

            Py_INCREF(Py_None);
            return Py_None;
        }
    }

    /* Raise an exception if the arguments couldn't be parsed. */
    sipNoMethod(sipParseErr, sipName_VisualizationFrame, sipName_dragMoveEvent, NULL);

    return NULL;
}


extern "C" {static PyObject *meth_rviz_VisualizationFrame_dragLeaveEvent(PyObject *, PyObject *, PyObject *);}
static PyObject *meth_rviz_VisualizationFrame_dragLeaveEvent(PyObject *sipSelf, PyObject *sipArgs, PyObject *sipKwds)
{
    PyObject *sipParseErr = NULL;
    bool sipSelfWasArg = (!sipSelf || sipIsDerived((sipSimpleWrapper *)sipSelf));

    {
        QDragLeaveEvent* a0;
        siprviz_VisualizationFrame *sipCpp;

        if (sipParseKwdArgs(&sipParseErr, sipArgs, sipKwds, NULL, NULL, "BJ8", &sipSelf, sipType_rviz_VisualizationFrame, &sipCpp, sipType_QDragLeaveEvent, &a0))
        {
            sipCpp->sipProtectVirt_dragLeaveEvent(sipSelfWasArg,a0);

            Py_INCREF(Py_None);
            return Py_None;
        }
    }

    /* Raise an exception if the arguments couldn't be parsed. */
    sipNoMethod(sipParseErr, sipName_VisualizationFrame, sipName_dragLeaveEvent, NULL);

    return NULL;
}


extern "C" {static PyObject *meth_rviz_VisualizationFrame_dropEvent(PyObject *, PyObject *, PyObject *);}
static PyObject *meth_rviz_VisualizationFrame_dropEvent(PyObject *sipSelf, PyObject *sipArgs, PyObject *sipKwds)
{
    PyObject *sipParseErr = NULL;
    bool sipSelfWasArg = (!sipSelf || sipIsDerived((sipSimpleWrapper *)sipSelf));

    {
        QDropEvent* a0;
        siprviz_VisualizationFrame *sipCpp;

        if (sipParseKwdArgs(&sipParseErr, sipArgs, sipKwds, NULL, NULL, "BJ8", &sipSelf, sipType_rviz_VisualizationFrame, &sipCpp, sipType_QDropEvent, &a0))
        {
            sipCpp->sipProtectVirt_dropEvent(sipSelfWasArg,a0);

            Py_INCREF(Py_None);
            return Py_None;
        }
    }

    /* Raise an exception if the arguments couldn't be parsed. */
    sipNoMethod(sipParseErr, sipName_VisualizationFrame, sipName_dropEvent, NULL);

    return NULL;
}


extern "C" {static PyObject *meth_rviz_VisualizationFrame_showEvent(PyObject *, PyObject *, PyObject *);}
static PyObject *meth_rviz_VisualizationFrame_showEvent(PyObject *sipSelf, PyObject *sipArgs, PyObject *sipKwds)
{
    PyObject *sipParseErr = NULL;
    bool sipSelfWasArg = (!sipSelf || sipIsDerived((sipSimpleWrapper *)sipSelf));

    {
        QShowEvent* a0;
        siprviz_VisualizationFrame *sipCpp;

        if (sipParseKwdArgs(&sipParseErr, sipArgs, sipKwds, NULL, NULL, "BJ8", &sipSelf, sipType_rviz_VisualizationFrame, &sipCpp, sipType_QShowEvent, &a0))
        {
            sipCpp->sipProtectVirt_showEvent(sipSelfWasArg,a0);

            Py_INCREF(Py_None);
            return Py_None;
        }
    }

    /* Raise an exception if the arguments couldn't be parsed. */
    sipNoMethod(sipParseErr, sipName_VisualizationFrame, sipName_showEvent, NULL);

    return NULL;
}


extern "C" {static PyObject *meth_rviz_VisualizationFrame_hideEvent(PyObject *, PyObject *, PyObject *);}
static PyObject *meth_rviz_VisualizationFrame_hideEvent(PyObject *sipSelf, PyObject *sipArgs, PyObject *sipKwds)
{
    PyObject *sipParseErr = NULL;
    bool sipSelfWasArg = (!sipSelf || sipIsDerived((sipSimpleWrapper *)sipSelf));

    {
        QHideEvent* a0;
        siprviz_VisualizationFrame *sipCpp;

        if (sipParseKwdArgs(&sipParseErr, sipArgs, sipKwds, NULL, NULL, "BJ8", &sipSelf, sipType_rviz_VisualizationFrame, &sipCpp, sipType_QHideEvent, &a0))
        {
            sipCpp->sipProtectVirt_hideEvent(sipSelfWasArg,a0);

            Py_INCREF(Py_None);
            return Py_None;
        }
    }

    /* Raise an exception if the arguments couldn't be parsed. */
    sipNoMethod(sipParseErr, sipName_VisualizationFrame, sipName_hideEvent, NULL);

    return NULL;
}


extern "C" {static PyObject *meth_rviz_VisualizationFrame_changeEvent(PyObject *, PyObject *, PyObject *);}
static PyObject *meth_rviz_VisualizationFrame_changeEvent(PyObject *sipSelf, PyObject *sipArgs, PyObject *sipKwds)
{
    PyObject *sipParseErr = NULL;
    bool sipSelfWasArg = (!sipSelf || sipIsDerived((sipSimpleWrapper *)sipSelf));

    {
        QEvent* a0;
        siprviz_VisualizationFrame *sipCpp;

        if (sipParseKwdArgs(&sipParseErr, sipArgs, sipKwds, NULL, NULL, "BJ8", &sipSelf, sipType_rviz_VisualizationFrame, &sipCpp, sipType_QEvent, &a0))
        {
            sipCpp->sipProtectVirt_changeEvent(sipSelfWasArg,a0);

            Py_INCREF(Py_None);
            return Py_None;
        }
    }

    /* Raise an exception if the arguments couldn't be parsed. */
    sipNoMethod(sipParseErr, sipName_VisualizationFrame, sipName_changeEvent, NULL);

    return NULL;
}


extern "C" {static PyObject *meth_rviz_VisualizationFrame_metric(PyObject *, PyObject *, PyObject *);}
static PyObject *meth_rviz_VisualizationFrame_metric(PyObject *sipSelf, PyObject *sipArgs, PyObject *sipKwds)
{
    PyObject *sipParseErr = NULL;
    bool sipSelfWasArg = (!sipSelf || sipIsDerived((sipSimpleWrapper *)sipSelf));

    {
        QPaintDevice::PaintDeviceMetric a0;
        const siprviz_VisualizationFrame *sipCpp;

        if (sipParseKwdArgs(&sipParseErr, sipArgs, sipKwds, NULL, NULL, "BE", &sipSelf, sipType_rviz_VisualizationFrame, &sipCpp, sipType_QPaintDevice_PaintDeviceMetric, &a0))
        {
            int sipRes;

            sipRes = sipCpp->sipProtectVirt_metric(sipSelfWasArg,a0);

            return SIPLong_FromLong(sipRes);
        }
    }

    /* Raise an exception if the arguments couldn't be parsed. */
    sipNoMethod(sipParseErr, sipName_VisualizationFrame, sipName_metric, NULL);

    return NULL;
}


extern "C" {static PyObject *meth_rviz_VisualizationFrame_inputMethodEvent(PyObject *, PyObject *, PyObject *);}
static PyObject *meth_rviz_VisualizationFrame_inputMethodEvent(PyObject *sipSelf, PyObject *sipArgs, PyObject *sipKwds)
{
    PyObject *sipParseErr = NULL;
    bool sipSelfWasArg = (!sipSelf || sipIsDerived((sipSimpleWrapper *)sipSelf));

    {
        QInputMethodEvent* a0;
        siprviz_VisualizationFrame *sipCpp;

        if (sipParseKwdArgs(&sipParseErr, sipArgs, sipKwds, NULL, NULL, "BJ8", &sipSelf, sipType_rviz_VisualizationFrame, &sipCpp, sipType_QInputMethodEvent, &a0))
        {
            sipCpp->sipProtectVirt_inputMethodEvent(sipSelfWasArg,a0);

            Py_INCREF(Py_None);
            return Py_None;
        }
    }

    /* Raise an exception if the arguments couldn't be parsed. */
    sipNoMethod(sipParseErr, sipName_VisualizationFrame, sipName_inputMethodEvent, NULL);

    return NULL;
}


extern "C" {static PyObject *meth_rviz_VisualizationFrame_updateMicroFocus(PyObject *, PyObject *, PyObject *);}
static PyObject *meth_rviz_VisualizationFrame_updateMicroFocus(PyObject *sipSelf, PyObject *sipArgs, PyObject *sipKwds)
{
    PyObject *sipParseErr = NULL;

    {
        siprviz_VisualizationFrame *sipCpp;

        if (sipParseKwdArgs(&sipParseErr, sipArgs, sipKwds, NULL, NULL, "B", &sipSelf, sipType_rviz_VisualizationFrame, &sipCpp))
        {
            sipCpp->sipProtect_updateMicroFocus();

            Py_INCREF(Py_None);
            return Py_None;
        }
    }

    /* Raise an exception if the arguments couldn't be parsed. */
    sipNoMethod(sipParseErr, sipName_VisualizationFrame, sipName_updateMicroFocus, NULL);

    return NULL;
}


extern "C" {static PyObject *meth_rviz_VisualizationFrame_create(PyObject *, PyObject *, PyObject *);}
static PyObject *meth_rviz_VisualizationFrame_create(PyObject *sipSelf, PyObject *sipArgs, PyObject *sipKwds)
{
    PyObject *sipParseErr = NULL;

    {
        WId a0def = 0;
        WId* a0 = &a0def;
        int a0State = 0;
        bool a1 = 1;
        bool a2 = 1;
        siprviz_VisualizationFrame *sipCpp;

        static const char *sipKwdList[] = {
            sipName_window,
            sipName_initializeWindow,
            sipName_destroyOldWindow,
        };

        if (sipParseKwdArgs(&sipParseErr, sipArgs, sipKwds, sipKwdList, NULL, "B|J1bb", &sipSelf, sipType_rviz_VisualizationFrame, &sipCpp, sipType_quintptr,&a0, &a0State, &a1, &a2))
        {
            sipCpp->sipProtect_create(*a0,a1,a2);
            sipReleaseType(a0,sipType_quintptr,a0State);

            Py_INCREF(Py_None);
            return Py_None;
        }
    }

    /* Raise an exception if the arguments couldn't be parsed. */
    sipNoMethod(sipParseErr, sipName_VisualizationFrame, sipName_create, NULL);

    return NULL;
}


extern "C" {static PyObject *meth_rviz_VisualizationFrame_destroy(PyObject *, PyObject *, PyObject *);}
static PyObject *meth_rviz_VisualizationFrame_destroy(PyObject *sipSelf, PyObject *sipArgs, PyObject *sipKwds)
{
    PyObject *sipParseErr = NULL;

    {
        bool a0 = 1;
        bool a1 = 1;
        siprviz_VisualizationFrame *sipCpp;

        static const char *sipKwdList[] = {
            sipName_destroyWindow,
            sipName_destroySubWindows,
        };

        if (sipParseKwdArgs(&sipParseErr, sipArgs, sipKwds, sipKwdList, NULL, "B|bb", &sipSelf, sipType_rviz_VisualizationFrame, &sipCpp, &a0, &a1))
        {
            sipCpp->sipProtect_destroy(a0,a1);

            Py_INCREF(Py_None);
            return Py_None;
        }
    }

    /* Raise an exception if the arguments couldn't be parsed. */
    sipNoMethod(sipParseErr, sipName_VisualizationFrame, sipName_destroy, NULL);

    return NULL;
}


extern "C" {static PyObject *meth_rviz_VisualizationFrame_focusNextPrevChild(PyObject *, PyObject *, PyObject *);}
static PyObject *meth_rviz_VisualizationFrame_focusNextPrevChild(PyObject *sipSelf, PyObject *sipArgs, PyObject *sipKwds)
{
    PyObject *sipParseErr = NULL;
    bool sipSelfWasArg = (!sipSelf || sipIsDerived((sipSimpleWrapper *)sipSelf));

    {
        bool a0;
        siprviz_VisualizationFrame *sipCpp;

        if (sipParseKwdArgs(&sipParseErr, sipArgs, sipKwds, NULL, NULL, "Bb", &sipSelf, sipType_rviz_VisualizationFrame, &sipCpp, &a0))
        {
            bool sipRes;

            sipRes = sipCpp->sipProtectVirt_focusNextPrevChild(sipSelfWasArg,a0);

            return PyBool_FromLong(sipRes);
        }
    }

    /* Raise an exception if the arguments couldn't be parsed. */
    sipNoMethod(sipParseErr, sipName_VisualizationFrame, sipName_focusNextPrevChild, NULL);

    return NULL;
}


extern "C" {static PyObject *meth_rviz_VisualizationFrame_focusNextChild(PyObject *, PyObject *, PyObject *);}
static PyObject *meth_rviz_VisualizationFrame_focusNextChild(PyObject *sipSelf, PyObject *sipArgs, PyObject *sipKwds)
{
    PyObject *sipParseErr = NULL;

    {
        siprviz_VisualizationFrame *sipCpp;

        if (sipParseKwdArgs(&sipParseErr, sipArgs, sipKwds, NULL, NULL, "B", &sipSelf, sipType_rviz_VisualizationFrame, &sipCpp))
        {
            bool sipRes;

            sipRes = sipCpp->sipProtect_focusNextChild();

            return PyBool_FromLong(sipRes);
        }
    }

    /* Raise an exception if the arguments couldn't be parsed. */
    sipNoMethod(sipParseErr, sipName_VisualizationFrame, sipName_focusNextChild, NULL);

    return NULL;
}


extern "C" {static PyObject *meth_rviz_VisualizationFrame_focusPreviousChild(PyObject *, PyObject *, PyObject *);}
static PyObject *meth_rviz_VisualizationFrame_focusPreviousChild(PyObject *sipSelf, PyObject *sipArgs, PyObject *sipKwds)
{
    PyObject *sipParseErr = NULL;

    {
        siprviz_VisualizationFrame *sipCpp;

        if (sipParseKwdArgs(&sipParseErr, sipArgs, sipKwds, NULL, NULL, "B", &sipSelf, sipType_rviz_VisualizationFrame, &sipCpp))
        {
            bool sipRes;

            sipRes = sipCpp->sipProtect_focusPreviousChild();

            return PyBool_FromLong(sipRes);
        }
    }

    /* Raise an exception if the arguments couldn't be parsed. */
    sipNoMethod(sipParseErr, sipName_VisualizationFrame, sipName_focusPreviousChild, NULL);

    return NULL;
}


extern "C" {static PyObject *meth_rviz_VisualizationFrame_nativeEvent(PyObject *, PyObject *, PyObject *);}
static PyObject *meth_rviz_VisualizationFrame_nativeEvent(PyObject *sipSelf, PyObject *sipArgs, PyObject *sipKwds)
{
    PyObject *sipParseErr = NULL;
    bool sipSelfWasArg = (!sipSelf || sipIsDerived((sipSimpleWrapper *)sipSelf));

    {
        const QByteArray* a0;
        int a0State = 0;
        void* a1;
        long a2;
        siprviz_VisualizationFrame *sipCpp;

        if (sipParseKwdArgs(&sipParseErr, sipArgs, sipKwds, NULL, NULL, "BJ1v", &sipSelf, sipType_rviz_VisualizationFrame, &sipCpp, sipType_QByteArray, &a0, &a0State, &a1))
        {
            bool sipRes;

            sipRes = sipCpp->sipProtectVirt_nativeEvent(sipSelfWasArg,*a0,a1,&a2);
            sipReleaseType(const_cast<QByteArray *>(a0),sipType_QByteArray,a0State);

            return sipBuildResult(0,"(bl)",sipRes,a2);
        }
    }

    /* Raise an exception if the arguments couldn't be parsed. */
    sipNoMethod(sipParseErr, sipName_VisualizationFrame, sipName_nativeEvent, NULL);

    return NULL;
}


extern "C" {static PyObject *meth_rviz_VisualizationFrame_sharedPainter(PyObject *, PyObject *, PyObject *);}
static PyObject *meth_rviz_VisualizationFrame_sharedPainter(PyObject *sipSelf, PyObject *sipArgs, PyObject *sipKwds)
{
    PyObject *sipParseErr = NULL;
    bool sipSelfWasArg = (!sipSelf || sipIsDerived((sipSimpleWrapper *)sipSelf));

    {
        const siprviz_VisualizationFrame *sipCpp;

        if (sipParseKwdArgs(&sipParseErr, sipArgs, sipKwds, NULL, NULL, "B", &sipSelf, sipType_rviz_VisualizationFrame, &sipCpp))
        {
            QPainter*sipRes;

            sipRes = sipCpp->sipProtectVirt_sharedPainter(sipSelfWasArg);

            return sipConvertFromType(sipRes,sipType_QPainter,NULL);
        }
    }

    /* Raise an exception if the arguments couldn't be parsed. */
    sipNoMethod(sipParseErr, sipName_VisualizationFrame, sipName_sharedPainter, NULL);

    return NULL;
}


extern "C" {static PyObject *meth_rviz_VisualizationFrame_initPainter(PyObject *, PyObject *, PyObject *);}
static PyObject *meth_rviz_VisualizationFrame_initPainter(PyObject *sipSelf, PyObject *sipArgs, PyObject *sipKwds)
{
    PyObject *sipParseErr = NULL;
    bool sipSelfWasArg = (!sipSelf || sipIsDerived((sipSimpleWrapper *)sipSelf));

    {
        QPainter* a0;
        const siprviz_VisualizationFrame *sipCpp;

        if (sipParseKwdArgs(&sipParseErr, sipArgs, sipKwds, NULL, NULL, "BJ8", &sipSelf, sipType_rviz_VisualizationFrame, &sipCpp, sipType_QPainter, &a0))
        {
            sipCpp->sipProtectVirt_initPainter(sipSelfWasArg,a0);

            Py_INCREF(Py_None);
            return Py_None;
        }
    }

    /* Raise an exception if the arguments couldn't be parsed. */
    sipNoMethod(sipParseErr, sipName_VisualizationFrame, sipName_initPainter, NULL);

    return NULL;
}


extern "C" {static PyObject *meth_rviz_VisualizationFrame_contextMenuEvent(PyObject *, PyObject *, PyObject *);}
static PyObject *meth_rviz_VisualizationFrame_contextMenuEvent(PyObject *sipSelf, PyObject *sipArgs, PyObject *sipKwds)
{
    PyObject *sipParseErr = NULL;
    bool sipSelfWasArg = (!sipSelf || sipIsDerived((sipSimpleWrapper *)sipSelf));

    {
        QContextMenuEvent* a0;
        siprviz_VisualizationFrame *sipCpp;

        if (sipParseKwdArgs(&sipParseErr, sipArgs, sipKwds, NULL, NULL, "BJ8", &sipSelf, sipType_rviz_VisualizationFrame, &sipCpp, sipType_QContextMenuEvent, &a0))
        {
            sipCpp->sipProtectVirt_contextMenuEvent(sipSelfWasArg,a0);

            Py_INCREF(Py_None);
            return Py_None;
        }
    }

    /* Raise an exception if the arguments couldn't be parsed. */
    sipNoMethod(sipParseErr, sipName_VisualizationFrame, sipName_contextMenuEvent, NULL);

    return NULL;
}


extern "C" {static PyObject *meth_rviz_VisualizationFrame_event(PyObject *, PyObject *, PyObject *);}
static PyObject *meth_rviz_VisualizationFrame_event(PyObject *sipSelf, PyObject *sipArgs, PyObject *sipKwds)
{
    PyObject *sipParseErr = NULL;
    bool sipSelfWasArg = (!sipSelf || sipIsDerived((sipSimpleWrapper *)sipSelf));

    {
        QEvent* a0;
        siprviz_VisualizationFrame *sipCpp;

        if (sipParseKwdArgs(&sipParseErr, sipArgs, sipKwds, NULL, NULL, "BJ8", &sipSelf, sipType_rviz_VisualizationFrame, &sipCpp, sipType_QEvent, &a0))
        {
            bool sipRes;

            sipRes = sipCpp->sipProtectVirt_event(sipSelfWasArg,a0);

            return PyBool_FromLong(sipRes);
        }
    }

    /* Raise an exception if the arguments couldn't be parsed. */
    sipNoMethod(sipParseErr, sipName_VisualizationFrame, sipName_event, NULL);

    return NULL;
}


extern "C" {static PyObject *meth_rviz_VisualizationFrame_setShowChooseNewMaster(PyObject *, PyObject *);}
static PyObject *meth_rviz_VisualizationFrame_setShowChooseNewMaster(PyObject *sipSelf, PyObject *sipArgs)
{
    PyObject *sipParseErr = NULL;

    {
        bool a0;
        rviz::VisualizationFrame *sipCpp;

        if (sipParseArgs(&sipParseErr, sipArgs, "Bb", &sipSelf, sipType_rviz_VisualizationFrame, &sipCpp, &a0))
        {
            sipCpp->setShowChooseNewMaster(a0);

            Py_INCREF(Py_None);
            return Py_None;
        }
    }

    /* Raise an exception if the arguments couldn't be parsed. */
    sipNoMethod(sipParseErr, sipName_VisualizationFrame, sipName_setShowChooseNewMaster, NULL);

    return NULL;
}


extern "C" {static PyObject *meth_rviz_VisualizationFrame_setHelpPath(PyObject *, PyObject *);}
static PyObject *meth_rviz_VisualizationFrame_setHelpPath(PyObject *sipSelf, PyObject *sipArgs)
{
    PyObject *sipParseErr = NULL;

    {
        const QString* a0;
        int a0State = 0;
        rviz::VisualizationFrame *sipCpp;

        if (sipParseArgs(&sipParseErr, sipArgs, "BJ1", &sipSelf, sipType_rviz_VisualizationFrame, &sipCpp, sipType_QString,&a0, &a0State))
        {
            sipCpp->setHelpPath(*a0);
            sipReleaseType(const_cast<QString *>(a0),sipType_QString,a0State);

            Py_INCREF(Py_None);
            return Py_None;
        }
    }

    /* Raise an exception if the arguments couldn't be parsed. */
    sipNoMethod(sipParseErr, sipName_VisualizationFrame, sipName_setHelpPath, NULL);

    return NULL;
}


extern "C" {static PyObject *meth_rviz_VisualizationFrame_setSplashPath(PyObject *, PyObject *);}
static PyObject *meth_rviz_VisualizationFrame_setSplashPath(PyObject *sipSelf, PyObject *sipArgs)
{
    PyObject *sipParseErr = NULL;

    {
        const QString* a0;
        int a0State = 0;
        rviz::VisualizationFrame *sipCpp;

        if (sipParseArgs(&sipParseErr, sipArgs, "BJ1", &sipSelf, sipType_rviz_VisualizationFrame, &sipCpp, sipType_QString,&a0, &a0State))
        {
            sipCpp->setSplashPath(*a0);
            sipReleaseType(const_cast<QString *>(a0),sipType_QString,a0State);

            Py_INCREF(Py_None);
            return Py_None;
        }
    }

    /* Raise an exception if the arguments couldn't be parsed. */
    sipNoMethod(sipParseErr, sipName_VisualizationFrame, sipName_setSplashPath, NULL);

    return NULL;
}


extern "C" {static PyObject *meth_rviz_VisualizationFrame_initialize(PyObject *, PyObject *);}
static PyObject *meth_rviz_VisualizationFrame_initialize(PyObject *sipSelf, PyObject *sipArgs)
{
    PyObject *sipParseErr = NULL;

    {
        const QString& a0def = "";
        const QString* a0 = &a0def;
        int a0State = 0;
        rviz::VisualizationFrame *sipCpp;

        if (sipParseArgs(&sipParseErr, sipArgs, "B|J1", &sipSelf, sipType_rviz_VisualizationFrame, &sipCpp, sipType_QString,&a0, &a0State))
        {
            sipCpp->initialize(*a0);
            sipReleaseType(const_cast<QString *>(a0),sipType_QString,a0State);

            Py_INCREF(Py_None);
            return Py_None;
        }
    }

    /* Raise an exception if the arguments couldn't be parsed. */
    sipNoMethod(sipParseErr, sipName_VisualizationFrame, sipName_initialize, NULL);

    return NULL;
}


extern "C" {static PyObject *meth_rviz_VisualizationFrame_getManager(PyObject *, PyObject *);}
static PyObject *meth_rviz_VisualizationFrame_getManager(PyObject *sipSelf, PyObject *sipArgs)
{
    PyObject *sipParseErr = NULL;

    {
        rviz::VisualizationFrame *sipCpp;

        if (sipParseArgs(&sipParseErr, sipArgs, "B", &sipSelf, sipType_rviz_VisualizationFrame, &sipCpp))
        {
            rviz::VisualizationManager*sipRes;

            sipRes = sipCpp->getManager();

            return sipConvertFromType(sipRes,sipType_rviz_VisualizationManager,NULL);
        }
    }

    /* Raise an exception if the arguments couldn't be parsed. */
    sipNoMethod(sipParseErr, sipName_VisualizationFrame, sipName_getManager, NULL);

    return NULL;
}


extern "C" {static PyObject *meth_rviz_VisualizationFrame_getParentWindow(PyObject *, PyObject *);}
static PyObject *meth_rviz_VisualizationFrame_getParentWindow(PyObject *sipSelf, PyObject *sipArgs)
{
    PyObject *sipParseErr = NULL;
    bool sipSelfWasArg = (!sipSelf || sipIsDerived((sipSimpleWrapper *)sipSelf));

    {
        rviz::VisualizationFrame *sipCpp;

        if (sipParseArgs(&sipParseErr, sipArgs, "B", &sipSelf, sipType_rviz_VisualizationFrame, &sipCpp))
        {
            QWidget*sipRes;

            sipRes = (sipSelfWasArg ? sipCpp->rviz::VisualizationFrame::getParentWindow() : sipCpp->getParentWindow());

            return sipConvertFromType(sipRes,sipType_QWidget,NULL);
        }
    }

    /* Raise an exception if the arguments couldn't be parsed. */
    sipNoMethod(sipParseErr, sipName_VisualizationFrame, sipName_getParentWindow, NULL);

    return NULL;
}


extern "C" {static PyObject *meth_rviz_VisualizationFrame_addPane(PyObject *, PyObject *);}
static PyObject *meth_rviz_VisualizationFrame_addPane(PyObject *sipSelf, PyObject *sipArgs)
{
    PyObject *sipParseErr = NULL;
    bool sipSelfWasArg = (!sipSelf || sipIsDerived((sipSimpleWrapper *)sipSelf));

    {
        const QString* a0;
        int a0State = 0;
        QWidget* a1;
        Qt::DockWidgetArea a2 = Qt::LeftDockWidgetArea;
        bool a3 = 1;
        rviz::VisualizationFrame *sipCpp;

        if (sipParseArgs(&sipParseErr, sipArgs, "BJ1J8|Eb", &sipSelf, sipType_rviz_VisualizationFrame, &sipCpp, sipType_QString,&a0, &a0State, sipType_QWidget, &a1, sipType_Qt_DockWidgetArea, &a2, &a3))
        {
            rviz::PanelDockWidget*sipRes;

            sipRes = (sipSelfWasArg ? sipCpp->rviz::VisualizationFrame::addPane(*a0,a1,a2,a3) : sipCpp->addPane(*a0,a1,a2,a3));
            sipReleaseType(const_cast<QString *>(a0),sipType_QString,a0State);

            return sipConvertFromType(sipRes,sipType_rviz_PanelDockWidget,NULL);
        }
    }

    /* Raise an exception if the arguments couldn't be parsed. */
    sipNoMethod(sipParseErr, sipName_VisualizationFrame, sipName_addPane, NULL);

    return NULL;
}


extern "C" {static PyObject *meth_rviz_VisualizationFrame_loadPersistentSettings(PyObject *, PyObject *);}
static PyObject *meth_rviz_VisualizationFrame_loadPersistentSettings(PyObject *sipSelf, PyObject *sipArgs)
{
    PyObject *sipParseErr = NULL;

    {
        rviz::VisualizationFrame *sipCpp;

        if (sipParseArgs(&sipParseErr, sipArgs, "B", &sipSelf, sipType_rviz_VisualizationFrame, &sipCpp))
        {
            sipCpp->loadPersistentSettings();

            Py_INCREF(Py_None);
            return Py_None;
        }
    }

    /* Raise an exception if the arguments couldn't be parsed. */
    sipNoMethod(sipParseErr, sipName_VisualizationFrame, sipName_loadPersistentSettings, NULL);

    return NULL;
}


extern "C" {static PyObject *meth_rviz_VisualizationFrame_savePersistentSettings(PyObject *, PyObject *);}
static PyObject *meth_rviz_VisualizationFrame_savePersistentSettings(PyObject *sipSelf, PyObject *sipArgs)
{
    PyObject *sipParseErr = NULL;

    {
        rviz::VisualizationFrame *sipCpp;

        if (sipParseArgs(&sipParseErr, sipArgs, "B", &sipSelf, sipType_rviz_VisualizationFrame, &sipCpp))
        {
            sipCpp->savePersistentSettings();

            Py_INCREF(Py_None);
            return Py_None;
        }
    }

    /* Raise an exception if the arguments couldn't be parsed. */
    sipNoMethod(sipParseErr, sipName_VisualizationFrame, sipName_savePersistentSettings, NULL);

    return NULL;
}


extern "C" {static PyObject *meth_rviz_VisualizationFrame_loadDisplayConfig(PyObject *, PyObject *);}
static PyObject *meth_rviz_VisualizationFrame_loadDisplayConfig(PyObject *sipSelf, PyObject *sipArgs)
{
    PyObject *sipParseErr = NULL;

    {
        const QString* a0;
        int a0State = 0;
        rviz::VisualizationFrame *sipCpp;

        if (sipParseArgs(&sipParseErr, sipArgs, "BJ1", &sipSelf, sipType_rviz_VisualizationFrame, &sipCpp, sipType_QString,&a0, &a0State))
        {
            sipCpp->loadDisplayConfig(*a0);
            sipReleaseType(const_cast<QString *>(a0),sipType_QString,a0State);

            Py_INCREF(Py_None);
            return Py_None;
        }
    }

    /* Raise an exception if the arguments couldn't be parsed. */
    sipNoMethod(sipParseErr, sipName_VisualizationFrame, sipName_loadDisplayConfig, NULL);

    return NULL;
}


extern "C" {static PyObject *meth_rviz_VisualizationFrame_saveDisplayConfig(PyObject *, PyObject *);}
static PyObject *meth_rviz_VisualizationFrame_saveDisplayConfig(PyObject *sipSelf, PyObject *sipArgs)
{
    PyObject *sipParseErr = NULL;

    {
        const QString* a0;
        int a0State = 0;
        rviz::VisualizationFrame *sipCpp;

        if (sipParseArgs(&sipParseErr, sipArgs, "BJ1", &sipSelf, sipType_rviz_VisualizationFrame, &sipCpp, sipType_QString,&a0, &a0State))
        {
            bool sipRes;

            sipRes = sipCpp->saveDisplayConfig(*a0);
            sipReleaseType(const_cast<QString *>(a0),sipType_QString,a0State);

            return PyBool_FromLong(sipRes);
        }
    }

    /* Raise an exception if the arguments couldn't be parsed. */
    sipNoMethod(sipParseErr, sipName_VisualizationFrame, sipName_saveDisplayConfig, NULL);

    return NULL;
}


extern "C" {static PyObject *meth_rviz_VisualizationFrame_getErrorMessage(PyObject *, PyObject *);}
static PyObject *meth_rviz_VisualizationFrame_getErrorMessage(PyObject *sipSelf, PyObject *sipArgs)
{
    PyObject *sipParseErr = NULL;

    {
        const rviz::VisualizationFrame *sipCpp;

        if (sipParseArgs(&sipParseErr, sipArgs, "B", &sipSelf, sipType_rviz_VisualizationFrame, &sipCpp))
        {
            QString*sipRes;

            sipRes = new QString(sipCpp->getErrorMessage());

            return sipConvertFromNewType(sipRes,sipType_QString,NULL);
        }
    }

    /* Raise an exception if the arguments couldn't be parsed. */
    sipNoMethod(sipParseErr, sipName_VisualizationFrame, sipName_getErrorMessage, NULL);

    return NULL;
}


extern "C" {static PyObject *meth_rviz_VisualizationFrame_load(PyObject *, PyObject *);}
static PyObject *meth_rviz_VisualizationFrame_load(PyObject *sipSelf, PyObject *sipArgs)
{
    PyObject *sipParseErr = NULL;
    bool sipSelfWasArg = (!sipSelf || sipIsDerived((sipSimpleWrapper *)sipSelf));

    {
        const rviz::Config* a0;
        rviz::VisualizationFrame *sipCpp;

        if (sipParseArgs(&sipParseErr, sipArgs, "BJ9", &sipSelf, sipType_rviz_VisualizationFrame, &sipCpp, sipType_rviz_Config, &a0))
        {
            (sipSelfWasArg ? sipCpp->rviz::VisualizationFrame::load(*a0) : sipCpp->load(*a0));

            Py_INCREF(Py_None);
            return Py_None;
        }
    }

    /* Raise an exception if the arguments couldn't be parsed. */
    sipNoMethod(sipParseErr, sipName_VisualizationFrame, sipName_load, NULL);

    return NULL;
}


extern "C" {static PyObject *meth_rviz_VisualizationFrame_save(PyObject *, PyObject *);}
static PyObject *meth_rviz_VisualizationFrame_save(PyObject *sipSelf, PyObject *sipArgs)
{
    PyObject *sipParseErr = NULL;
    bool sipSelfWasArg = (!sipSelf || sipIsDerived((sipSimpleWrapper *)sipSelf));

    {
        rviz::Config* a0;
        rviz::VisualizationFrame *sipCpp;

        if (sipParseArgs(&sipParseErr, sipArgs, "BJ9", &sipSelf, sipType_rviz_VisualizationFrame, &sipCpp, sipType_rviz_Config, &a0))
        {
            (sipSelfWasArg ? sipCpp->rviz::VisualizationFrame::save(*a0) : sipCpp->save(*a0));

            Py_INCREF(Py_None);
            return Py_None;
        }
    }

    /* Raise an exception if the arguments couldn't be parsed. */
    sipNoMethod(sipParseErr, sipName_VisualizationFrame, sipName_save, NULL);

    return NULL;
}


extern "C" {static PyObject *meth_rviz_VisualizationFrame_setHideButtonVisibility(PyObject *, PyObject *);}
static PyObject *meth_rviz_VisualizationFrame_setHideButtonVisibility(PyObject *sipSelf, PyObject *sipArgs)
{
    PyObject *sipParseErr = NULL;

    {
        bool a0;
        rviz::VisualizationFrame *sipCpp;

        if (sipParseArgs(&sipParseErr, sipArgs, "Bb", &sipSelf, sipType_rviz_VisualizationFrame, &sipCpp, &a0))
        {
            sipCpp->setHideButtonVisibility(a0);

            Py_INCREF(Py_None);
            return Py_None;
        }
    }

    /* Raise an exception if the arguments couldn't be parsed. */
    sipNoMethod(sipParseErr, sipName_VisualizationFrame, sipName_setHideButtonVisibility, NULL);

    return NULL;
}


/* Cast a pointer to a type somewhere in its superclass hierarchy. */
extern "C" {static void *cast_rviz_VisualizationFrame(void *, const sipTypeDef *);}
static void *cast_rviz_VisualizationFrame(void *ptr, const sipTypeDef *targetType)
{
    void *res;

    if (targetType == sipType_rviz_VisualizationFrame)
        return ptr;

    if ((res = ((const sipClassTypeDef *)sipType_QMainWindow)->ctd_cast((QMainWindow *)(rviz::VisualizationFrame *)ptr,targetType)) != NULL)
        return res;

    return NULL;
}


/* Call the instance's destructor. */
extern "C" {static void release_rviz_VisualizationFrame(void *, int);}
static void release_rviz_VisualizationFrame(void *sipCppV,int)
{
    rviz::VisualizationFrame *sipCpp = reinterpret_cast<rviz::VisualizationFrame *>(sipCppV);

    if (QThread::currentThread() == sipCpp->thread())
        delete sipCpp;
    else
        sipCpp->deleteLater();
}


extern "C" {static void dealloc_rviz_VisualizationFrame(sipSimpleWrapper *);}
static void dealloc_rviz_VisualizationFrame(sipSimpleWrapper *sipSelf)
{
    if (sipIsDerived(sipSelf))
        reinterpret_cast<siprviz_VisualizationFrame *>(sipGetAddress(sipSelf))->sipPySelf = NULL;

    if (sipIsPyOwned(sipSelf))
    {
        release_rviz_VisualizationFrame(sipGetAddress(sipSelf),sipSelf->flags);
    }
}


extern "C" {static void *init_type_rviz_VisualizationFrame(sipSimpleWrapper *, PyObject *, PyObject *, PyObject **, PyObject **, PyObject **);}
static void *init_type_rviz_VisualizationFrame(sipSimpleWrapper *sipSelf, PyObject *sipArgs, PyObject *sipKwds, PyObject **sipUnused, PyObject **, PyObject **sipParseErr)
{
    siprviz_VisualizationFrame *sipCpp = 0;

    {
        QWidget* a0 = 0;

        if (sipParseKwdArgs(sipParseErr, sipArgs, sipKwds, NULL, sipUnused, "|J8", sipType_QWidget, &a0))
        {
            sipCpp = new siprviz_VisualizationFrame(a0);

            sipCpp->sipPySelf = sipSelf;

            return sipCpp;
        }
    }

    return NULL;
}


/* Define this type's super-types. */
static sipEncodedTypeDef supers_rviz_VisualizationFrame[] = {{220, 2, 1}};


static PyMethodDef methods_rviz_VisualizationFrame[] = {
    {SIP_MLNAME_CAST(sipName_actionEvent), (PyCFunction)meth_rviz_VisualizationFrame_actionEvent, METH_VARARGS|METH_KEYWORDS, NULL},
    {SIP_MLNAME_CAST(sipName_addPane), meth_rviz_VisualizationFrame_addPane, METH_VARARGS, NULL},
    {SIP_MLNAME_CAST(sipName_changeEvent), (PyCFunction)meth_rviz_VisualizationFrame_changeEvent, METH_VARARGS|METH_KEYWORDS, NULL},
    {SIP_MLNAME_CAST(sipName_childEvent), (PyCFunction)meth_rviz_VisualizationFrame_childEvent, METH_VARARGS|METH_KEYWORDS, NULL},
    {SIP_MLNAME_CAST(sipName_closeEvent), (PyCFunction)meth_rviz_VisualizationFrame_closeEvent, METH_VARARGS|METH_KEYWORDS, NULL},
    {SIP_MLNAME_CAST(sipName_connectNotify), (PyCFunction)meth_rviz_VisualizationFrame_connectNotify, METH_VARARGS|METH_KEYWORDS, NULL},
    {SIP_MLNAME_CAST(sipName_contextMenuEvent), (PyCFunction)meth_rviz_VisualizationFrame_contextMenuEvent, METH_VARARGS|METH_KEYWORDS, NULL},
    {SIP_MLNAME_CAST(sipName_create), (PyCFunction)meth_rviz_VisualizationFrame_create, METH_VARARGS|METH_KEYWORDS, NULL},
    {SIP_MLNAME_CAST(sipName_customEvent), (PyCFunction)meth_rviz_VisualizationFrame_customEvent, METH_VARARGS|METH_KEYWORDS, NULL},
    {SIP_MLNAME_CAST(sipName_destroy), (PyCFunction)meth_rviz_VisualizationFrame_destroy, METH_VARARGS|METH_KEYWORDS, NULL},
    {SIP_MLNAME_CAST(sipName_disconnectNotify), (PyCFunction)meth_rviz_VisualizationFrame_disconnectNotify, METH_VARARGS|METH_KEYWORDS, NULL},
    {SIP_MLNAME_CAST(sipName_dragEnterEvent), (PyCFunction)meth_rviz_VisualizationFrame_dragEnterEvent, METH_VARARGS|METH_KEYWORDS, NULL},
    {SIP_MLNAME_CAST(sipName_dragLeaveEvent), (PyCFunction)meth_rviz_VisualizationFrame_dragLeaveEvent, METH_VARARGS|METH_KEYWORDS, NULL},
    {SIP_MLNAME_CAST(sipName_dragMoveEvent), (PyCFunction)meth_rviz_VisualizationFrame_dragMoveEvent, METH_VARARGS|METH_KEYWORDS, NULL},
    {SIP_MLNAME_CAST(sipName_dropEvent), (PyCFunction)meth_rviz_VisualizationFrame_dropEvent, METH_VARARGS|METH_KEYWORDS, NULL},
    {SIP_MLNAME_CAST(sipName_enterEvent), (PyCFunction)meth_rviz_VisualizationFrame_enterEvent, METH_VARARGS|METH_KEYWORDS, NULL},
    {SIP_MLNAME_CAST(sipName_event), (PyCFunction)meth_rviz_VisualizationFrame_event, METH_VARARGS|METH_KEYWORDS, NULL},
    {SIP_MLNAME_CAST(sipName_focusInEvent), (PyCFunction)meth_rviz_VisualizationFrame_focusInEvent, METH_VARARGS|METH_KEYWORDS, NULL},
    {SIP_MLNAME_CAST(sipName_focusNextChild), (PyCFunction)meth_rviz_VisualizationFrame_focusNextChild, METH_VARARGS|METH_KEYWORDS, NULL},
    {SIP_MLNAME_CAST(sipName_focusNextPrevChild), (PyCFunction)meth_rviz_VisualizationFrame_focusNextPrevChild, METH_VARARGS|METH_KEYWORDS, NULL},
    {SIP_MLNAME_CAST(sipName_focusOutEvent), (PyCFunction)meth_rviz_VisualizationFrame_focusOutEvent, METH_VARARGS|METH_KEYWORDS, NULL},
    {SIP_MLNAME_CAST(sipName_focusPreviousChild), (PyCFunction)meth_rviz_VisualizationFrame_focusPreviousChild, METH_VARARGS|METH_KEYWORDS, NULL},
    {SIP_MLNAME_CAST(sipName_getErrorMessage), meth_rviz_VisualizationFrame_getErrorMessage, METH_VARARGS, NULL},
    {SIP_MLNAME_CAST(sipName_getManager), meth_rviz_VisualizationFrame_getManager, METH_VARARGS, NULL},
    {SIP_MLNAME_CAST(sipName_getParentWindow), meth_rviz_VisualizationFrame_getParentWindow, METH_VARARGS, NULL},
    {SIP_MLNAME_CAST(sipName_hideEvent), (PyCFunction)meth_rviz_VisualizationFrame_hideEvent, METH_VARARGS|METH_KEYWORDS, NULL},
    {SIP_MLNAME_CAST(sipName_initPainter), (PyCFunction)meth_rviz_VisualizationFrame_initPainter, METH_VARARGS|METH_KEYWORDS, NULL},
    {SIP_MLNAME_CAST(sipName_initialize), meth_rviz_VisualizationFrame_initialize, METH_VARARGS, NULL},
    {SIP_MLNAME_CAST(sipName_inputMethodEvent), (PyCFunction)meth_rviz_VisualizationFrame_inputMethodEvent, METH_VARARGS|METH_KEYWORDS, NULL},
    {SIP_MLNAME_CAST(sipName_isSignalConnected), (PyCFunction)meth_rviz_VisualizationFrame_isSignalConnected, METH_VARARGS|METH_KEYWORDS, NULL},
    {SIP_MLNAME_CAST(sipName_keyPressEvent), (PyCFunction)meth_rviz_VisualizationFrame_keyPressEvent, METH_VARARGS|METH_KEYWORDS, NULL},
    {SIP_MLNAME_CAST(sipName_keyReleaseEvent), (PyCFunction)meth_rviz_VisualizationFrame_keyReleaseEvent, METH_VARARGS|METH_KEYWORDS, NULL},
    {SIP_MLNAME_CAST(sipName_leaveEvent), (PyCFunction)meth_rviz_VisualizationFrame_leaveEvent, METH_VARARGS|METH_KEYWORDS, NULL},
    {SIP_MLNAME_CAST(sipName_load), meth_rviz_VisualizationFrame_load, METH_VARARGS, NULL},
    {SIP_MLNAME_CAST(sipName_loadDisplayConfig), meth_rviz_VisualizationFrame_loadDisplayConfig, METH_VARARGS, NULL},
    {SIP_MLNAME_CAST(sipName_loadPersistentSettings), meth_rviz_VisualizationFrame_loadPersistentSettings, METH_VARARGS, NULL},
    {SIP_MLNAME_CAST(sipName_metric), (PyCFunction)meth_rviz_VisualizationFrame_metric, METH_VARARGS|METH_KEYWORDS, NULL},
    {SIP_MLNAME_CAST(sipName_mouseDoubleClickEvent), (PyCFunction)meth_rviz_VisualizationFrame_mouseDoubleClickEvent, METH_VARARGS|METH_KEYWORDS, NULL},
    {SIP_MLNAME_CAST(sipName_mouseMoveEvent), (PyCFunction)meth_rviz_VisualizationFrame_mouseMoveEvent, METH_VARARGS|METH_KEYWORDS, NULL},
    {SIP_MLNAME_CAST(sipName_mousePressEvent), (PyCFunction)meth_rviz_VisualizationFrame_mousePressEvent, METH_VARARGS|METH_KEYWORDS, NULL},
    {SIP_MLNAME_CAST(sipName_mouseReleaseEvent), (PyCFunction)meth_rviz_VisualizationFrame_mouseReleaseEvent, METH_VARARGS|METH_KEYWORDS, NULL},
    {SIP_MLNAME_CAST(sipName_moveEvent), (PyCFunction)meth_rviz_VisualizationFrame_moveEvent, METH_VARARGS|METH_KEYWORDS, NULL},
    {SIP_MLNAME_CAST(sipName_nativeEvent), (PyCFunction)meth_rviz_VisualizationFrame_nativeEvent, METH_VARARGS|METH_KEYWORDS, NULL},
    {SIP_MLNAME_CAST(sipName_paintEvent), (PyCFunction)meth_rviz_VisualizationFrame_paintEvent, METH_VARARGS|METH_KEYWORDS, NULL},
    {SIP_MLNAME_CAST(sipName_receivers), (PyCFunction)meth_rviz_VisualizationFrame_receivers, METH_VARARGS|METH_KEYWORDS, NULL},
    {SIP_MLNAME_CAST(sipName_resizeEvent), (PyCFunction)meth_rviz_VisualizationFrame_resizeEvent, METH_VARARGS|METH_KEYWORDS, NULL},
    {SIP_MLNAME_CAST(sipName_save), meth_rviz_VisualizationFrame_save, METH_VARARGS, NULL},
    {SIP_MLNAME_CAST(sipName_saveDisplayConfig), meth_rviz_VisualizationFrame_saveDisplayConfig, METH_VARARGS, NULL},
    {SIP_MLNAME_CAST(sipName_savePersistentSettings), meth_rviz_VisualizationFrame_savePersistentSettings, METH_VARARGS, NULL},
    {SIP_MLNAME_CAST(sipName_sender), (PyCFunction)meth_rviz_VisualizationFrame_sender, METH_VARARGS|METH_KEYWORDS, NULL},
    {SIP_MLNAME_CAST(sipName_senderSignalIndex), (PyCFunction)meth_rviz_VisualizationFrame_senderSignalIndex, METH_VARARGS|METH_KEYWORDS, NULL},
    {SIP_MLNAME_CAST(sipName_setHelpPath), meth_rviz_VisualizationFrame_setHelpPath, METH_VARARGS, NULL},
    {SIP_MLNAME_CAST(sipName_setHideButtonVisibility), meth_rviz_VisualizationFrame_setHideButtonVisibility, METH_VARARGS, NULL},
    {SIP_MLNAME_CAST(sipName_setShowChooseNewMaster), meth_rviz_VisualizationFrame_setShowChooseNewMaster, METH_VARARGS, NULL},
    {SIP_MLNAME_CAST(sipName_setSplashPath), meth_rviz_VisualizationFrame_setSplashPath, METH_VARARGS, NULL},
    {SIP_MLNAME_CAST(sipName_sharedPainter), (PyCFunction)meth_rviz_VisualizationFrame_sharedPainter, METH_VARARGS|METH_KEYWORDS, NULL},
    {SIP_MLNAME_CAST(sipName_showEvent), (PyCFunction)meth_rviz_VisualizationFrame_showEvent, METH_VARARGS|METH_KEYWORDS, NULL},
    {SIP_MLNAME_CAST(sipName_tabletEvent), (PyCFunction)meth_rviz_VisualizationFrame_tabletEvent, METH_VARARGS|METH_KEYWORDS, NULL},
    {SIP_MLNAME_CAST(sipName_timerEvent), (PyCFunction)meth_rviz_VisualizationFrame_timerEvent, METH_VARARGS|METH_KEYWORDS, NULL},
    {SIP_MLNAME_CAST(sipName_updateMicroFocus), (PyCFunction)meth_rviz_VisualizationFrame_updateMicroFocus, METH_VARARGS|METH_KEYWORDS, NULL},
    {SIP_MLNAME_CAST(sipName_wheelEvent), (PyCFunction)meth_rviz_VisualizationFrame_wheelEvent, METH_VARARGS|METH_KEYWORDS, NULL}
};


pyqt5ClassTypeDef sipTypeDef_librviz_sip_rviz_VisualizationFrame = {
{
    {
        -1,
        0,
        0,
        SIP_TYPE_SCC|SIP_TYPE_SUPER_INIT|SIP_TYPE_CLASS,
        sipNameNr_rviz__VisualizationFrame,
        {0}
    },
    {
        sipNameNr_VisualizationFrame,
        {0, 255, 0},
        61, methods_rviz_VisualizationFrame,
        0, 0,
        0, 0,
        {0, 0, 0, 0, 0, 0, 0, 0, 0, 0},
    },
    0,
    -1,
    -1,
    supers_rviz_VisualizationFrame,
    0,
    init_type_rviz_VisualizationFrame,
    0,
    0,
#if PY_MAJOR_VERSION >= 3
    0,
    0,
#else
    0,
    0,
    0,
    0,
#endif
    dealloc_rviz_VisualizationFrame,
    0,
    0,
    0,
    release_rviz_VisualizationFrame,
    cast_rviz_VisualizationFrame,
    0,
    0,
    0,
    0,
    0,
    0
},
    &rviz::VisualizationFrame::staticMetaObject,
    0,
    0,
    0
};
